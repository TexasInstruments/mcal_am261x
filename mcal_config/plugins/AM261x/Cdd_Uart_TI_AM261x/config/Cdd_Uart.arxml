AUTOSAR XML (schema 00044)
package /TI_AM261x
  module definition Cdd_Uart [0..*]: post-build-variant-support=true, refined-module-def=Cdd, variants post-build/pre-compile  # Configuration of the CDD (Complex Device Driver) UART module.
    container CddUartDriver  # This container contains the configuration parameters and sub containers of the AUTOSAR Complex device driver (CDD) module.
      container CddUartChannel [1..6]  # Configuration of an individual UART channel.
        enumeration CddUartHwID: {CDD_UART_CHANNEL_ID_0, CDD_UART_CHANNEL_ID_1, CDD_UART_CHANNEL_ID_2, CDD_UART_CHANNEL_ID_3, CDD_UART_CHANNEL_ID_4, CDD_UART_CHANNEL_ID_5}, origin=Texas Instruments, set at post-build in variant post-build / pre-compile in variant pre-compile, default-value=CDD_UART_CHANNEL_ID_0  # This parameter contains the Channel ID of UART port in the device.
        integer CddUartClockFrequency: 32000..1000000000, origin=Texas Instruments, set at post-build in variant post-build / pre-compile in variant pre-compile, default-value=48000000  # This parameter indicates the input clock frequency from the device.
        integer CddUartBaudRate: 2400..12000000, origin=Texas Instruments, set at post-build in variant post-build / pre-compile in variant pre-compile, default-value=115200  # This parameter contains the desired Baud Rate to be used for transmission of signals.
        enumeration CddUartIOMode: {CDD_UART_MODE_POLLING, CDD_UART_MODE_INTERRUPT, CDD_UART_MODE_DMA}, origin=Texas Instruments, set at post-build in variant post-build / pre-compile in variant pre-compile, default-value=CDD_UART_MODE_INTERRUPT  # This parameter identifies the UART operational mode for the configured IP.
        enumeration CddUartTXTriggerLevel: {CDD_UART_TRIGGER_LEVEL_1, CDD_UART_TRIGGER_LEVEL_8, CDD_UART_TRIGGER_LEVEL_16, CDD_UART_TRIGGER_LEVEL_32, CDD_UART_TRIGGER_LEVEL_56}, origin=Texas Instruments, set at post-build in variant post-build / pre-compile in variant pre-compile, default-value=CDD_UART_TRIGGER_LEVEL_16  # This parameter identifies the UART transmission trigger level threshold for the configured UART.
        enumeration CddUartRXTriggerLevel: {CDD_UART_TRIGGER_LEVEL_1, CDD_UART_TRIGGER_LEVEL_8, CDD_UART_TRIGGER_LEVEL_16, CDD_UART_TRIGGER_LEVEL_56, CDD_UART_TRIGGER_LEVEL_60}, origin=Texas Instruments, set at post-build in variant post-build / pre-compile in variant pre-compile, default-value=CDD_UART_TRIGGER_LEVEL_16  # This parameter identifies the UART trigger level threshold during receival for the configured UART.
        enumeration CddUartWordLength: {CDD_UART_WORD_LENGTH_5, CDD_UART_WORD_LENGTH_6, CDD_UART_WORD_LENGTH_7, CDD_UART_WORD_LENGTH_8}, origin=Texas Instruments, set at post-build in variant post-build / pre-compile in variant pre-compile, default-value=CDD_UART_WORD_LENGTH_8  # This parameter identifies the word length for the packets used in data transmission with UART.
        enumeration CddUartParity: {CDD_UART_PARITY_NONE, CDD_UART_PARITY_ODD, CDD_UART_PARITY_EVEN}, origin=Texas Instruments, set at post-build in variant post-build / pre-compile in variant pre-compile, default-value=CDD_UART_PARITY_NONE  # This parameter specifies the parity of the bits transferred.
        enumeration CddUartReadReturnModes: {CDD_UART_FULL_READ_RETURN, CDD_UART_PARTIAL_READ_RETURN}, origin=Texas Instruments, set at post-build in variant post-build / pre-compile in variant pre-compile, default-value=CDD_UART_FULL_READ_RETURN  # This parameter identifies the UART read return modes.
        enumeration CddUartOperatingModes: {CDD_UART_13x_OPER, CDD_UART_16x_OPER, CDD_UART_16x_AUTO_OPER}, origin=Texas Instruments, set at post-build in variant post-build / pre-compile in variant pre-compile, default-value=CDD_UART_16x_OPER  # This parameter identifies the UART operational mode for the configured channels.
        enumeration CddUartStopBits: {CDD_UART_STOP_BIT_1, CDD_UART_STOP_BITS_2}, origin=Texas Instruments, set at post-build in variant post-build / pre-compile in variant pre-compile, default-value=CDD_UART_STOP_BIT_1  # This parameter specifies the size of stop bits to use in data packets.
        function name CddUartReadNotificationHandler: origin=Texas Instruments, set at post-build in variant post-build / pre-compile in variant pre-compile, default-value=CddUart_CallbackReadNotify  # This parameter is a read notification handler function.
        function name CddUartWriteNotificationHandler: origin=Texas Instruments, set at post-build in variant post-build / pre-compile in variant pre-compile, default-value=CddUart_CallbackWriteNotify  # This parameter is a write notification handler function.
        function name CddUartErrorNotificationHandler: origin=Texas Instruments, set at post-build in variant post-build / pre-compile in variant pre-compile, default-value=CddUart_CallbackErrorNotify  # This parameter is a error notification handler function.
        reference CddUartHwUnitCddDmaTxHandler [0..1]: multiplicity set at post-build in variant post-build / pre-compile in variant pre-compile, origin=Texas Instruments, set at post-build in variant post-build / pre-compile in variant pre-compile, destination=CddDmaDriverHandler  # References the CDD DMA handler used for CDD UART transmission
        reference CddUartHwUnitCddDmaRxHandler [0..1]: multiplicity set at post-build in variant post-build / pre-compile in variant pre-compile, origin=Texas Instruments, set at post-build in variant post-build / pre-compile in variant pre-compile, destination=CddDmaDriverHandler  # References the CDD DMA handler used for CDD UART reception
    container CddUartGeneral  # General configuration settings for the Complex Device Driver
      boolean CddVersionInfoApi: origin=Texas Instruments, set at post-build in variant post-build / pre-compile in variant pre-compile, default-value=true  # Switches the Cdd_Uart_GetVersionInfo function ON or OFF.
      boolean CddUartRegisterReadbackApi: origin=Texas Instruments, set at post-build in variant post-build / pre-compile in variant pre-compile, default-value=true  # Switches the Cdd_Uart_RegisterReadback function ON or OFF.
      boolean CddUartDeinitApi: origin=Texas Instruments, set at post-build in variant post-build / pre-compile in variant pre-compile, default-value=true  # Switches the Cdd_Uart_DeInit function ON or OFF.
      boolean CddUartWriteApi: origin=Texas Instruments, set at post-build in variant post-build / pre-compile in variant pre-compile, default-value=true  # Switches the Cdd_Uart_Write function ON or OFF.
      boolean CddUartReadApi: origin=Texas Instruments, set at post-build in variant post-build / pre-compile in variant pre-compile, default-value=true  # Switches the Cdd_Uart_Read function ON or OFF.
      boolean CddUartCancelApi: origin=Texas Instruments, set at post-build in variant post-build / pre-compile in variant pre-compile, default-value=true  # Switches the Cdd_Uart_Cancel function ON or OFF.
      boolean CddUartGetRemainingWordsApi: origin=Texas Instruments, set at post-build in variant post-build / pre-compile in variant pre-compile, default-value=true  # Switches the Cdd_Uart_GetRemainingWords API which returns the remaining words to be transferred from the active device UART instance.
      boolean CddUartDevErrorDetect: origin=Texas Instruments, set at post-build in variant post-build / pre-compile in variant pre-compile, default-value=true  # Switches the Development Error Detection and Notification ON or OFF.
      enumeration CddUartIrqType: {CDD_UART_ISR_VOID, CDD_UART_ISR_CAT1, CDD_UART_ISR_CAT2}, origin=Texas Instruments, set at post-build in variant post-build / pre-compile in variant pre-compile, default-value=CDD_UART_ISR_VOID  # This parameter specifies the category of Interrupt ReQuest for callbacks.
      integer CddDefaultOSCounterId [0..1]: 0..16, multiplicity set at post-build in variant post-build / pre-compile in variant pre-compile, origin=Texas Instruments, set at post-build in variant post-build / pre-compile in variant pre-compile, default-value=0  # Default Os Counter Id if node reference to OsCounter ref CddOsCounterRef is not set
      reference CddOsCounterRef [0..1]: multiplicity set at post-build in variant post-build / pre-compile in variant pre-compile, origin=Texas Instruments, set at post-build in variant post-build / pre-compile in variant pre-compile, destination=OsCounter  # This parameter contains a reference to the OsCounter, which is used by the UART driver.
    container CddUartPublishedInformation  # Container holding all Complex driver specific published information parameters
      enumeration CddUartDeviceVariant: {AM261x}, origin=Texas Instruments, set at post-build in variant post-build / pre-compile in variant pre-compile, default-value=AM261x  # Device variant AM261X
