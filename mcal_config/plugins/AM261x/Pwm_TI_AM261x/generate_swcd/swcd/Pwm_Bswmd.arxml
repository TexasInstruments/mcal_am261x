<?xml version="1.0" encoding="UTF-8"?>
[!AUTOSPACING!][!//
<AUTOSAR xmlns="http://autosar.org/schema/r4.0" xmlns:xsi="http://www.w3.org/2001/XMLSchema-instance" xsi:schemaLocation="http://autosar.org/schema/r4.0 AUTOSAR_00044.xsd">
  <AR-PACKAGES>
    <AR-PACKAGE UUID="7433391b-1e6c-4b89-b26c-f55aa54fa2ac">
      <SHORT-NAME>Pwm_TI_AM261x</SHORT-NAME>
      <ELEMENTS>
        <BSW-MODULE-DESCRIPTION UUID="14f83e36-7628-433d-ac1a-ee586d6d4cf7">
          <SHORT-NAME>Pwm</SHORT-NAME>
          <CATEGORY>BSW_MODULE</CATEGORY>
          <IMPLEMENTED-ENTRYS>
            [!LOOP "as:modconf('Pwm')[1]/PwmChannelConfigSet/PwmChannel/*"!][!//
            [!IF "PwmChannelId = '0'"!][!//
            <BSW-MODULE-ENTRY-REF-CONDITIONAL>
              <BSW-MODULE-ENTRY-REF DEST="BSW-MODULE-ENTRY">/Pwm_TI_AM261x/Pwm_ModuleEntry/Pwm_Ch0Isr</BSW-MODULE-ENTRY-REF>
            </BSW-MODULE-ENTRY-REF-CONDITIONAL>
            [!ENDIF!][!//
            [!IF "PwmChannelId = '10'"!][!//
            <BSW-MODULE-ENTRY-REF-CONDITIONAL>
              <BSW-MODULE-ENTRY-REF DEST="BSW-MODULE-ENTRY">/Pwm_TI_AM261x/Pwm_ModuleEntry/Pwm_Ch10Isr</BSW-MODULE-ENTRY-REF>
            </BSW-MODULE-ENTRY-REF-CONDITIONAL>
            [!ENDIF!][!//
            [!IF "PwmChannelId = '11'"!][!//
            <BSW-MODULE-ENTRY-REF-CONDITIONAL>
              <BSW-MODULE-ENTRY-REF DEST="BSW-MODULE-ENTRY">/Pwm_TI_AM261x/Pwm_ModuleEntry/Pwm_Ch11Isr</BSW-MODULE-ENTRY-REF>
            </BSW-MODULE-ENTRY-REF-CONDITIONAL>
            [!ENDIF!][!//
            [!IF "PwmChannelId = '12'"!][!//
            <BSW-MODULE-ENTRY-REF-CONDITIONAL>
              <BSW-MODULE-ENTRY-REF DEST="BSW-MODULE-ENTRY">/Pwm_TI_AM261x/Pwm_ModuleEntry/Pwm_Ch12Isr</BSW-MODULE-ENTRY-REF>
            </BSW-MODULE-ENTRY-REF-CONDITIONAL>
            [!ENDIF!][!//
            [!IF "PwmChannelId = '13'"!][!//
            <BSW-MODULE-ENTRY-REF-CONDITIONAL>
              <BSW-MODULE-ENTRY-REF DEST="BSW-MODULE-ENTRY">/Pwm_TI_AM261x/Pwm_ModuleEntry/Pwm_Ch13Isr</BSW-MODULE-ENTRY-REF>
            </BSW-MODULE-ENTRY-REF-CONDITIONAL>
            [!ENDIF!][!//
            [!IF "PwmChannelId = '14'"!][!//
            <BSW-MODULE-ENTRY-REF-CONDITIONAL>
              <BSW-MODULE-ENTRY-REF DEST="BSW-MODULE-ENTRY">/Pwm_TI_AM261x/Pwm_ModuleEntry/Pwm_Ch14Isr</BSW-MODULE-ENTRY-REF>
            </BSW-MODULE-ENTRY-REF-CONDITIONAL>
            [!ENDIF!][!//
            [!IF "PwmChannelId = '15'"!][!//
            <BSW-MODULE-ENTRY-REF-CONDITIONAL>
              <BSW-MODULE-ENTRY-REF DEST="BSW-MODULE-ENTRY">/Pwm_TI_AM261x/Pwm_ModuleEntry/Pwm_Ch15Isr</BSW-MODULE-ENTRY-REF>
            </BSW-MODULE-ENTRY-REF-CONDITIONAL>
            [!ENDIF!][!//
            [!IF "PwmChannelId = '16'"!][!//
            <BSW-MODULE-ENTRY-REF-CONDITIONAL>
              <BSW-MODULE-ENTRY-REF DEST="BSW-MODULE-ENTRY">/Pwm_TI_AM261x/Pwm_ModuleEntry/Pwm_Ch16Isr</BSW-MODULE-ENTRY-REF>
            </BSW-MODULE-ENTRY-REF-CONDITIONAL>
            [!ENDIF!][!//
            [!IF "PwmChannelId = '17'"!][!//
            <BSW-MODULE-ENTRY-REF-CONDITIONAL>
              <BSW-MODULE-ENTRY-REF DEST="BSW-MODULE-ENTRY">/Pwm_TI_AM261x/Pwm_ModuleEntry/Pwm_Ch17Isr</BSW-MODULE-ENTRY-REF>
            </BSW-MODULE-ENTRY-REF-CONDITIONAL>
            [!ENDIF!][!//
            [!IF "PwmChannelId = '18'"!][!//
            <BSW-MODULE-ENTRY-REF-CONDITIONAL>
              <BSW-MODULE-ENTRY-REF DEST="BSW-MODULE-ENTRY">/Pwm_TI_AM261x/Pwm_ModuleEntry/Pwm_Ch18Isr</BSW-MODULE-ENTRY-REF>
            </BSW-MODULE-ENTRY-REF-CONDITIONAL>
            [!ENDIF!][!//
            [!IF "PwmChannelId = '19'"!][!//
            <BSW-MODULE-ENTRY-REF-CONDITIONAL>
              <BSW-MODULE-ENTRY-REF DEST="BSW-MODULE-ENTRY">/Pwm_TI_AM261x/Pwm_ModuleEntry/Pwm_Ch19Isr</BSW-MODULE-ENTRY-REF>
            </BSW-MODULE-ENTRY-REF-CONDITIONAL>
            [!ENDIF!][!//
            [!IF "PwmChannelId = '1'"!][!//
            <BSW-MODULE-ENTRY-REF-CONDITIONAL>
              <BSW-MODULE-ENTRY-REF DEST="BSW-MODULE-ENTRY">/Pwm_TI_AM261x/Pwm_ModuleEntry/Pwm_Ch1Isr</BSW-MODULE-ENTRY-REF>
            </BSW-MODULE-ENTRY-REF-CONDITIONAL>
            [!ENDIF!][!//
            [!IF "PwmChannelId = '2'"!][!//
            <BSW-MODULE-ENTRY-REF-CONDITIONAL>
              <BSW-MODULE-ENTRY-REF DEST="BSW-MODULE-ENTRY">/Pwm_TI_AM261x/Pwm_ModuleEntry/Pwm_Ch2Isr</BSW-MODULE-ENTRY-REF>
            </BSW-MODULE-ENTRY-REF-CONDITIONAL>
            [!ENDIF!][!//
            [!IF "PwmChannelId = '3'"!][!//
            <BSW-MODULE-ENTRY-REF-CONDITIONAL>
              <BSW-MODULE-ENTRY-REF DEST="BSW-MODULE-ENTRY">/Pwm_TI_AM261x/Pwm_ModuleEntry/Pwm_Ch3Isr</BSW-MODULE-ENTRY-REF>
            </BSW-MODULE-ENTRY-REF-CONDITIONAL>
            [!ENDIF!][!//
            [!IF "PwmChannelId = '4'"!][!//
            <BSW-MODULE-ENTRY-REF-CONDITIONAL>
              <BSW-MODULE-ENTRY-REF DEST="BSW-MODULE-ENTRY">/Pwm_TI_AM261x/Pwm_ModuleEntry/Pwm_Ch4Isr</BSW-MODULE-ENTRY-REF>
            </BSW-MODULE-ENTRY-REF-CONDITIONAL>
            [!ENDIF!][!//
            [!IF "PwmChannelId = '5'"!][!//
            <BSW-MODULE-ENTRY-REF-CONDITIONAL>
              <BSW-MODULE-ENTRY-REF DEST="BSW-MODULE-ENTRY">/Pwm_TI_AM261x/Pwm_ModuleEntry/Pwm_Ch5Isr</BSW-MODULE-ENTRY-REF>
            </BSW-MODULE-ENTRY-REF-CONDITIONAL>
            [!ENDIF!][!//
            [!IF "PwmChannelId = '6'"!][!//
            <BSW-MODULE-ENTRY-REF-CONDITIONAL>
              <BSW-MODULE-ENTRY-REF DEST="BSW-MODULE-ENTRY">/Pwm_TI_AM261x/Pwm_ModuleEntry/Pwm_Ch6Isr</BSW-MODULE-ENTRY-REF>
            </BSW-MODULE-ENTRY-REF-CONDITIONAL>
            [!ENDIF!][!//
            [!IF "PwmChannelId = '7'"!][!//
            <BSW-MODULE-ENTRY-REF-CONDITIONAL>
              <BSW-MODULE-ENTRY-REF DEST="BSW-MODULE-ENTRY">/Pwm_TI_AM261x/Pwm_ModuleEntry/Pwm_Ch7Isr</BSW-MODULE-ENTRY-REF>
            </BSW-MODULE-ENTRY-REF-CONDITIONAL>
            [!ENDIF!][!//
            [!IF "PwmChannelId = '8'"!][!//
            <BSW-MODULE-ENTRY-REF-CONDITIONAL>
              <BSW-MODULE-ENTRY-REF DEST="BSW-MODULE-ENTRY">/Pwm_TI_AM261x/Pwm_ModuleEntry/Pwm_Ch8Isr</BSW-MODULE-ENTRY-REF>
            </BSW-MODULE-ENTRY-REF-CONDITIONAL>
            [!ENDIF!][!//
            [!IF "PwmChannelId = '9'"!][!//
            <BSW-MODULE-ENTRY-REF-CONDITIONAL>
              <BSW-MODULE-ENTRY-REF DEST="BSW-MODULE-ENTRY">/Pwm_TI_AM261x/Pwm_ModuleEntry/Pwm_Ch9Isr</BSW-MODULE-ENTRY-REF>
            </BSW-MODULE-ENTRY-REF-CONDITIONAL>
            [!ENDIF!][!//
            [!ENDLOOP!][!//
            [!IF "as:modconf('Pwm')[1]/PwmConfigurationOfOptApiServices/PwmDeInitApi = 'true'"!][!//
            <BSW-MODULE-ENTRY-REF-CONDITIONAL>
              <BSW-MODULE-ENTRY-REF DEST="BSW-MODULE-ENTRY">/Pwm_TI_AM261x/Pwm_ModuleEntry/Pwm_DeInit</BSW-MODULE-ENTRY-REF>
            </BSW-MODULE-ENTRY-REF-CONDITIONAL>
            [!ENDIF!][!//
            [!IF "as:modconf('Pwm')[1]/PwmGeneral/PwmNotificationSupported = 'true'"!][!//
            <BSW-MODULE-ENTRY-REF-CONDITIONAL>
              <BSW-MODULE-ENTRY-REF DEST="BSW-MODULE-ENTRY">/Pwm_TI_AM261x/Pwm_ModuleEntry/Pwm_DisableNotification</BSW-MODULE-ENTRY-REF>
            </BSW-MODULE-ENTRY-REF-CONDITIONAL>
            [!ENDIF!][!//
            [!IF "as:modconf('Pwm')[1]/PwmGeneral/PwmNotificationSupported = 'true'"!][!//
            <BSW-MODULE-ENTRY-REF-CONDITIONAL>
              <BSW-MODULE-ENTRY-REF DEST="BSW-MODULE-ENTRY">/Pwm_TI_AM261x/Pwm_ModuleEntry/Pwm_EnableNotification</BSW-MODULE-ENTRY-REF>
            </BSW-MODULE-ENTRY-REF-CONDITIONAL>
            [!ENDIF!][!//
            [!IF "as:modconf('Pwm')[1]/PwmConfigurationOfOptApiServices/PwmGetOutputState = 'true'"!][!//
            <BSW-MODULE-ENTRY-REF-CONDITIONAL>
              <BSW-MODULE-ENTRY-REF DEST="BSW-MODULE-ENTRY">/Pwm_TI_AM261x/Pwm_ModuleEntry/Pwm_GetOutputState</BSW-MODULE-ENTRY-REF>
            </BSW-MODULE-ENTRY-REF-CONDITIONAL>
            [!ENDIF!][!//
            [!IF "as:modconf('Pwm')[1]/PwmConfigurationOfOptApiServices/PwmVersionInfoApi = 'true'"!][!//
            <BSW-MODULE-ENTRY-REF-CONDITIONAL>
              <BSW-MODULE-ENTRY-REF DEST="BSW-MODULE-ENTRY">/Pwm_TI_AM261x/Pwm_ModuleEntry/Pwm_GetVersionInfo</BSW-MODULE-ENTRY-REF>
            </BSW-MODULE-ENTRY-REF-CONDITIONAL>
            [!ENDIF!][!//
            <BSW-MODULE-ENTRY-REF-CONDITIONAL>
              <BSW-MODULE-ENTRY-REF DEST="BSW-MODULE-ENTRY">/Pwm_TI_AM261x/Pwm_ModuleEntry/Pwm_Init</BSW-MODULE-ENTRY-REF>
            </BSW-MODULE-ENTRY-REF-CONDITIONAL>
            [!IF "as:modconf('Pwm')[1]/PwmConfigurationOfOptApiServices/PwmEnableRegisterReadbackApi = 'true'"!][!//
            <BSW-MODULE-ENTRY-REF-CONDITIONAL>
              <BSW-MODULE-ENTRY-REF DEST="BSW-MODULE-ENTRY">/Pwm_TI_AM261x/Pwm_ModuleEntry/Pwm_RegisterReadback</BSW-MODULE-ENTRY-REF>
            </BSW-MODULE-ENTRY-REF-CONDITIONAL>
            [!ENDIF!][!//
            [!IF "as:modconf('Pwm')[1]/PwmConfigurationOfOptApiServices/PwmSetDutyCycle = 'true'"!][!//
            <BSW-MODULE-ENTRY-REF-CONDITIONAL>
              <BSW-MODULE-ENTRY-REF DEST="BSW-MODULE-ENTRY">/Pwm_TI_AM261x/Pwm_ModuleEntry/Pwm_SetDutyCycle</BSW-MODULE-ENTRY-REF>
            </BSW-MODULE-ENTRY-REF-CONDITIONAL>
            [!ENDIF!][!//
            [!IF "as:modconf('Pwm')[1]/PwmConfigurationOfOptApiServices/PwmSetOutputToIdle = 'true'"!][!//
            <BSW-MODULE-ENTRY-REF-CONDITIONAL>
              <BSW-MODULE-ENTRY-REF DEST="BSW-MODULE-ENTRY">/Pwm_TI_AM261x/Pwm_ModuleEntry/Pwm_SetOutputToIdle</BSW-MODULE-ENTRY-REF>
            </BSW-MODULE-ENTRY-REF-CONDITIONAL>
            [!ENDIF!][!//
            [!IF "as:modconf('Pwm')[1]/PwmConfigurationOfOptApiServices/PwmSetPeriodAndDuty = 'true'"!][!//
            <BSW-MODULE-ENTRY-REF-CONDITIONAL>
              <BSW-MODULE-ENTRY-REF DEST="BSW-MODULE-ENTRY">/Pwm_TI_AM261x/Pwm_ModuleEntry/Pwm_SetPeriodAndDuty</BSW-MODULE-ENTRY-REF>
            </BSW-MODULE-ENTRY-REF-CONDITIONAL>
            [!ENDIF!][!//
          </IMPLEMENTED-ENTRYS>
          <MODULE-ID>121</MODULE-ID>
          <BSW-MODULE-DEPENDENCYS>
            [!IF "as:modconf('Pwm')[1]/PwmGeneral/PwmDevErrorDetect = 'true'"!][!//
            <BSW-MODULE-DEPENDENCY UUID="fb9fb20b-41dd-44be-85ba-f696bc291799">
              <SHORT-NAME>Det</SHORT-NAME>
              <TARGET-MODULE-ID>15</TARGET-MODULE-ID>
              <TARGET-MODULE-REFS>
                <BSW-MODULE-DESCRIPTION-REF-CONDITIONAL>
                  <BSW-MODULE-DESCRIPTION-REF DEST="BSW-MODULE-DESCRIPTION">/AUTOSAR_Det/Det</BSW-MODULE-DESCRIPTION-REF>
                </BSW-MODULE-DESCRIPTION-REF-CONDITIONAL>
              </TARGET-MODULE-REFS>
            </BSW-MODULE-DEPENDENCY>
            [!ENDIF!][!//
          </BSW-MODULE-DEPENDENCYS>
          <INTERNAL-BEHAVIORS>
            <BSW-INTERNAL-BEHAVIOR UUID="545cba72-7e9d-4b82-a776-f965a81d3077">
              <SHORT-NAME>Pwm_Behavior</SHORT-NAME>
              <EXCLUSIVE-AREAS>
                <EXCLUSIVE-AREA UUID="44ce0598-db74-4c06-b2ec-ce7472afbcb3">
                  <SHORT-NAME>PWM_EXCLUSIVE_AREA_0</SHORT-NAME>
                </EXCLUSIVE-AREA>
              </EXCLUSIVE-AREAS>
              <ENTITYS>
                [!LOOP "as:modconf('Pwm')[1]/PwmChannelConfigSet/PwmChannel/*"!][!//
                [!IF "PwmChannelId = '0'"!][!//
                <BSW-INTERRUPT-ENTITY UUID="8bb521da-fed2-44e4-beaa-041ec071da91">
                  <SHORT-NAME>Pwm_Ch0Isr</SHORT-NAME>
                  <MINIMUM-START-INTERVAL>0.0</MINIMUM-START-INTERVAL>
                  <REENTRANCY-LEVEL>NON-REENTRANT</REENTRANCY-LEVEL>
                  <IMPLEMENTED-ENTRY-REF DEST="BSW-MODULE-ENTRY">/Pwm_TI_AM261x/Pwm_ModuleEntry/Pwm_Ch0Isr</IMPLEMENTED-ENTRY-REF>
                  [!IF "as:modconf('Pwm')[1]/PwmGeneral/PwmTypeofInterruptFunction = 'PWM_ISR_CAT2'"!][!//
                  <INTERRUPT-CATEGORY>CAT-2</INTERRUPT-CATEGORY>
                  [!ELSE!][!//
                  <INTERRUPT-CATEGORY>CAT-1</INTERRUPT-CATEGORY>
                  [!ENDIF!][!//
                  <INTERRUPT-SOURCE>Hardware</INTERRUPT-SOURCE>
                </BSW-INTERRUPT-ENTITY>
                [!ENDIF!][!//
                [!IF "PwmChannelId = '10'"!][!//
                <BSW-INTERRUPT-ENTITY UUID="0365f434-8fd1-45a8-a2fc-45e9ad6129d8">
                  <SHORT-NAME>Pwm_Ch10Isr</SHORT-NAME>
                  <MINIMUM-START-INTERVAL>0.0</MINIMUM-START-INTERVAL>
                  <REENTRANCY-LEVEL>NON-REENTRANT</REENTRANCY-LEVEL>
                  <IMPLEMENTED-ENTRY-REF DEST="BSW-MODULE-ENTRY">/Pwm_TI_AM261x/Pwm_ModuleEntry/Pwm_Ch10Isr</IMPLEMENTED-ENTRY-REF>
                  [!IF "as:modconf('Pwm')[1]/PwmGeneral/PwmTypeofInterruptFunction = 'PWM_ISR_CAT2'"!][!//
                  <INTERRUPT-CATEGORY>CAT-2</INTERRUPT-CATEGORY>
                  [!ELSE!][!//
                  <INTERRUPT-CATEGORY>CAT-1</INTERRUPT-CATEGORY>
                  [!ENDIF!][!//
                  <INTERRUPT-SOURCE>Hardware</INTERRUPT-SOURCE>
                </BSW-INTERRUPT-ENTITY>
                [!ENDIF!][!//
                [!IF "PwmChannelId = '11'"!][!//
                <BSW-INTERRUPT-ENTITY UUID="32c25eee-5e87-4f9e-a087-f16e0c44a651">
                  <SHORT-NAME>Pwm_Ch11Isr</SHORT-NAME>
                  <MINIMUM-START-INTERVAL>0.0</MINIMUM-START-INTERVAL>
                  <REENTRANCY-LEVEL>NON-REENTRANT</REENTRANCY-LEVEL>
                  <IMPLEMENTED-ENTRY-REF DEST="BSW-MODULE-ENTRY">/Pwm_TI_AM261x/Pwm_ModuleEntry/Pwm_Ch11Isr</IMPLEMENTED-ENTRY-REF>
                  [!IF "as:modconf('Pwm')[1]/PwmGeneral/PwmTypeofInterruptFunction = 'PWM_ISR_CAT2'"!][!//
                  <INTERRUPT-CATEGORY>CAT-2</INTERRUPT-CATEGORY>
                  [!ELSE!][!//
                  <INTERRUPT-CATEGORY>CAT-1</INTERRUPT-CATEGORY>
                  [!ENDIF!][!//
                  <INTERRUPT-SOURCE>Hardware</INTERRUPT-SOURCE>
                </BSW-INTERRUPT-ENTITY>
                [!ENDIF!][!//
                [!IF "PwmChannelId = '12'"!][!//
                <BSW-INTERRUPT-ENTITY UUID="89a68e96-67df-4c5b-af8c-a7aa30463755">
                  <SHORT-NAME>Pwm_Ch12Isr</SHORT-NAME>
                  <MINIMUM-START-INTERVAL>0.0</MINIMUM-START-INTERVAL>
                  <REENTRANCY-LEVEL>NON-REENTRANT</REENTRANCY-LEVEL>
                  <IMPLEMENTED-ENTRY-REF DEST="BSW-MODULE-ENTRY">/Pwm_TI_AM261x/Pwm_ModuleEntry/Pwm_Ch12Isr</IMPLEMENTED-ENTRY-REF>
                  [!IF "as:modconf('Pwm')[1]/PwmGeneral/PwmTypeofInterruptFunction = 'PWM_ISR_CAT2'"!][!//
                  <INTERRUPT-CATEGORY>CAT-2</INTERRUPT-CATEGORY>
                  [!ELSE!][!//
                  <INTERRUPT-CATEGORY>CAT-1</INTERRUPT-CATEGORY>
                  [!ENDIF!][!//
                  <INTERRUPT-SOURCE>Hardware</INTERRUPT-SOURCE>
                </BSW-INTERRUPT-ENTITY>
                [!ENDIF!][!//
                [!IF "PwmChannelId = '13'"!][!//
                <BSW-INTERRUPT-ENTITY UUID="5eaecaf1-f346-4f48-a3fe-42c19144e359">
                  <SHORT-NAME>Pwm_Ch13Isr</SHORT-NAME>
                  <MINIMUM-START-INTERVAL>0.0</MINIMUM-START-INTERVAL>
                  <REENTRANCY-LEVEL>NON-REENTRANT</REENTRANCY-LEVEL>
                  <IMPLEMENTED-ENTRY-REF DEST="BSW-MODULE-ENTRY">/Pwm_TI_AM261x/Pwm_ModuleEntry/Pwm_Ch13Isr</IMPLEMENTED-ENTRY-REF>
                  [!IF "as:modconf('Pwm')[1]/PwmGeneral/PwmTypeofInterruptFunction = 'PWM_ISR_CAT2'"!][!//
                  <INTERRUPT-CATEGORY>CAT-2</INTERRUPT-CATEGORY>
                  [!ELSE!][!//
                  <INTERRUPT-CATEGORY>CAT-1</INTERRUPT-CATEGORY>
                  [!ENDIF!][!//
                  <INTERRUPT-SOURCE>Hardware</INTERRUPT-SOURCE>
                </BSW-INTERRUPT-ENTITY>
                [!ENDIF!][!//
                [!IF "PwmChannelId = '14'"!][!//
                <BSW-INTERRUPT-ENTITY UUID="f03bf9d1-d98c-400c-aa60-9d3b0d061e20">
                  <SHORT-NAME>Pwm_Ch14Isr</SHORT-NAME>
                  <MINIMUM-START-INTERVAL>0.0</MINIMUM-START-INTERVAL>
                  <REENTRANCY-LEVEL>NON-REENTRANT</REENTRANCY-LEVEL>
                  <IMPLEMENTED-ENTRY-REF DEST="BSW-MODULE-ENTRY">/Pwm_TI_AM261x/Pwm_ModuleEntry/Pwm_Ch14Isr</IMPLEMENTED-ENTRY-REF>
                  [!IF "as:modconf('Pwm')[1]/PwmGeneral/PwmTypeofInterruptFunction = 'PWM_ISR_CAT2'"!][!//
                  <INTERRUPT-CATEGORY>CAT-2</INTERRUPT-CATEGORY>
                  [!ELSE!][!//
                  <INTERRUPT-CATEGORY>CAT-1</INTERRUPT-CATEGORY>
                  [!ENDIF!][!//
                  <INTERRUPT-SOURCE>Hardware</INTERRUPT-SOURCE>
                </BSW-INTERRUPT-ENTITY>
                [!ENDIF!][!//
                [!IF "PwmChannelId = '15'"!][!//
                <BSW-INTERRUPT-ENTITY UUID="21cc732d-8f65-4db9-a8c9-07a82e2779e2">
                  <SHORT-NAME>Pwm_Ch15Isr</SHORT-NAME>
                  <MINIMUM-START-INTERVAL>0.0</MINIMUM-START-INTERVAL>
                  <REENTRANCY-LEVEL>NON-REENTRANT</REENTRANCY-LEVEL>
                  <IMPLEMENTED-ENTRY-REF DEST="BSW-MODULE-ENTRY">/Pwm_TI_AM261x/Pwm_ModuleEntry/Pwm_Ch15Isr</IMPLEMENTED-ENTRY-REF>
                  [!IF "as:modconf('Pwm')[1]/PwmGeneral/PwmTypeofInterruptFunction = 'PWM_ISR_CAT2'"!][!//
                  <INTERRUPT-CATEGORY>CAT-2</INTERRUPT-CATEGORY>
                  [!ELSE!][!//
                  <INTERRUPT-CATEGORY>CAT-1</INTERRUPT-CATEGORY>
                  [!ENDIF!][!//
                  <INTERRUPT-SOURCE>Hardware</INTERRUPT-SOURCE>
                </BSW-INTERRUPT-ENTITY>
                [!ENDIF!][!//
                [!IF "PwmChannelId = '16'"!][!//
                <BSW-INTERRUPT-ENTITY UUID="ec9452c5-8c2a-4c8c-9cad-eff5b4700469">
                  <SHORT-NAME>Pwm_Ch16Isr</SHORT-NAME>
                  <MINIMUM-START-INTERVAL>0.0</MINIMUM-START-INTERVAL>
                  <REENTRANCY-LEVEL>NON-REENTRANT</REENTRANCY-LEVEL>
                  <IMPLEMENTED-ENTRY-REF DEST="BSW-MODULE-ENTRY">/Pwm_TI_AM261x/Pwm_ModuleEntry/Pwm_Ch16Isr</IMPLEMENTED-ENTRY-REF>
                  [!IF "as:modconf('Pwm')[1]/PwmGeneral/PwmTypeofInterruptFunction = 'PWM_ISR_CAT2'"!][!//
                  <INTERRUPT-CATEGORY>CAT-2</INTERRUPT-CATEGORY>
                  [!ELSE!][!//
                  <INTERRUPT-CATEGORY>CAT-1</INTERRUPT-CATEGORY>
                  [!ENDIF!][!//
                  <INTERRUPT-SOURCE>Hardware</INTERRUPT-SOURCE>
                </BSW-INTERRUPT-ENTITY>
                [!ENDIF!][!//
                [!IF "PwmChannelId = '17'"!][!//
                <BSW-INTERRUPT-ENTITY UUID="c808331f-4631-43ac-9da1-ffe9bddcb70b">
                  <SHORT-NAME>Pwm_Ch17Isr</SHORT-NAME>
                  <MINIMUM-START-INTERVAL>0.0</MINIMUM-START-INTERVAL>
                  <REENTRANCY-LEVEL>NON-REENTRANT</REENTRANCY-LEVEL>
                  <IMPLEMENTED-ENTRY-REF DEST="BSW-MODULE-ENTRY">/Pwm_TI_AM261x/Pwm_ModuleEntry/Pwm_Ch17Isr</IMPLEMENTED-ENTRY-REF>
                  [!IF "as:modconf('Pwm')[1]/PwmGeneral/PwmTypeofInterruptFunction = 'PWM_ISR_CAT2'"!][!//
                  <INTERRUPT-CATEGORY>CAT-2</INTERRUPT-CATEGORY>
                  [!ELSE!][!//
                  <INTERRUPT-CATEGORY>CAT-1</INTERRUPT-CATEGORY>
                  [!ENDIF!][!//
                  <INTERRUPT-SOURCE>Hardware</INTERRUPT-SOURCE>
                </BSW-INTERRUPT-ENTITY>
                [!ENDIF!][!//
                [!IF "PwmChannelId = '18'"!][!//
                <BSW-INTERRUPT-ENTITY UUID="52ef6296-bafd-48e5-a868-d76670d31b5f">
                  <SHORT-NAME>Pwm_Ch18Isr</SHORT-NAME>
                  <MINIMUM-START-INTERVAL>0.0</MINIMUM-START-INTERVAL>
                  <REENTRANCY-LEVEL>NON-REENTRANT</REENTRANCY-LEVEL>
                  <IMPLEMENTED-ENTRY-REF DEST="BSW-MODULE-ENTRY">/Pwm_TI_AM261x/Pwm_ModuleEntry/Pwm_Ch18Isr</IMPLEMENTED-ENTRY-REF>
                  [!IF "as:modconf('Pwm')[1]/PwmGeneral/PwmTypeofInterruptFunction = 'PWM_ISR_CAT2'"!][!//
                  <INTERRUPT-CATEGORY>CAT-2</INTERRUPT-CATEGORY>
                  [!ELSE!][!//
                  <INTERRUPT-CATEGORY>CAT-1</INTERRUPT-CATEGORY>
                  [!ENDIF!][!//
                  <INTERRUPT-SOURCE>Hardware</INTERRUPT-SOURCE>
                </BSW-INTERRUPT-ENTITY>
                [!ENDIF!][!//
                [!IF "PwmChannelId = '19'"!][!//
                <BSW-INTERRUPT-ENTITY UUID="2bd3d547-f554-4346-b92f-1e93c792e35b">
                  <SHORT-NAME>Pwm_Ch19Isr</SHORT-NAME>
                  <MINIMUM-START-INTERVAL>0.0</MINIMUM-START-INTERVAL>
                  <REENTRANCY-LEVEL>NON-REENTRANT</REENTRANCY-LEVEL>
                  <IMPLEMENTED-ENTRY-REF DEST="BSW-MODULE-ENTRY">/Pwm_TI_AM261x/Pwm_ModuleEntry/Pwm_Ch19Isr</IMPLEMENTED-ENTRY-REF>
                  [!IF "as:modconf('Pwm')[1]/PwmGeneral/PwmTypeofInterruptFunction = 'PWM_ISR_CAT2'"!][!//
                  <INTERRUPT-CATEGORY>CAT-2</INTERRUPT-CATEGORY>
                  [!ELSE!][!//
                  <INTERRUPT-CATEGORY>CAT-1</INTERRUPT-CATEGORY>
                  [!ENDIF!][!//
                  <INTERRUPT-SOURCE>Hardware</INTERRUPT-SOURCE>
                </BSW-INTERRUPT-ENTITY>
                [!ENDIF!][!//
                [!IF "PwmChannelId = '1'"!][!//
                <BSW-INTERRUPT-ENTITY UUID="e9502660-ef46-41a8-a7a0-0bc8ef0b9119">
                  <SHORT-NAME>Pwm_Ch1Isr</SHORT-NAME>
                  <MINIMUM-START-INTERVAL>0.0</MINIMUM-START-INTERVAL>
                  <REENTRANCY-LEVEL>NON-REENTRANT</REENTRANCY-LEVEL>
                  <IMPLEMENTED-ENTRY-REF DEST="BSW-MODULE-ENTRY">/Pwm_TI_AM261x/Pwm_ModuleEntry/Pwm_Ch1Isr</IMPLEMENTED-ENTRY-REF>
                  [!IF "as:modconf('Pwm')[1]/PwmGeneral/PwmTypeofInterruptFunction = 'PWM_ISR_CAT2'"!][!//
                  <INTERRUPT-CATEGORY>CAT-2</INTERRUPT-CATEGORY>
                  [!ELSE!][!//
                  <INTERRUPT-CATEGORY>CAT-1</INTERRUPT-CATEGORY>
                  [!ENDIF!][!//
                  <INTERRUPT-SOURCE>Hardware</INTERRUPT-SOURCE>
                </BSW-INTERRUPT-ENTITY>
                [!ENDIF!][!//
                [!IF "PwmChannelId = '2'"!][!//
                <BSW-INTERRUPT-ENTITY UUID="ee951f73-c94a-4f92-b06a-9c0d11fff6bb">
                  <SHORT-NAME>Pwm_Ch2Isr</SHORT-NAME>
                  <MINIMUM-START-INTERVAL>0.0</MINIMUM-START-INTERVAL>
                  <REENTRANCY-LEVEL>NON-REENTRANT</REENTRANCY-LEVEL>
                  <IMPLEMENTED-ENTRY-REF DEST="BSW-MODULE-ENTRY">/Pwm_TI_AM261x/Pwm_ModuleEntry/Pwm_Ch2Isr</IMPLEMENTED-ENTRY-REF>
                  [!IF "as:modconf('Pwm')[1]/PwmGeneral/PwmTypeofInterruptFunction = 'PWM_ISR_CAT2'"!][!//
                  <INTERRUPT-CATEGORY>CAT-2</INTERRUPT-CATEGORY>
                  [!ELSE!][!//
                  <INTERRUPT-CATEGORY>CAT-1</INTERRUPT-CATEGORY>
                  [!ENDIF!][!//
                  <INTERRUPT-SOURCE>Hardware</INTERRUPT-SOURCE>
                </BSW-INTERRUPT-ENTITY>
                [!ENDIF!][!//
                [!IF "PwmChannelId = '3'"!][!//
                <BSW-INTERRUPT-ENTITY UUID="273f3b77-66f6-45d8-a908-4925fd990f68">
                  <SHORT-NAME>Pwm_Ch3Isr</SHORT-NAME>
                  <MINIMUM-START-INTERVAL>0.0</MINIMUM-START-INTERVAL>
                  <REENTRANCY-LEVEL>NON-REENTRANT</REENTRANCY-LEVEL>
                  <IMPLEMENTED-ENTRY-REF DEST="BSW-MODULE-ENTRY">/Pwm_TI_AM261x/Pwm_ModuleEntry/Pwm_Ch3Isr</IMPLEMENTED-ENTRY-REF>
                  [!IF "as:modconf('Pwm')[1]/PwmGeneral/PwmTypeofInterruptFunction = 'PWM_ISR_CAT2'"!][!//
                  <INTERRUPT-CATEGORY>CAT-2</INTERRUPT-CATEGORY>
                  [!ELSE!][!//
                  <INTERRUPT-CATEGORY>CAT-1</INTERRUPT-CATEGORY>
                  [!ENDIF!][!//
                  <INTERRUPT-SOURCE>Hardware</INTERRUPT-SOURCE>
                </BSW-INTERRUPT-ENTITY>
                [!ENDIF!][!//
                [!IF "PwmChannelId = '4'"!][!//
                <BSW-INTERRUPT-ENTITY UUID="4b67eb75-1956-40b3-b52d-56dc868f84dc">
                  <SHORT-NAME>Pwm_Ch4Isr</SHORT-NAME>
                  <MINIMUM-START-INTERVAL>0.0</MINIMUM-START-INTERVAL>
                  <REENTRANCY-LEVEL>NON-REENTRANT</REENTRANCY-LEVEL>
                  <IMPLEMENTED-ENTRY-REF DEST="BSW-MODULE-ENTRY">/Pwm_TI_AM261x/Pwm_ModuleEntry/Pwm_Ch4Isr</IMPLEMENTED-ENTRY-REF>
                  [!IF "as:modconf('Pwm')[1]/PwmGeneral/PwmTypeofInterruptFunction = 'PWM_ISR_CAT2'"!][!//
                  <INTERRUPT-CATEGORY>CAT-2</INTERRUPT-CATEGORY>
                  [!ELSE!][!//
                  <INTERRUPT-CATEGORY>CAT-1</INTERRUPT-CATEGORY>
                  [!ENDIF!][!//
                  <INTERRUPT-SOURCE>Hardware</INTERRUPT-SOURCE>
                </BSW-INTERRUPT-ENTITY>
                [!ENDIF!][!//
                [!IF "PwmChannelId = '5'"!][!//
                <BSW-INTERRUPT-ENTITY UUID="227bff96-ac5a-4415-87c3-e3b6ada39727">
                  <SHORT-NAME>Pwm_Ch5Isr</SHORT-NAME>
                  <MINIMUM-START-INTERVAL>0.0</MINIMUM-START-INTERVAL>
                  <REENTRANCY-LEVEL>NON-REENTRANT</REENTRANCY-LEVEL>
                  <IMPLEMENTED-ENTRY-REF DEST="BSW-MODULE-ENTRY">/Pwm_TI_AM261x/Pwm_ModuleEntry/Pwm_Ch5Isr</IMPLEMENTED-ENTRY-REF>
                  [!IF "as:modconf('Pwm')[1]/PwmGeneral/PwmTypeofInterruptFunction = 'PWM_ISR_CAT2'"!][!//
                  <INTERRUPT-CATEGORY>CAT-2</INTERRUPT-CATEGORY>
                  [!ELSE!][!//
                  <INTERRUPT-CATEGORY>CAT-1</INTERRUPT-CATEGORY>
                  [!ENDIF!][!//
                  <INTERRUPT-SOURCE>Hardware</INTERRUPT-SOURCE>
                </BSW-INTERRUPT-ENTITY>
                [!ENDIF!][!//
                [!IF "PwmChannelId = '6'"!][!//
                <BSW-INTERRUPT-ENTITY UUID="3e011397-fcf5-4f58-a8fa-9ea5fbd3ff98">
                  <SHORT-NAME>Pwm_Ch6Isr</SHORT-NAME>
                  <MINIMUM-START-INTERVAL>0.0</MINIMUM-START-INTERVAL>
                  <REENTRANCY-LEVEL>NON-REENTRANT</REENTRANCY-LEVEL>
                  <IMPLEMENTED-ENTRY-REF DEST="BSW-MODULE-ENTRY">/Pwm_TI_AM261x/Pwm_ModuleEntry/Pwm_Ch6Isr</IMPLEMENTED-ENTRY-REF>
                  [!IF "as:modconf('Pwm')[1]/PwmGeneral/PwmTypeofInterruptFunction = 'PWM_ISR_CAT2'"!][!//
                  <INTERRUPT-CATEGORY>CAT-2</INTERRUPT-CATEGORY>
                  [!ELSE!][!//
                  <INTERRUPT-CATEGORY>CAT-1</INTERRUPT-CATEGORY>
                  [!ENDIF!][!//
                  <INTERRUPT-SOURCE>Hardware</INTERRUPT-SOURCE>
                </BSW-INTERRUPT-ENTITY>
                [!ENDIF!][!//
                [!IF "PwmChannelId = '7'"!][!//
                <BSW-INTERRUPT-ENTITY UUID="825f5a44-f023-43fb-a52d-6d1b9b4cb011">
                  <SHORT-NAME>Pwm_Ch7Isr</SHORT-NAME>
                  <MINIMUM-START-INTERVAL>0.0</MINIMUM-START-INTERVAL>
                  <REENTRANCY-LEVEL>NON-REENTRANT</REENTRANCY-LEVEL>
                  <IMPLEMENTED-ENTRY-REF DEST="BSW-MODULE-ENTRY">/Pwm_TI_AM261x/Pwm_ModuleEntry/Pwm_Ch7Isr</IMPLEMENTED-ENTRY-REF>
                  [!IF "as:modconf('Pwm')[1]/PwmGeneral/PwmTypeofInterruptFunction = 'PWM_ISR_CAT2'"!][!//
                  <INTERRUPT-CATEGORY>CAT-2</INTERRUPT-CATEGORY>
                  [!ELSE!][!//
                  <INTERRUPT-CATEGORY>CAT-1</INTERRUPT-CATEGORY>
                  [!ENDIF!][!//
                  <INTERRUPT-SOURCE>Hardware</INTERRUPT-SOURCE>
                </BSW-INTERRUPT-ENTITY>
                [!ENDIF!][!//
                [!IF "PwmChannelId = '8'"!][!//
                <BSW-INTERRUPT-ENTITY UUID="f6be7c68-f351-4a48-83dd-8bd30cfa6d06">
                  <SHORT-NAME>Pwm_Ch8Isr</SHORT-NAME>
                  <MINIMUM-START-INTERVAL>0.0</MINIMUM-START-INTERVAL>
                  <REENTRANCY-LEVEL>NON-REENTRANT</REENTRANCY-LEVEL>
                  <IMPLEMENTED-ENTRY-REF DEST="BSW-MODULE-ENTRY">/Pwm_TI_AM261x/Pwm_ModuleEntry/Pwm_Ch8Isr</IMPLEMENTED-ENTRY-REF>
                  [!IF "as:modconf('Pwm')[1]/PwmGeneral/PwmTypeofInterruptFunction = 'PWM_ISR_CAT2'"!][!//
                  <INTERRUPT-CATEGORY>CAT-2</INTERRUPT-CATEGORY>
                  [!ELSE!][!//
                  <INTERRUPT-CATEGORY>CAT-1</INTERRUPT-CATEGORY>
                  [!ENDIF!][!//
                  <INTERRUPT-SOURCE>Hardware</INTERRUPT-SOURCE>
                </BSW-INTERRUPT-ENTITY>
                [!ENDIF!][!//
                [!IF "PwmChannelId = '9'"!][!//
                <BSW-INTERRUPT-ENTITY UUID="62b6aa11-3d86-4aca-b095-0f1fd4d9a330">
                  <SHORT-NAME>Pwm_Ch9Isr</SHORT-NAME>
                  <MINIMUM-START-INTERVAL>0.0</MINIMUM-START-INTERVAL>
                  <REENTRANCY-LEVEL>NON-REENTRANT</REENTRANCY-LEVEL>
                  <IMPLEMENTED-ENTRY-REF DEST="BSW-MODULE-ENTRY">/Pwm_TI_AM261x/Pwm_ModuleEntry/Pwm_Ch9Isr</IMPLEMENTED-ENTRY-REF>
                  [!IF "as:modconf('Pwm')[1]/PwmGeneral/PwmTypeofInterruptFunction = 'PWM_ISR_CAT2'"!][!//
                  <INTERRUPT-CATEGORY>CAT-2</INTERRUPT-CATEGORY>
                  [!ELSE!][!//
                  <INTERRUPT-CATEGORY>CAT-1</INTERRUPT-CATEGORY>
                  [!ENDIF!][!//
                  <INTERRUPT-SOURCE>Hardware</INTERRUPT-SOURCE>
                </BSW-INTERRUPT-ENTITY>
                [!ENDIF!][!//
                [!ENDLOOP!][!//
                [!IF "as:modconf('Pwm')[1]/PwmConfigurationOfOptApiServices/PwmDeInitApi = 'true'"!][!//
                <BSW-CALLED-ENTITY UUID="836c9c4c-c0c5-4db2-bf6d-3b54f782bc28">
                  <SHORT-NAME>Pwm_DeInit</SHORT-NAME>
                  <MINIMUM-START-INTERVAL>0.0</MINIMUM-START-INTERVAL>
                  <REENTRANCY-LEVEL>NON-REENTRANT</REENTRANCY-LEVEL>
                  <CALL-POINTS>
                    [!IF "as:modconf('Pwm')[1]/PwmGeneral/PwmDevErrorDetect = 'true'"!][!//
                    <BSW-DIRECT-CALL-POINT>
                      <SHORT-NAME>Det_ReportError</SHORT-NAME>
                      <CALLED-ENTRY-REF DEST="BSW-MODULE-ENTRY">/AUTOSAR_Det/BSWModuleEntry/Det_ReportError</CALLED-ENTRY-REF>
                    </BSW-DIRECT-CALL-POINT>
                    [!ENDIF!][!//
                  </CALL-POINTS>
                  <IMPLEMENTED-ENTRY-REF DEST="BSW-MODULE-ENTRY">/Pwm_TI_AM261x/Pwm_ModuleEntry/Pwm_DeInit</IMPLEMENTED-ENTRY-REF>
                </BSW-CALLED-ENTITY>
                [!ENDIF!][!//
                [!IF "as:modconf('Pwm')[1]/PwmGeneral/PwmNotificationSupported = 'true'"!][!//
                <BSW-CALLED-ENTITY UUID="bb0a1c3b-4f62-414f-802a-dc55a91dc4d9">
                  <SHORT-NAME>Pwm_DisableNotification</SHORT-NAME>
                  <CAN-ENTER-EXCLUSIVE-AREA-REFS>
                    <CAN-ENTER-EXCLUSIVE-AREA-REF DEST="EXCLUSIVE-AREA">/Pwm_TI_AM261x/Pwm/Pwm_Behavior/PWM_EXCLUSIVE_AREA_0</CAN-ENTER-EXCLUSIVE-AREA-REF>
                  </CAN-ENTER-EXCLUSIVE-AREA-REFS>
                  <MINIMUM-START-INTERVAL>0.0</MINIMUM-START-INTERVAL>
                  <REENTRANCY-LEVEL>SINGLE-CORE-REENTRANT</REENTRANCY-LEVEL>
                  <CALL-POINTS>
                    [!IF "as:modconf('Pwm')[1]/PwmGeneral/PwmDevErrorDetect = 'true'"!][!//
                    <BSW-DIRECT-CALL-POINT>
                      <SHORT-NAME>Det_ReportError</SHORT-NAME>
                      <CALLED-ENTRY-REF DEST="BSW-MODULE-ENTRY">/AUTOSAR_Det/BSWModuleEntry/Det_ReportError</CALLED-ENTRY-REF>
                    </BSW-DIRECT-CALL-POINT>
                    [!ENDIF!][!//
                  </CALL-POINTS>
                  <IMPLEMENTED-ENTRY-REF DEST="BSW-MODULE-ENTRY">/Pwm_TI_AM261x/Pwm_ModuleEntry/Pwm_DisableNotification</IMPLEMENTED-ENTRY-REF>
                </BSW-CALLED-ENTITY>
                [!ENDIF!][!//
                [!IF "as:modconf('Pwm')[1]/PwmGeneral/PwmNotificationSupported = 'true'"!][!//
                <BSW-CALLED-ENTITY UUID="1604a95b-5f19-4931-9f2c-e591a5a5bb21">
                  <SHORT-NAME>Pwm_EnableNotification</SHORT-NAME>
                  <CAN-ENTER-EXCLUSIVE-AREA-REFS>
                    <CAN-ENTER-EXCLUSIVE-AREA-REF DEST="EXCLUSIVE-AREA">/Pwm_TI_AM261x/Pwm/Pwm_Behavior/PWM_EXCLUSIVE_AREA_0</CAN-ENTER-EXCLUSIVE-AREA-REF>
                  </CAN-ENTER-EXCLUSIVE-AREA-REFS>
                  <MINIMUM-START-INTERVAL>0.0</MINIMUM-START-INTERVAL>
                  <REENTRANCY-LEVEL>SINGLE-CORE-REENTRANT</REENTRANCY-LEVEL>
                  <CALL-POINTS>
                    [!IF "as:modconf('Pwm')[1]/PwmGeneral/PwmDevErrorDetect = 'true'"!][!//
                    <BSW-DIRECT-CALL-POINT>
                      <SHORT-NAME>Det_ReportError</SHORT-NAME>
                      <CALLED-ENTRY-REF DEST="BSW-MODULE-ENTRY">/AUTOSAR_Det/BSWModuleEntry/Det_ReportError</CALLED-ENTRY-REF>
                    </BSW-DIRECT-CALL-POINT>
                    [!ENDIF!][!//
                  </CALL-POINTS>
                  <IMPLEMENTED-ENTRY-REF DEST="BSW-MODULE-ENTRY">/Pwm_TI_AM261x/Pwm_ModuleEntry/Pwm_EnableNotification</IMPLEMENTED-ENTRY-REF>
                </BSW-CALLED-ENTITY>
                [!ENDIF!][!//
                [!IF "as:modconf('Pwm')[1]/PwmConfigurationOfOptApiServices/PwmGetOutputState = 'true'"!][!//
                <BSW-CALLED-ENTITY UUID="b41ff77a-b500-4861-a0e4-ed4bce1f1d17">
                  <SHORT-NAME>Pwm_GetOutputState</SHORT-NAME>
                  <MINIMUM-START-INTERVAL>0.0</MINIMUM-START-INTERVAL>
                  <REENTRANCY-LEVEL>NON-REENTRANT</REENTRANCY-LEVEL>
                  <IMPLEMENTED-ENTRY-REF DEST="BSW-MODULE-ENTRY">/Pwm_TI_AM261x/Pwm_ModuleEntry/Pwm_GetOutputState</IMPLEMENTED-ENTRY-REF>
                </BSW-CALLED-ENTITY>
                [!ENDIF!][!//
                [!IF "as:modconf('Pwm')[1]/PwmConfigurationOfOptApiServices/PwmVersionInfoApi = 'true'"!][!//
                <BSW-CALLED-ENTITY UUID="fa050e85-f71d-4836-b4c7-5b6fabf04410">
                  <SHORT-NAME>Pwm_GetVersionInfo</SHORT-NAME>
                  <MINIMUM-START-INTERVAL>0.0</MINIMUM-START-INTERVAL>
                  <REENTRANCY-LEVEL>SINGLE-CORE-REENTRANT</REENTRANCY-LEVEL>
                  <CALL-POINTS>
                    [!IF "as:modconf('Pwm')[1]/PwmGeneral/PwmDevErrorDetect = 'true'"!][!//
                    <BSW-DIRECT-CALL-POINT>
                      <SHORT-NAME>Det_ReportError</SHORT-NAME>
                      <CALLED-ENTRY-REF DEST="BSW-MODULE-ENTRY">/AUTOSAR_Det/BSWModuleEntry/Det_ReportError</CALLED-ENTRY-REF>
                    </BSW-DIRECT-CALL-POINT>
                    [!ENDIF!][!//
                  </CALL-POINTS>
                  <IMPLEMENTED-ENTRY-REF DEST="BSW-MODULE-ENTRY">/Pwm_TI_AM261x/Pwm_ModuleEntry/Pwm_GetVersionInfo</IMPLEMENTED-ENTRY-REF>
                </BSW-CALLED-ENTITY>
                [!ENDIF!][!//
                <BSW-CALLED-ENTITY UUID="42526311-e4d8-43e7-83f5-582fe8619ae4">
                  <SHORT-NAME>Pwm_Init</SHORT-NAME>
                  <MINIMUM-START-INTERVAL>0.0</MINIMUM-START-INTERVAL>
                  <REENTRANCY-LEVEL>NON-REENTRANT</REENTRANCY-LEVEL>
                  <CALL-POINTS>
                    [!IF "as:modconf('Pwm')[1]/PwmGeneral/PwmDevErrorDetect = 'true'"!][!//
                    <BSW-DIRECT-CALL-POINT>
                      <SHORT-NAME>Det_ReportError</SHORT-NAME>
                      <CALLED-ENTRY-REF DEST="BSW-MODULE-ENTRY">/AUTOSAR_Det/BSWModuleEntry/Det_ReportError</CALLED-ENTRY-REF>
                    </BSW-DIRECT-CALL-POINT>
                    [!ENDIF!][!//
                  </CALL-POINTS>
                  <IMPLEMENTED-ENTRY-REF DEST="BSW-MODULE-ENTRY">/Pwm_TI_AM261x/Pwm_ModuleEntry/Pwm_Init</IMPLEMENTED-ENTRY-REF>
                </BSW-CALLED-ENTITY>
                [!IF "as:modconf('Pwm')[1]/PwmConfigurationOfOptApiServices/PwmEnableRegisterReadbackApi = 'true'"!][!//
                <BSW-CALLED-ENTITY UUID="3dfc0aa5-b8d7-4ef7-bf7c-d168a2289457">
                  <SHORT-NAME>Pwm_RegisterReadback</SHORT-NAME>
                  <MINIMUM-START-INTERVAL>0.0</MINIMUM-START-INTERVAL>
                  <REENTRANCY-LEVEL>SINGLE-CORE-REENTRANT</REENTRANCY-LEVEL>
                  <CALL-POINTS>
                    [!IF "as:modconf('Pwm')[1]/PwmGeneral/PwmDevErrorDetect = 'true'"!][!//
                    <BSW-DIRECT-CALL-POINT>
                      <SHORT-NAME>Det_ReportError</SHORT-NAME>
                      <CALLED-ENTRY-REF DEST="BSW-MODULE-ENTRY">/AUTOSAR_Det/BSWModuleEntry/Det_ReportError</CALLED-ENTRY-REF>
                    </BSW-DIRECT-CALL-POINT>
                    [!ENDIF!][!//
                  </CALL-POINTS>
                  <IMPLEMENTED-ENTRY-REF DEST="BSW-MODULE-ENTRY">/Pwm_TI_AM261x/Pwm_ModuleEntry/Pwm_RegisterReadback</IMPLEMENTED-ENTRY-REF>
                </BSW-CALLED-ENTITY>
                [!ENDIF!][!//
                [!IF "as:modconf('Pwm')[1]/PwmConfigurationOfOptApiServices/PwmSetDutyCycle = 'true'"!][!//
                <BSW-CALLED-ENTITY UUID="25af2770-4e48-4c69-83d3-0c9722d1d317">
                  <SHORT-NAME>Pwm_SetDutyCycle</SHORT-NAME>
                  <CAN-ENTER-EXCLUSIVE-AREA-REFS>
                    <CAN-ENTER-EXCLUSIVE-AREA-REF DEST="EXCLUSIVE-AREA">/Pwm_TI_AM261x/Pwm/Pwm_Behavior/PWM_EXCLUSIVE_AREA_0</CAN-ENTER-EXCLUSIVE-AREA-REF>
                  </CAN-ENTER-EXCLUSIVE-AREA-REFS>
                  <MINIMUM-START-INTERVAL>0.0</MINIMUM-START-INTERVAL>
                  <REENTRANCY-LEVEL>SINGLE-CORE-REENTRANT</REENTRANCY-LEVEL>
                  <IMPLEMENTED-ENTRY-REF DEST="BSW-MODULE-ENTRY">/Pwm_TI_AM261x/Pwm_ModuleEntry/Pwm_SetDutyCycle</IMPLEMENTED-ENTRY-REF>
                </BSW-CALLED-ENTITY>
                [!ENDIF!][!//
                [!IF "as:modconf('Pwm')[1]/PwmConfigurationOfOptApiServices/PwmSetOutputToIdle = 'true'"!][!//
                <BSW-CALLED-ENTITY UUID="240ddd05-fe4b-478c-adbe-ffa8c43c254f">
                  <SHORT-NAME>Pwm_SetOutputToIdle</SHORT-NAME>
                  <CAN-ENTER-EXCLUSIVE-AREA-REFS>
                    <CAN-ENTER-EXCLUSIVE-AREA-REF DEST="EXCLUSIVE-AREA">/Pwm_TI_AM261x/Pwm/Pwm_Behavior/PWM_EXCLUSIVE_AREA_0</CAN-ENTER-EXCLUSIVE-AREA-REF>
                  </CAN-ENTER-EXCLUSIVE-AREA-REFS>
                  <MINIMUM-START-INTERVAL>0.0</MINIMUM-START-INTERVAL>
                  <REENTRANCY-LEVEL>SINGLE-CORE-REENTRANT</REENTRANCY-LEVEL>
                  <CALL-POINTS>
                    [!IF "as:modconf('Pwm')[1]/PwmGeneral/PwmDevErrorDetect = 'true'"!][!//
                    <BSW-DIRECT-CALL-POINT>
                      <SHORT-NAME>Det_ReportError</SHORT-NAME>
                      <CALLED-ENTRY-REF DEST="BSW-MODULE-ENTRY">/AUTOSAR_Det/BSWModuleEntry/Det_ReportError</CALLED-ENTRY-REF>
                    </BSW-DIRECT-CALL-POINT>
                    [!ENDIF!][!//
                  </CALL-POINTS>
                  <IMPLEMENTED-ENTRY-REF DEST="BSW-MODULE-ENTRY">/Pwm_TI_AM261x/Pwm_ModuleEntry/Pwm_SetOutputToIdle</IMPLEMENTED-ENTRY-REF>
                </BSW-CALLED-ENTITY>
                [!ENDIF!][!//
                [!IF "as:modconf('Pwm')[1]/PwmConfigurationOfOptApiServices/PwmSetPeriodAndDuty = 'true'"!][!//
                <BSW-CALLED-ENTITY UUID="35dac5a9-edfc-43ef-970c-b31a587d9b6b">
                  <SHORT-NAME>Pwm_SetPeriodAndDuty</SHORT-NAME>
                  <CAN-ENTER-EXCLUSIVE-AREA-REFS>
                    <CAN-ENTER-EXCLUSIVE-AREA-REF DEST="EXCLUSIVE-AREA">/Pwm_TI_AM261x/Pwm/Pwm_Behavior/PWM_EXCLUSIVE_AREA_0</CAN-ENTER-EXCLUSIVE-AREA-REF>
                  </CAN-ENTER-EXCLUSIVE-AREA-REFS>
                  <MINIMUM-START-INTERVAL>0.0</MINIMUM-START-INTERVAL>
                  <REENTRANCY-LEVEL>SINGLE-CORE-REENTRANT</REENTRANCY-LEVEL>
                  <CALL-POINTS>
                    [!IF "as:modconf('Pwm')[1]/PwmGeneral/PwmDevErrorDetect = 'true'"!][!//
                    <BSW-DIRECT-CALL-POINT>
                      <SHORT-NAME>Det_ReportError</SHORT-NAME>
                      <CALLED-ENTRY-REF DEST="BSW-MODULE-ENTRY">/AUTOSAR_Det/BSWModuleEntry/Det_ReportError</CALLED-ENTRY-REF>
                    </BSW-DIRECT-CALL-POINT>
                    [!ENDIF!][!//
                  </CALL-POINTS>
                  <IMPLEMENTED-ENTRY-REF DEST="BSW-MODULE-ENTRY">/Pwm_TI_AM261x/Pwm_ModuleEntry/Pwm_SetPeriodAndDuty</IMPLEMENTED-ENTRY-REF>
                </BSW-CALLED-ENTITY>
                [!ENDIF!][!//
              </ENTITYS>
            </BSW-INTERNAL-BEHAVIOR>
          </INTERNAL-BEHAVIORS>
        </BSW-MODULE-DESCRIPTION>
        <BSW-IMPLEMENTATION UUID="47b6e6c5-163d-43bf-8ef4-bd195e008af7">
          <SHORT-NAME>Pwm_Impl</SHORT-NAME>
          <CODE-DESCRIPTORS>
            <CODE UUID="f88b9383-975f-412d-bce2-272fa3b5f335">
              <SHORT-NAME>Files</SHORT-NAME>
              <ARTIFACT-DESCRIPTORS>
                <AUTOSAR-ENGINEERING-OBJECT>
                  <SHORT-LABEL>V0::Pwm_Irq.c</SHORT-LABEL>
                  <CATEGORY>SWSRC</CATEGORY>
                </AUTOSAR-ENGINEERING-OBJECT>
                <AUTOSAR-ENGINEERING-OBJECT>
                  <SHORT-LABEL>V0::Pwm_Irq.h</SHORT-LABEL>
                  <CATEGORY>SWHDR</CATEGORY>
                </AUTOSAR-ENGINEERING-OBJECT>
                <AUTOSAR-ENGINEERING-OBJECT>
                  <SHORT-LABEL>V0::Pwm_Priv.c</SHORT-LABEL>
                  <CATEGORY>SWSRC</CATEGORY>
                </AUTOSAR-ENGINEERING-OBJECT>
                <AUTOSAR-ENGINEERING-OBJECT>
                  <SHORT-LABEL>V0::Pwm_Priv.h</SHORT-LABEL>
                  <CATEGORY>SWHDR</CATEGORY>
                </AUTOSAR-ENGINEERING-OBJECT>
                <AUTOSAR-ENGINEERING-OBJECT>
                  <SHORT-LABEL>V0::Pwm_Sfo.c</SHORT-LABEL>
                  <CATEGORY>SWSRC</CATEGORY>
                </AUTOSAR-ENGINEERING-OBJECT>
                <AUTOSAR-ENGINEERING-OBJECT>
                  <SHORT-LABEL>V0::Pwm_Sfo.h</SHORT-LABEL>
                  <CATEGORY>SWHDR</CATEGORY>
                </AUTOSAR-ENGINEERING-OBJECT>
                <AUTOSAR-ENGINEERING-OBJECT>
                  <SHORT-LABEL>generate::include::Pwm_Cfg.h</SHORT-LABEL>
                  <CATEGORY>SWHDR</CATEGORY>
                </AUTOSAR-ENGINEERING-OBJECT>
                <AUTOSAR-ENGINEERING-OBJECT>
                  <SHORT-LABEL>generate::src::Pwm_Cfg.c</SHORT-LABEL>
                  <CATEGORY>SWSRC</CATEGORY>
                </AUTOSAR-ENGINEERING-OBJECT>
                <AUTOSAR-ENGINEERING-OBJECT>
                  <SHORT-LABEL>generate::src::Pwm_PBcfg.c</SHORT-LABEL>
                  <CATEGORY>SWSRC</CATEGORY>
                </AUTOSAR-ENGINEERING-OBJECT>
                <AUTOSAR-ENGINEERING-OBJECT>
                  <SHORT-LABEL>include::Pwm.h</SHORT-LABEL>
                  <CATEGORY>SWHDR</CATEGORY>
                </AUTOSAR-ENGINEERING-OBJECT>
                <AUTOSAR-ENGINEERING-OBJECT>
                  <SHORT-LABEL>src::Pwm.c</SHORT-LABEL>
                  <CATEGORY>SWSRC</CATEGORY>
                </AUTOSAR-ENGINEERING-OBJECT>
              </ARTIFACT-DESCRIPTORS>
            </CODE>
          </CODE-DESCRIPTORS>
          <COMPILERS>
            <COMPILER UUID="f5284677-0f1d-4394-867e-f2ca293ad284">
              <SHORT-NAME>tiarmclang</SHORT-NAME>
              <NAME>TI ARM Clang</NAME>
              <OPTIONS>-mcpu=cortex-r5  -mfpu=vfpv3-d16  -mfloat-abi=hard  -c  -mlittle-endian  -ffunction-sections  -gdwarf-3  -Werror -Os  -x  -save-temps  -mthumb   -DAM261X_PLATFORM </OPTIONS>
              <VENDOR>Texas Instruments</VENDOR>
              <VERSION>4.0.0</VERSION>
            </COMPILER>
          </COMPILERS>
          <LINKERS>
            <LINKER UUID="ca019926-b7a6-499e-be37-4615fdd0dddc">
              <SHORT-NAME>tiarmlnk</SHORT-NAME>
              <NAME>TI ARM Clang Linker</NAME>
              <OPTIONS>-mcpu=cortex-r5  -Wl,--ram_model  -Wl,--reread_libs  -Wl,--warn_sections  -qq -Wl,--emit_warnings_as_errors --diag_suppress=10068 --diag_suppress=10063 </OPTIONS>
              <VENDOR>Texas Instruments</VENDOR>
              <VERSION>4.0.0</VERSION>
            </LINKER>
          </LINKERS>
          <PROGRAMMING-LANGUAGE>C</PROGRAMMING-LANGUAGE>
          <RESOURCE-CONSUMPTION UUID="a53c868a-5ee2-49bd-80a7-207d623f9864">
            <SHORT-NAME>ResourceConsumption</SHORT-NAME>
            <MEMORY-SECTIONS>
              <MEMORY-SECTION UUID="7c33b5f9-d314-45ca-8376-3d90751d9449">
                <SHORT-NAME>PWM_CODE</SHORT-NAME>
                <ALIGNMENT>UNSPECIFIED</ALIGNMENT>
                <SW-ADDRMETHOD-REF DEST="SW-ADDR-METHOD">/AUTOSAR_MemMap/SwAddrMethods/CODE</SW-ADDRMETHOD-REF>
                <SYMBOL>CODE</SYMBOL>
              </MEMORY-SECTION>
              <MEMORY-SECTION UUID="f3e0455f-617b-4d98-990a-29761e661cb6">
                <SHORT-NAME>PWM_CONFIG_DATA</SHORT-NAME>
                <ALIGNMENT>UNSPECIFIED</ALIGNMENT>
                <SW-ADDRMETHOD-REF DEST="SW-ADDR-METHOD">/AUTOSAR_MemMap/SwAddrMethods/CONFIG_DATA</SW-ADDRMETHOD-REF>
                <SYMBOL>CONFIG_DATA</SYMBOL>
              </MEMORY-SECTION>
              <MEMORY-SECTION UUID="2e3f49c5-9c77-4f78-80c6-a5a5283cf24f">
                <SHORT-NAME>PWM_ISR_CODE</SHORT-NAME>
                <ALIGNMENT>UNSPECIFIED</ALIGNMENT>
                <SW-ADDRMETHOD-REF DEST="SW-ADDR-METHOD">/AUTOSAR_MemMap/SwAddrMethods/CODE</SW-ADDRMETHOD-REF>
                <SYMBOL>ISR_CODE</SYMBOL>
              </MEMORY-SECTION>
              <MEMORY-SECTION UUID="0f9eff5a-245d-4d91-83a2-c2869664d3cb">
                <SHORT-NAME>PWM_VAR_INIT_32</SHORT-NAME>
                <ALIGNMENT>32</ALIGNMENT>
                <SW-ADDRMETHOD-REF DEST="SW-ADDR-METHOD">/AUTOSAR_MemMap/SwAddrMethods/VAR_INIT</SW-ADDRMETHOD-REF>
                <SYMBOL>VAR_INIT_32</SYMBOL>
              </MEMORY-SECTION>
              <MEMORY-SECTION UUID="acb1525c-acf1-42bd-b242-aa9b04cbb8b0">
                <SHORT-NAME>PWM_VAR_INIT_8</SHORT-NAME>
                <ALIGNMENT>8</ALIGNMENT>
                <SW-ADDRMETHOD-REF DEST="SW-ADDR-METHOD">/AUTOSAR_MemMap/SwAddrMethods/VAR_INIT</SW-ADDRMETHOD-REF>
                <SYMBOL>VAR_INIT_8</SYMBOL>
              </MEMORY-SECTION>
              <MEMORY-SECTION UUID="13039ea3-837c-4f39-8115-b780e4bd4317">
                <SHORT-NAME>PWM_VAR_NO_INIT_32</SHORT-NAME>
                <ALIGNMENT>32</ALIGNMENT>
                <SW-ADDRMETHOD-REF DEST="SW-ADDR-METHOD">/AUTOSAR_MemMap/SwAddrMethods/VAR_NO_INIT</SW-ADDRMETHOD-REF>
                <SYMBOL>VAR_NO_INIT_32</SYMBOL>
              </MEMORY-SECTION>
              <MEMORY-SECTION UUID="9b0c64b6-1e53-4980-9be5-76804fa06044">
                <SHORT-NAME>PWM_VAR_NO_INIT_UNSPECIFIED</SHORT-NAME>
                <ALIGNMENT>UNSPECIFIED</ALIGNMENT>
                <SW-ADDRMETHOD-REF DEST="SW-ADDR-METHOD">/AUTOSAR_MemMap/SwAddrMethods/VAR_NO_INIT</SW-ADDRMETHOD-REF>
                <SYMBOL>VAR_NO_INIT_UNSPECIFIED</SYMBOL>
              </MEMORY-SECTION>
            </MEMORY-SECTIONS>
          </RESOURCE-CONSUMPTION>
          <SW-VERSION>10.01.00</SW-VERSION>
          <VENDOR-ID>44</VENDOR-ID>
          <AR-RELEASE-VERSION>4.3.1</AR-RELEASE-VERSION>
          <BEHAVIOR-REF DEST="BSW-INTERNAL-BEHAVIOR">/Pwm_TI_AM261x/Pwm/Pwm_Behavior</BEHAVIOR-REF>
          <VENDOR-SPECIFIC-MODULE-DEF-REFS>
            <VENDOR-SPECIFIC-MODULE-DEF-REF DEST="ECUC-MODULE-DEF">/TI_AM261x/Pwm</VENDOR-SPECIFIC-MODULE-DEF-REF>
          </VENDOR-SPECIFIC-MODULE-DEF-REFS>
        </BSW-IMPLEMENTATION>
      </ELEMENTS>
      <AR-PACKAGES>
        <AR-PACKAGE UUID="702bad5a-4a69-4ee3-a45f-eacecc0cdb3b">
          <SHORT-NAME>Pwm_ModuleEntry</SHORT-NAME>
          <ELEMENTS>
            <BSW-MODULE-ENTRY UUID="4135ef4f-a356-45bd-8a39-8c540ec8cfa6">
              <SHORT-NAME>Pwm_Ch0Isr</SHORT-NAME>
              <IS-REENTRANT>false</IS-REENTRANT>
              <IS-SYNCHRONOUS>true</IS-SYNCHRONOUS>
              <CALL-TYPE>INTERRUPT</CALL-TYPE>
              [!IF "as:modconf('Pwm')[1]/PwmGeneral/PwmTypeofInterruptFunction = 'PWM_ISR_CAT2'"!][!//
              <EXECUTION-CONTEXT>INTERRUPT-CAT-2</EXECUTION-CONTEXT>
              [!ELSE!][!//
              <EXECUTION-CONTEXT>INTERRUPT-CAT-1</EXECUTION-CONTEXT>
              [!ENDIF!][!//
              <SW-SERVICE-IMPL-POLICY>STANDARD</SW-SERVICE-IMPL-POLICY>
              <BSW-ENTRY-KIND>CONCRETE</BSW-ENTRY-KIND>
            </BSW-MODULE-ENTRY>
            <BSW-MODULE-ENTRY UUID="c0945af3-ab2c-4ff7-83d0-54377b78613e">
              <SHORT-NAME>Pwm_Ch10Isr</SHORT-NAME>
              <IS-REENTRANT>false</IS-REENTRANT>
              <IS-SYNCHRONOUS>true</IS-SYNCHRONOUS>
              <CALL-TYPE>INTERRUPT</CALL-TYPE>
              [!IF "as:modconf('Pwm')[1]/PwmGeneral/PwmTypeofInterruptFunction = 'PWM_ISR_CAT2'"!][!//
              <EXECUTION-CONTEXT>INTERRUPT-CAT-2</EXECUTION-CONTEXT>
              [!ELSE!][!//
              <EXECUTION-CONTEXT>INTERRUPT-CAT-1</EXECUTION-CONTEXT>
              [!ENDIF!][!//
              <SW-SERVICE-IMPL-POLICY>STANDARD</SW-SERVICE-IMPL-POLICY>
              <BSW-ENTRY-KIND>CONCRETE</BSW-ENTRY-KIND>
            </BSW-MODULE-ENTRY>
            <BSW-MODULE-ENTRY UUID="10027e2a-7e80-40f5-ad85-e8c94ddcdc57">
              <SHORT-NAME>Pwm_Ch11Isr</SHORT-NAME>
              <IS-REENTRANT>false</IS-REENTRANT>
              <IS-SYNCHRONOUS>true</IS-SYNCHRONOUS>
              <CALL-TYPE>INTERRUPT</CALL-TYPE>
              [!IF "as:modconf('Pwm')[1]/PwmGeneral/PwmTypeofInterruptFunction = 'PWM_ISR_CAT2'"!][!//
              <EXECUTION-CONTEXT>INTERRUPT-CAT-2</EXECUTION-CONTEXT>
              [!ELSE!][!//
              <EXECUTION-CONTEXT>INTERRUPT-CAT-1</EXECUTION-CONTEXT>
              [!ENDIF!][!//
              <SW-SERVICE-IMPL-POLICY>STANDARD</SW-SERVICE-IMPL-POLICY>
              <BSW-ENTRY-KIND>CONCRETE</BSW-ENTRY-KIND>
            </BSW-MODULE-ENTRY>
            <BSW-MODULE-ENTRY UUID="c3180176-860a-431e-8902-aa1454b62973">
              <SHORT-NAME>Pwm_Ch12Isr</SHORT-NAME>
              <IS-REENTRANT>false</IS-REENTRANT>
              <IS-SYNCHRONOUS>true</IS-SYNCHRONOUS>
              <CALL-TYPE>INTERRUPT</CALL-TYPE>
              [!IF "as:modconf('Pwm')[1]/PwmGeneral/PwmTypeofInterruptFunction = 'PWM_ISR_CAT2'"!][!//
              <EXECUTION-CONTEXT>INTERRUPT-CAT-2</EXECUTION-CONTEXT>
              [!ELSE!][!//
              <EXECUTION-CONTEXT>INTERRUPT-CAT-1</EXECUTION-CONTEXT>
              [!ENDIF!][!//
              <SW-SERVICE-IMPL-POLICY>STANDARD</SW-SERVICE-IMPL-POLICY>
              <BSW-ENTRY-KIND>CONCRETE</BSW-ENTRY-KIND>
            </BSW-MODULE-ENTRY>
            <BSW-MODULE-ENTRY UUID="1c8b661f-61e3-4eef-8448-ef188117971e">
              <SHORT-NAME>Pwm_Ch13Isr</SHORT-NAME>
              <IS-REENTRANT>false</IS-REENTRANT>
              <IS-SYNCHRONOUS>true</IS-SYNCHRONOUS>
              <CALL-TYPE>INTERRUPT</CALL-TYPE>
              [!IF "as:modconf('Pwm')[1]/PwmGeneral/PwmTypeofInterruptFunction = 'PWM_ISR_CAT2'"!][!//
              <EXECUTION-CONTEXT>INTERRUPT-CAT-2</EXECUTION-CONTEXT>
              [!ELSE!][!//
              <EXECUTION-CONTEXT>INTERRUPT-CAT-1</EXECUTION-CONTEXT>
              [!ENDIF!][!//
              <SW-SERVICE-IMPL-POLICY>STANDARD</SW-SERVICE-IMPL-POLICY>
              <BSW-ENTRY-KIND>CONCRETE</BSW-ENTRY-KIND>
            </BSW-MODULE-ENTRY>
            <BSW-MODULE-ENTRY UUID="b080fe41-1348-48ae-9ea9-538de0887fca">
              <SHORT-NAME>Pwm_Ch14Isr</SHORT-NAME>
              <IS-REENTRANT>false</IS-REENTRANT>
              <IS-SYNCHRONOUS>true</IS-SYNCHRONOUS>
              <CALL-TYPE>INTERRUPT</CALL-TYPE>
              [!IF "as:modconf('Pwm')[1]/PwmGeneral/PwmTypeofInterruptFunction = 'PWM_ISR_CAT2'"!][!//
              <EXECUTION-CONTEXT>INTERRUPT-CAT-2</EXECUTION-CONTEXT>
              [!ELSE!][!//
              <EXECUTION-CONTEXT>INTERRUPT-CAT-1</EXECUTION-CONTEXT>
              [!ENDIF!][!//
              <SW-SERVICE-IMPL-POLICY>STANDARD</SW-SERVICE-IMPL-POLICY>
              <BSW-ENTRY-KIND>CONCRETE</BSW-ENTRY-KIND>
            </BSW-MODULE-ENTRY>
            <BSW-MODULE-ENTRY UUID="866eb68a-a291-4d0a-aa93-6dfb3e92582a">
              <SHORT-NAME>Pwm_Ch15Isr</SHORT-NAME>
              <IS-REENTRANT>false</IS-REENTRANT>
              <IS-SYNCHRONOUS>true</IS-SYNCHRONOUS>
              <CALL-TYPE>INTERRUPT</CALL-TYPE>
              [!IF "as:modconf('Pwm')[1]/PwmGeneral/PwmTypeofInterruptFunction = 'PWM_ISR_CAT2'"!][!//
              <EXECUTION-CONTEXT>INTERRUPT-CAT-2</EXECUTION-CONTEXT>
              [!ELSE!][!//
              <EXECUTION-CONTEXT>INTERRUPT-CAT-1</EXECUTION-CONTEXT>
              [!ENDIF!][!//
              <SW-SERVICE-IMPL-POLICY>STANDARD</SW-SERVICE-IMPL-POLICY>
              <BSW-ENTRY-KIND>CONCRETE</BSW-ENTRY-KIND>
            </BSW-MODULE-ENTRY>
            <BSW-MODULE-ENTRY UUID="18a62d57-9d3c-4127-b5e4-f5544371d047">
              <SHORT-NAME>Pwm_Ch16Isr</SHORT-NAME>
              <IS-REENTRANT>false</IS-REENTRANT>
              <IS-SYNCHRONOUS>true</IS-SYNCHRONOUS>
              <CALL-TYPE>INTERRUPT</CALL-TYPE>
              [!IF "as:modconf('Pwm')[1]/PwmGeneral/PwmTypeofInterruptFunction = 'PWM_ISR_CAT2'"!][!//
              <EXECUTION-CONTEXT>INTERRUPT-CAT-2</EXECUTION-CONTEXT>
              [!ELSE!][!//
              <EXECUTION-CONTEXT>INTERRUPT-CAT-1</EXECUTION-CONTEXT>
              [!ENDIF!][!//
              <SW-SERVICE-IMPL-POLICY>STANDARD</SW-SERVICE-IMPL-POLICY>
              <BSW-ENTRY-KIND>CONCRETE</BSW-ENTRY-KIND>
            </BSW-MODULE-ENTRY>
            <BSW-MODULE-ENTRY UUID="31c9127b-d71f-4354-aec7-527e2ab347f4">
              <SHORT-NAME>Pwm_Ch17Isr</SHORT-NAME>
              <IS-REENTRANT>false</IS-REENTRANT>
              <IS-SYNCHRONOUS>true</IS-SYNCHRONOUS>
              <CALL-TYPE>INTERRUPT</CALL-TYPE>
              [!IF "as:modconf('Pwm')[1]/PwmGeneral/PwmTypeofInterruptFunction = 'PWM_ISR_CAT2'"!][!//
              <EXECUTION-CONTEXT>INTERRUPT-CAT-2</EXECUTION-CONTEXT>
              [!ELSE!][!//
              <EXECUTION-CONTEXT>INTERRUPT-CAT-1</EXECUTION-CONTEXT>
              [!ENDIF!][!//
              <SW-SERVICE-IMPL-POLICY>STANDARD</SW-SERVICE-IMPL-POLICY>
              <BSW-ENTRY-KIND>CONCRETE</BSW-ENTRY-KIND>
            </BSW-MODULE-ENTRY>
            <BSW-MODULE-ENTRY UUID="d0fae181-2a83-4957-86d7-6aa1c2800965">
              <SHORT-NAME>Pwm_Ch18Isr</SHORT-NAME>
              <IS-REENTRANT>false</IS-REENTRANT>
              <IS-SYNCHRONOUS>true</IS-SYNCHRONOUS>
              <CALL-TYPE>INTERRUPT</CALL-TYPE>
              [!IF "as:modconf('Pwm')[1]/PwmGeneral/PwmTypeofInterruptFunction = 'PWM_ISR_CAT2'"!][!//
              <EXECUTION-CONTEXT>INTERRUPT-CAT-2</EXECUTION-CONTEXT>
              [!ELSE!][!//
              <EXECUTION-CONTEXT>INTERRUPT-CAT-1</EXECUTION-CONTEXT>
              [!ENDIF!][!//
              <SW-SERVICE-IMPL-POLICY>STANDARD</SW-SERVICE-IMPL-POLICY>
              <BSW-ENTRY-KIND>CONCRETE</BSW-ENTRY-KIND>
            </BSW-MODULE-ENTRY>
            <BSW-MODULE-ENTRY UUID="66c5b65b-93e3-4ea6-9097-b29056fa8564">
              <SHORT-NAME>Pwm_Ch19Isr</SHORT-NAME>
              <IS-REENTRANT>false</IS-REENTRANT>
              <IS-SYNCHRONOUS>true</IS-SYNCHRONOUS>
              <CALL-TYPE>INTERRUPT</CALL-TYPE>
              [!IF "as:modconf('Pwm')[1]/PwmGeneral/PwmTypeofInterruptFunction = 'PWM_ISR_CAT2'"!][!//
              <EXECUTION-CONTEXT>INTERRUPT-CAT-2</EXECUTION-CONTEXT>
              [!ELSE!][!//
              <EXECUTION-CONTEXT>INTERRUPT-CAT-1</EXECUTION-CONTEXT>
              [!ENDIF!][!//
              <SW-SERVICE-IMPL-POLICY>STANDARD</SW-SERVICE-IMPL-POLICY>
              <BSW-ENTRY-KIND>CONCRETE</BSW-ENTRY-KIND>
            </BSW-MODULE-ENTRY>
            <BSW-MODULE-ENTRY UUID="ac384057-6bbb-4fdb-985c-144bbf17ce08">
              <SHORT-NAME>Pwm_Ch1Isr</SHORT-NAME>
              <IS-REENTRANT>false</IS-REENTRANT>
              <IS-SYNCHRONOUS>true</IS-SYNCHRONOUS>
              <CALL-TYPE>INTERRUPT</CALL-TYPE>
              [!IF "as:modconf('Pwm')[1]/PwmGeneral/PwmTypeofInterruptFunction = 'PWM_ISR_CAT2'"!][!//
              <EXECUTION-CONTEXT>INTERRUPT-CAT-2</EXECUTION-CONTEXT>
              [!ELSE!][!//
              <EXECUTION-CONTEXT>INTERRUPT-CAT-1</EXECUTION-CONTEXT>
              [!ENDIF!][!//
              <SW-SERVICE-IMPL-POLICY>STANDARD</SW-SERVICE-IMPL-POLICY>
              <BSW-ENTRY-KIND>CONCRETE</BSW-ENTRY-KIND>
            </BSW-MODULE-ENTRY>
            <BSW-MODULE-ENTRY UUID="3e924fb7-f485-4897-a830-ea0c3022f5b2">
              <SHORT-NAME>Pwm_Ch2Isr</SHORT-NAME>
              <IS-REENTRANT>false</IS-REENTRANT>
              <IS-SYNCHRONOUS>true</IS-SYNCHRONOUS>
              <CALL-TYPE>INTERRUPT</CALL-TYPE>
              [!IF "as:modconf('Pwm')[1]/PwmGeneral/PwmTypeofInterruptFunction = 'PWM_ISR_CAT2'"!][!//
              <EXECUTION-CONTEXT>INTERRUPT-CAT-2</EXECUTION-CONTEXT>
              [!ELSE!][!//
              <EXECUTION-CONTEXT>INTERRUPT-CAT-1</EXECUTION-CONTEXT>
              [!ENDIF!][!//
              <SW-SERVICE-IMPL-POLICY>STANDARD</SW-SERVICE-IMPL-POLICY>
              <BSW-ENTRY-KIND>CONCRETE</BSW-ENTRY-KIND>
            </BSW-MODULE-ENTRY>
            <BSW-MODULE-ENTRY UUID="258aac4a-777a-4205-a453-50fb6f672137">
              <SHORT-NAME>Pwm_Ch3Isr</SHORT-NAME>
              <IS-REENTRANT>false</IS-REENTRANT>
              <IS-SYNCHRONOUS>true</IS-SYNCHRONOUS>
              <CALL-TYPE>INTERRUPT</CALL-TYPE>
              [!IF "as:modconf('Pwm')[1]/PwmGeneral/PwmTypeofInterruptFunction = 'PWM_ISR_CAT2'"!][!//
              <EXECUTION-CONTEXT>INTERRUPT-CAT-2</EXECUTION-CONTEXT>
              [!ELSE!][!//
              <EXECUTION-CONTEXT>INTERRUPT-CAT-1</EXECUTION-CONTEXT>
              [!ENDIF!][!//
              <SW-SERVICE-IMPL-POLICY>STANDARD</SW-SERVICE-IMPL-POLICY>
              <BSW-ENTRY-KIND>CONCRETE</BSW-ENTRY-KIND>
            </BSW-MODULE-ENTRY>
            <BSW-MODULE-ENTRY UUID="fd8aa9f9-17c3-482c-9d53-b09b01639a8f">
              <SHORT-NAME>Pwm_Ch4Isr</SHORT-NAME>
              <IS-REENTRANT>false</IS-REENTRANT>
              <IS-SYNCHRONOUS>true</IS-SYNCHRONOUS>
              <CALL-TYPE>INTERRUPT</CALL-TYPE>
              [!IF "as:modconf('Pwm')[1]/PwmGeneral/PwmTypeofInterruptFunction = 'PWM_ISR_CAT2'"!][!//
              <EXECUTION-CONTEXT>INTERRUPT-CAT-2</EXECUTION-CONTEXT>
              [!ELSE!][!//
              <EXECUTION-CONTEXT>INTERRUPT-CAT-1</EXECUTION-CONTEXT>
              [!ENDIF!][!//
              <SW-SERVICE-IMPL-POLICY>STANDARD</SW-SERVICE-IMPL-POLICY>
              <BSW-ENTRY-KIND>CONCRETE</BSW-ENTRY-KIND>
            </BSW-MODULE-ENTRY>
            <BSW-MODULE-ENTRY UUID="6bb4645a-7528-4287-8e82-aca16ac819c3">
              <SHORT-NAME>Pwm_Ch5Isr</SHORT-NAME>
              <IS-REENTRANT>false</IS-REENTRANT>
              <IS-SYNCHRONOUS>true</IS-SYNCHRONOUS>
              <CALL-TYPE>INTERRUPT</CALL-TYPE>
              [!IF "as:modconf('Pwm')[1]/PwmGeneral/PwmTypeofInterruptFunction = 'PWM_ISR_CAT2'"!][!//
              <EXECUTION-CONTEXT>INTERRUPT-CAT-2</EXECUTION-CONTEXT>
              [!ELSE!][!//
              <EXECUTION-CONTEXT>INTERRUPT-CAT-1</EXECUTION-CONTEXT>
              [!ENDIF!][!//
              <SW-SERVICE-IMPL-POLICY>STANDARD</SW-SERVICE-IMPL-POLICY>
              <BSW-ENTRY-KIND>CONCRETE</BSW-ENTRY-KIND>
            </BSW-MODULE-ENTRY>
            <BSW-MODULE-ENTRY UUID="01b193c0-0955-48ba-b2a0-8b26b2130e51">
              <SHORT-NAME>Pwm_Ch6Isr</SHORT-NAME>
              <IS-REENTRANT>false</IS-REENTRANT>
              <IS-SYNCHRONOUS>true</IS-SYNCHRONOUS>
              <CALL-TYPE>INTERRUPT</CALL-TYPE>
              [!IF "as:modconf('Pwm')[1]/PwmGeneral/PwmTypeofInterruptFunction = 'PWM_ISR_CAT2'"!][!//
              <EXECUTION-CONTEXT>INTERRUPT-CAT-2</EXECUTION-CONTEXT>
              [!ELSE!][!//
              <EXECUTION-CONTEXT>INTERRUPT-CAT-1</EXECUTION-CONTEXT>
              [!ENDIF!][!//
              <SW-SERVICE-IMPL-POLICY>STANDARD</SW-SERVICE-IMPL-POLICY>
              <BSW-ENTRY-KIND>CONCRETE</BSW-ENTRY-KIND>
            </BSW-MODULE-ENTRY>
            <BSW-MODULE-ENTRY UUID="e7f0c5b5-59a6-4ede-a1f5-567d7acd0756">
              <SHORT-NAME>Pwm_Ch7Isr</SHORT-NAME>
              <IS-REENTRANT>false</IS-REENTRANT>
              <IS-SYNCHRONOUS>true</IS-SYNCHRONOUS>
              <CALL-TYPE>INTERRUPT</CALL-TYPE>
              [!IF "as:modconf('Pwm')[1]/PwmGeneral/PwmTypeofInterruptFunction = 'PWM_ISR_CAT2'"!][!//
              <EXECUTION-CONTEXT>INTERRUPT-CAT-2</EXECUTION-CONTEXT>
              [!ELSE!][!//
              <EXECUTION-CONTEXT>INTERRUPT-CAT-1</EXECUTION-CONTEXT>
              [!ENDIF!][!//
              <SW-SERVICE-IMPL-POLICY>STANDARD</SW-SERVICE-IMPL-POLICY>
              <BSW-ENTRY-KIND>CONCRETE</BSW-ENTRY-KIND>
            </BSW-MODULE-ENTRY>
            <BSW-MODULE-ENTRY UUID="290c7ba9-5e6b-4b49-8ab3-655b354f7648">
              <SHORT-NAME>Pwm_Ch8Isr</SHORT-NAME>
              <IS-REENTRANT>false</IS-REENTRANT>
              <IS-SYNCHRONOUS>true</IS-SYNCHRONOUS>
              <CALL-TYPE>INTERRUPT</CALL-TYPE>
              [!IF "as:modconf('Pwm')[1]/PwmGeneral/PwmTypeofInterruptFunction = 'PWM_ISR_CAT2'"!][!//
              <EXECUTION-CONTEXT>INTERRUPT-CAT-2</EXECUTION-CONTEXT>
              [!ELSE!][!//
              <EXECUTION-CONTEXT>INTERRUPT-CAT-1</EXECUTION-CONTEXT>
              [!ENDIF!][!//
              <SW-SERVICE-IMPL-POLICY>STANDARD</SW-SERVICE-IMPL-POLICY>
              <BSW-ENTRY-KIND>CONCRETE</BSW-ENTRY-KIND>
            </BSW-MODULE-ENTRY>
            <BSW-MODULE-ENTRY UUID="0ff2262e-dff8-449d-b701-948af0003093">
              <SHORT-NAME>Pwm_Ch9Isr</SHORT-NAME>
              <IS-REENTRANT>false</IS-REENTRANT>
              <IS-SYNCHRONOUS>true</IS-SYNCHRONOUS>
              <CALL-TYPE>INTERRUPT</CALL-TYPE>
              [!IF "as:modconf('Pwm')[1]/PwmGeneral/PwmTypeofInterruptFunction = 'PWM_ISR_CAT2'"!][!//
              <EXECUTION-CONTEXT>INTERRUPT-CAT-2</EXECUTION-CONTEXT>
              [!ELSE!][!//
              <EXECUTION-CONTEXT>INTERRUPT-CAT-1</EXECUTION-CONTEXT>
              [!ENDIF!][!//
              <SW-SERVICE-IMPL-POLICY>STANDARD</SW-SERVICE-IMPL-POLICY>
              <BSW-ENTRY-KIND>CONCRETE</BSW-ENTRY-KIND>
            </BSW-MODULE-ENTRY>
            <BSW-MODULE-ENTRY UUID="20b72aee-1f25-4b7e-bbd8-434498b30967">
              <SHORT-NAME>Pwm_DeInit</SHORT-NAME>
              <SERVICE-ID>1</SERVICE-ID>
              <IS-REENTRANT>false</IS-REENTRANT>
              <IS-SYNCHRONOUS>true</IS-SYNCHRONOUS>
              <CALL-TYPE>REGULAR</CALL-TYPE>
              <EXECUTION-CONTEXT>UNSPECIFIED</EXECUTION-CONTEXT>
              <SW-SERVICE-IMPL-POLICY>STANDARD</SW-SERVICE-IMPL-POLICY>
              <BSW-ENTRY-KIND>CONCRETE</BSW-ENTRY-KIND>
            </BSW-MODULE-ENTRY>
            <BSW-MODULE-ENTRY UUID="4dc56375-51e0-4974-aeb3-9df566238f6a">
              <SHORT-NAME>Pwm_DisableNotification</SHORT-NAME>
              <SERVICE-ID>6</SERVICE-ID>
              <IS-REENTRANT>true</IS-REENTRANT>
              <IS-SYNCHRONOUS>true</IS-SYNCHRONOUS>
              <CALL-TYPE>REGULAR</CALL-TYPE>
              <EXECUTION-CONTEXT>UNSPECIFIED</EXECUTION-CONTEXT>
              <SW-SERVICE-IMPL-POLICY>STANDARD</SW-SERVICE-IMPL-POLICY>
              <BSW-ENTRY-KIND>CONCRETE</BSW-ENTRY-KIND>
            </BSW-MODULE-ENTRY>
            <BSW-MODULE-ENTRY UUID="7fc44031-f7c0-452b-b400-c0e63282d65c">
              <SHORT-NAME>Pwm_EnableNotification</SHORT-NAME>
              <SERVICE-ID>7</SERVICE-ID>
              <IS-REENTRANT>true</IS-REENTRANT>
              <IS-SYNCHRONOUS>true</IS-SYNCHRONOUS>
              <CALL-TYPE>REGULAR</CALL-TYPE>
              <EXECUTION-CONTEXT>UNSPECIFIED</EXECUTION-CONTEXT>
              <SW-SERVICE-IMPL-POLICY>STANDARD</SW-SERVICE-IMPL-POLICY>
              <BSW-ENTRY-KIND>CONCRETE</BSW-ENTRY-KIND>
            </BSW-MODULE-ENTRY>
            <BSW-MODULE-ENTRY UUID="5567d779-53b0-498d-847a-85ed48e5013b">
              <SHORT-NAME>Pwm_GetOutputState</SHORT-NAME>
              <SERVICE-ID>5</SERVICE-ID>
              <IS-REENTRANT>true</IS-REENTRANT>
              <IS-SYNCHRONOUS>true</IS-SYNCHRONOUS>
              <CALL-TYPE>REGULAR</CALL-TYPE>
              <EXECUTION-CONTEXT>UNSPECIFIED</EXECUTION-CONTEXT>
              <SW-SERVICE-IMPL-POLICY>STANDARD</SW-SERVICE-IMPL-POLICY>
              <BSW-ENTRY-KIND>CONCRETE</BSW-ENTRY-KIND>
            </BSW-MODULE-ENTRY>
            <BSW-MODULE-ENTRY UUID="70fd6bbd-fb5d-4e74-bfaa-f0f62238b72e">
              <SHORT-NAME>Pwm_GetVersionInfo</SHORT-NAME>
              <SERVICE-ID>8</SERVICE-ID>
              <IS-REENTRANT>true</IS-REENTRANT>
              <IS-SYNCHRONOUS>true</IS-SYNCHRONOUS>
              <CALL-TYPE>REGULAR</CALL-TYPE>
              <EXECUTION-CONTEXT>UNSPECIFIED</EXECUTION-CONTEXT>
              <SW-SERVICE-IMPL-POLICY>STANDARD</SW-SERVICE-IMPL-POLICY>
              <BSW-ENTRY-KIND>CONCRETE</BSW-ENTRY-KIND>
            </BSW-MODULE-ENTRY>
            <BSW-MODULE-ENTRY UUID="83c6dd95-a87b-4b9c-8e9e-770025ca9555">
              <SHORT-NAME>Pwm_Init</SHORT-NAME>
              <SERVICE-ID>0</SERVICE-ID>
              <IS-REENTRANT>false</IS-REENTRANT>
              <IS-SYNCHRONOUS>true</IS-SYNCHRONOUS>
              <CALL-TYPE>REGULAR</CALL-TYPE>
              <EXECUTION-CONTEXT>UNSPECIFIED</EXECUTION-CONTEXT>
              <SW-SERVICE-IMPL-POLICY>STANDARD</SW-SERVICE-IMPL-POLICY>
              <BSW-ENTRY-KIND>CONCRETE</BSW-ENTRY-KIND>
            </BSW-MODULE-ENTRY>
            <BSW-MODULE-ENTRY UUID="936f28f8-e85a-42ca-be00-3adbfe837227">
              <SHORT-NAME>Pwm_RegisterReadback</SHORT-NAME>
              <SERVICE-ID>7</SERVICE-ID>
              <IS-REENTRANT>true</IS-REENTRANT>
              <IS-SYNCHRONOUS>false</IS-SYNCHRONOUS>
              <CALL-TYPE>REGULAR</CALL-TYPE>
              <EXECUTION-CONTEXT>UNSPECIFIED</EXECUTION-CONTEXT>
              <SW-SERVICE-IMPL-POLICY>STANDARD</SW-SERVICE-IMPL-POLICY>
              <BSW-ENTRY-KIND>CONCRETE</BSW-ENTRY-KIND>
            </BSW-MODULE-ENTRY>
            <BSW-MODULE-ENTRY UUID="564cac9f-ab85-4437-bd80-68d00fac1961">
              <SHORT-NAME>Pwm_SetDutyCycle</SHORT-NAME>
              <SERVICE-ID>2</SERVICE-ID>
              <IS-REENTRANT>true</IS-REENTRANT>
              <IS-SYNCHRONOUS>true</IS-SYNCHRONOUS>
              <CALL-TYPE>REGULAR</CALL-TYPE>
              <EXECUTION-CONTEXT>UNSPECIFIED</EXECUTION-CONTEXT>
              <SW-SERVICE-IMPL-POLICY>STANDARD</SW-SERVICE-IMPL-POLICY>
              <BSW-ENTRY-KIND>CONCRETE</BSW-ENTRY-KIND>
            </BSW-MODULE-ENTRY>
            <BSW-MODULE-ENTRY UUID="9bf996e8-2e3e-4d7d-afc9-c622eeafa1cc">
              <SHORT-NAME>Pwm_SetOutputToIdle</SHORT-NAME>
              <SERVICE-ID>4</SERVICE-ID>
              <IS-REENTRANT>true</IS-REENTRANT>
              <IS-SYNCHRONOUS>true</IS-SYNCHRONOUS>
              <CALL-TYPE>REGULAR</CALL-TYPE>
              <EXECUTION-CONTEXT>UNSPECIFIED</EXECUTION-CONTEXT>
              <SW-SERVICE-IMPL-POLICY>STANDARD</SW-SERVICE-IMPL-POLICY>
              <BSW-ENTRY-KIND>CONCRETE</BSW-ENTRY-KIND>
            </BSW-MODULE-ENTRY>
            <BSW-MODULE-ENTRY UUID="662b666c-b533-40ec-b416-c829d6e7958c">
              <SHORT-NAME>Pwm_SetPeriodAndDuty</SHORT-NAME>
              <SERVICE-ID>3</SERVICE-ID>
              <IS-REENTRANT>true</IS-REENTRANT>
              <IS-SYNCHRONOUS>true</IS-SYNCHRONOUS>
              <CALL-TYPE>REGULAR</CALL-TYPE>
              <EXECUTION-CONTEXT>UNSPECIFIED</EXECUTION-CONTEXT>
              <SW-SERVICE-IMPL-POLICY>STANDARD</SW-SERVICE-IMPL-POLICY>
              <BSW-ENTRY-KIND>CONCRETE</BSW-ENTRY-KIND>
            </BSW-MODULE-ENTRY>
          </ELEMENTS>
        </AR-PACKAGE>
      </AR-PACKAGES>
    </AR-PACKAGE>
  </AR-PACKAGES>
</AUTOSAR>
