<?xml version="1.0" encoding="UTF-8"?>
[!AUTOSPACING!][!//
<AUTOSAR xmlns="http://autosar.org/schema/r4.0" xmlns:xsi="http://www.w3.org/2001/XMLSchema-instance" xsi:schemaLocation="http://autosar.org/schema/r4.0 AUTOSAR_00044.xsd">
  <AR-PACKAGES>
    <AR-PACKAGE UUID="f5cb086d-b648-489d-af60-0a1923f2599c">
      <SHORT-NAME>Cdd_Pwm_TI_AM261x</SHORT-NAME>
      <ELEMENTS>
        <BSW-MODULE-DESCRIPTION UUID="d1b8bf0b-124b-47a0-944b-819926a7022e">
          <SHORT-NAME>Cdd_Pwm</SHORT-NAME>
          <CATEGORY>BSW_MODULE</CATEGORY>
          <IMPLEMENTED-ENTRYS>
          [!IF "as:modconf('Cdd_Pwm')[1]/CddPwmGeneral/CddPwmChopperEnable = 'true'"!][!//
            <BSW-MODULE-ENTRY-REF-CONDITIONAL>
              <BSW-MODULE-ENTRY-REF DEST="BSW-MODULE-ENTRY">/Cdd_Pwm_TI_AM261x/Cdd_Pwm_ModuleEntry/Cdd_Pwm_ChopperCfg</BSW-MODULE-ENTRY-REF>
            </BSW-MODULE-ENTRY-REF-CONDITIONAL>
            <BSW-MODULE-ENTRY-REF-CONDITIONAL>
              <BSW-MODULE-ENTRY-REF DEST="BSW-MODULE-ENTRY">/Cdd_Pwm_TI_AM261x/Cdd_Pwm_ModuleEntry/Cdd_Pwm_ChopperEnable</BSW-MODULE-ENTRY-REF>
            </BSW-MODULE-ENTRY-REF-CONDITIONAL>
          [!ENDIF!][!//
          [!IF "as:modconf('Cdd_Pwm')[1]/CddPwmConfigurationOfOptionalApis/CddPwmGetCounterStatus"!][!//
            <BSW-MODULE-ENTRY-REF-CONDITIONAL>
              <BSW-MODULE-ENTRY-REF DEST="BSW-MODULE-ENTRY">/Cdd_Pwm_TI_AM261x/Cdd_Pwm_ModuleEntry/Cdd_Pwm_ClearCounterStatus</BSW-MODULE-ENTRY-REF>
            </BSW-MODULE-ENTRY-REF-CONDITIONAL>
          [!ENDIF!][!//
          [!IF "as:modconf('Cdd_Pwm')[1]/CddPwmConfigurationOfOptionalApis/CddPwmCounterComparatorCfg"!][!//
            <BSW-MODULE-ENTRY-REF-CONDITIONAL>
              <BSW-MODULE-ENTRY-REF DEST="BSW-MODULE-ENTRY">/Cdd_Pwm_TI_AM261x/Cdd_Pwm_ModuleEntry/Cdd_Pwm_CounterComparatorCfg</BSW-MODULE-ENTRY-REF>
            </BSW-MODULE-ENTRY-REF-CONDITIONAL>
          [!ENDIF!][!//
          [!IF "as:modconf('Cdd_Pwm')[1]/CddPwmConfigurationOfOptionalApis/CddPwmDeInitApi"!][!//
            <BSW-MODULE-ENTRY-REF-CONDITIONAL>
              <BSW-MODULE-ENTRY-REF DEST="BSW-MODULE-ENTRY">/Cdd_Pwm_TI_AM261x/Cdd_Pwm_ModuleEntry/Cdd_Pwm_DeInit</BSW-MODULE-ENTRY-REF>
            </BSW-MODULE-ENTRY-REF-CONDITIONAL>
          [!ENDIF!][!//
          [!IF "as:modconf('Cdd_Pwm')[1]/CddPwmGeneral/CddPwmDeadBandEnable"!][!//
            <BSW-MODULE-ENTRY-REF-CONDITIONAL>
              <BSW-MODULE-ENTRY-REF DEST="BSW-MODULE-ENTRY">/Cdd_Pwm_TI_AM261x/Cdd_Pwm_ModuleEntry/Cdd_Pwm_DeadbandBypass</BSW-MODULE-ENTRY-REF>
            </BSW-MODULE-ENTRY-REF-CONDITIONAL>
            <BSW-MODULE-ENTRY-REF-CONDITIONAL>
              <BSW-MODULE-ENTRY-REF DEST="BSW-MODULE-ENTRY">/Cdd_Pwm_TI_AM261x/Cdd_Pwm_ModuleEntry/Cdd_Pwm_DeadbandCfg</BSW-MODULE-ENTRY-REF>
            </BSW-MODULE-ENTRY-REF-CONDITIONAL>
			<BSW-MODULE-ENTRY-REF-CONDITIONAL>
              <BSW-MODULE-ENTRY-REF DEST="BSW-MODULE-ENTRY">/Cdd_Pwm_TI_AM261x/Cdd_Pwm_ModuleEntry/Cdd_Pwm_SetRisingEdgeDelay</BSW-MODULE-ENTRY-REF>
            </BSW-MODULE-ENTRY-REF-CONDITIONAL>
            <BSW-MODULE-ENTRY-REF-CONDITIONAL>
              <BSW-MODULE-ENTRY-REF DEST="BSW-MODULE-ENTRY">/Cdd_Pwm_TI_AM261x/Cdd_Pwm_ModuleEntry/Cdd_Pwm_SetFallingEdgeDelay</BSW-MODULE-ENTRY-REF>
            </BSW-MODULE-ENTRY-REF-CONDITIONAL>
			<BSW-MODULE-ENTRY-REF-CONDITIONAL>
              <BSW-MODULE-ENTRY-REF DEST="BSW-MODULE-ENTRY">/Cdd_Pwm_TI_AM261x/Cdd_Pwm_ModuleEntry/Cdd_Pwm_SetMinDeadbandDelay</BSW-MODULE-ENTRY-REF>
            </BSW-MODULE-ENTRY-REF-CONDITIONAL>
			<BSW-MODULE-ENTRY-REF-CONDITIONAL>
              <BSW-MODULE-ENTRY-REF DEST="BSW-MODULE-ENTRY">/Cdd_Pwm_TI_AM261x/Cdd_Pwm_ModuleEntry/Cdd_Pwm_HrSetRisingEdgeDelay</BSW-MODULE-ENTRY-REF>
            </BSW-MODULE-ENTRY-REF-CONDITIONAL>
            <BSW-MODULE-ENTRY-REF-CONDITIONAL>
              <BSW-MODULE-ENTRY-REF DEST="BSW-MODULE-ENTRY">/Cdd_Pwm_TI_AM261x/Cdd_Pwm_ModuleEntry/Cdd_Pwm_HrSetFallingEdgeDelay</BSW-MODULE-ENTRY-REF>
            </BSW-MODULE-ENTRY-REF-CONDITIONAL>
          [!ENDIF!][!//
          [!IF "as:modconf('Cdd_Pwm')[1]/CddPwmConfigurationOfOptionalApis/CddPwmNotificationSupported"!][!//
            <BSW-MODULE-ENTRY-REF-CONDITIONAL>
              <BSW-MODULE-ENTRY-REF DEST="BSW-MODULE-ENTRY">/Cdd_Pwm_TI_AM261x/Cdd_Pwm_ModuleEntry/Cdd_Pwm_DisableNotification</BSW-MODULE-ENTRY-REF>
            </BSW-MODULE-ENTRY-REF-CONDITIONAL>
            <BSW-MODULE-ENTRY-REF-CONDITIONAL>
              <BSW-MODULE-ENTRY-REF DEST="BSW-MODULE-ENTRY">/Cdd_Pwm_TI_AM261x/Cdd_Pwm_ModuleEntry/Cdd_Pwm_EnableNotification</BSW-MODULE-ENTRY-REF>
            </BSW-MODULE-ENTRY-REF-CONDITIONAL>
          [!ENDIF!][!//
            <BSW-MODULE-ENTRY-REF-CONDITIONAL>
              <BSW-MODULE-ENTRY-REF DEST="BSW-MODULE-ENTRY">/Cdd_Pwm_TI_AM261x/Cdd_Pwm_ModuleEntry/Cdd_Pwm_EtGetEventCount</BSW-MODULE-ENTRY-REF>
            </BSW-MODULE-ENTRY-REF-CONDITIONAL>
            <BSW-MODULE-ENTRY-REF-CONDITIONAL>
              <BSW-MODULE-ENTRY-REF DEST="BSW-MODULE-ENTRY">/Cdd_Pwm_TI_AM261x/Cdd_Pwm_ModuleEntry/Cdd_Pwm_EtIntrClear</BSW-MODULE-ENTRY-REF>
            </BSW-MODULE-ENTRY-REF-CONDITIONAL>
            <BSW-MODULE-ENTRY-REF-CONDITIONAL>
              <BSW-MODULE-ENTRY-REF DEST="BSW-MODULE-ENTRY">/Cdd_Pwm_TI_AM261x/Cdd_Pwm_ModuleEntry/Cdd_Pwm_EtIntrStatus</BSW-MODULE-ENTRY-REF>
            </BSW-MODULE-ENTRY-REF-CONDITIONAL>
          [!LOOP "as:modconf('Cdd_Pwm')[1]/CddPwmConfigSet/*/CddPwmChannel/*"!]
          [!VAR "Group" = "(num:i(substring-after(CddPwmGroupUnit,'CDD_PWM_CONTROLSS_G')))"!]
          [!VAR "Channel" = "(num:i(substring-after(CddPwmHwChannel,'CDD_PWM_CHANNEL_')))"!]
          [!IF "num:i($Group) = '0'"!][!//
          [!IF "num:i($Channel) = '0'"!][!//
            <BSW-MODULE-ENTRY-REF-CONDITIONAL>
              <BSW-MODULE-ENTRY-REF DEST="BSW-MODULE-ENTRY">/Cdd_Pwm_TI_AM261x/Cdd_Pwm_ModuleEntry/Cdd_Pwm_G0_Ch0Isr</BSW-MODULE-ENTRY-REF>
            </BSW-MODULE-ENTRY-REF-CONDITIONAL>
          [!ENDIF!][!//
          [!IF "num:i($Channel) = '1'"!][!//
            <BSW-MODULE-ENTRY-REF-CONDITIONAL>
              <BSW-MODULE-ENTRY-REF DEST="BSW-MODULE-ENTRY">/Cdd_Pwm_TI_AM261x/Cdd_Pwm_ModuleEntry/Cdd_Pwm_G0_Ch1Isr</BSW-MODULE-ENTRY-REF>
            </BSW-MODULE-ENTRY-REF-CONDITIONAL>
          [!ENDIF!][!//
          [!IF "num:i($Channel) = '2'"!][!//
            <BSW-MODULE-ENTRY-REF-CONDITIONAL>
              <BSW-MODULE-ENTRY-REF DEST="BSW-MODULE-ENTRY">/Cdd_Pwm_TI_AM261x/Cdd_Pwm_ModuleEntry/Cdd_Pwm_G0_Ch2Isr</BSW-MODULE-ENTRY-REF>
            </BSW-MODULE-ENTRY-REF-CONDITIONAL>
          [!ENDIF!][!//
          [!IF "num:i($Channel) = '3'"!][!//
            <BSW-MODULE-ENTRY-REF-CONDITIONAL>
              <BSW-MODULE-ENTRY-REF DEST="BSW-MODULE-ENTRY">/Cdd_Pwm_TI_AM261x/Cdd_Pwm_ModuleEntry/Cdd_Pwm_G0_Ch3Isr</BSW-MODULE-ENTRY-REF>
            </BSW-MODULE-ENTRY-REF-CONDITIONAL>
          [!ENDIF!][!//
          [!IF "num:i($Channel) = '4'"!][!//
            <BSW-MODULE-ENTRY-REF-CONDITIONAL>
              <BSW-MODULE-ENTRY-REF DEST="BSW-MODULE-ENTRY">/Cdd_Pwm_TI_AM261x/Cdd_Pwm_ModuleEntry/Cdd_Pwm_G0_Ch4Isr</BSW-MODULE-ENTRY-REF>
            </BSW-MODULE-ENTRY-REF-CONDITIONAL>
          [!ENDIF!][!//
          [!IF "num:i($Channel) = '5'"!][!//
            <BSW-MODULE-ENTRY-REF-CONDITIONAL>
              <BSW-MODULE-ENTRY-REF DEST="BSW-MODULE-ENTRY">/Cdd_Pwm_TI_AM261x/Cdd_Pwm_ModuleEntry/Cdd_Pwm_G0_Ch5Isr</BSW-MODULE-ENTRY-REF>
            </BSW-MODULE-ENTRY-REF-CONDITIONAL>
          [!ENDIF!][!//
          [!IF "num:i($Channel) = '6'"!][!//
            <BSW-MODULE-ENTRY-REF-CONDITIONAL>
              <BSW-MODULE-ENTRY-REF DEST="BSW-MODULE-ENTRY">/Cdd_Pwm_TI_AM261x/Cdd_Pwm_ModuleEntry/Cdd_Pwm_G0_Ch6Isr</BSW-MODULE-ENTRY-REF>
            </BSW-MODULE-ENTRY-REF-CONDITIONAL>
          [!ENDIF!][!//
          [!IF "num:i($Channel) = '7'"!][!//
            <BSW-MODULE-ENTRY-REF-CONDITIONAL>
              <BSW-MODULE-ENTRY-REF DEST="BSW-MODULE-ENTRY">/Cdd_Pwm_TI_AM261x/Cdd_Pwm_ModuleEntry/Cdd_Pwm_G0_Ch7Isr</BSW-MODULE-ENTRY-REF>
            </BSW-MODULE-ENTRY-REF-CONDITIONAL>
          [!ENDIF!][!//
          [!IF "num:i($Channel) = '8'"!][!//
            <BSW-MODULE-ENTRY-REF-CONDITIONAL>
              <BSW-MODULE-ENTRY-REF DEST="BSW-MODULE-ENTRY">/Cdd_Pwm_TI_AM261x/Cdd_Pwm_ModuleEntry/Cdd_Pwm_G0_Ch8Isr</BSW-MODULE-ENTRY-REF>
            </BSW-MODULE-ENTRY-REF-CONDITIONAL>
          [!ENDIF!][!//
          [!IF "num:i($Channel) = '9'"!][!//
            <BSW-MODULE-ENTRY-REF-CONDITIONAL>
              <BSW-MODULE-ENTRY-REF DEST="BSW-MODULE-ENTRY">/Cdd_Pwm_TI_AM261x/Cdd_Pwm_ModuleEntry/Cdd_Pwm_G0_Ch9Isr</BSW-MODULE-ENTRY-REF>
            </BSW-MODULE-ENTRY-REF-CONDITIONAL>
          [!ENDIF!][!//
          [!IF "num:i($Channel) = '0'"!][!//
            <BSW-MODULE-ENTRY-REF-CONDITIONAL>
              <BSW-MODULE-ENTRY-REF DEST="BSW-MODULE-ENTRY">/Cdd_Pwm_TI_AM261x/Cdd_Pwm_ModuleEntry/Cdd_Pwm_G0_TzCh0Isr</BSW-MODULE-ENTRY-REF>
            </BSW-MODULE-ENTRY-REF-CONDITIONAL>
          [!ENDIF!][!//
          [!IF "num:i($Channel) = '1'"!][!//
            <BSW-MODULE-ENTRY-REF-CONDITIONAL>
              <BSW-MODULE-ENTRY-REF DEST="BSW-MODULE-ENTRY">/Cdd_Pwm_TI_AM261x/Cdd_Pwm_ModuleEntry/Cdd_Pwm_G0_TzCh1Isr</BSW-MODULE-ENTRY-REF>
            </BSW-MODULE-ENTRY-REF-CONDITIONAL>
          [!ENDIF!][!//
          [!IF "num:i($Channel) = '2'"!][!//
            <BSW-MODULE-ENTRY-REF-CONDITIONAL>
              <BSW-MODULE-ENTRY-REF DEST="BSW-MODULE-ENTRY">/Cdd_Pwm_TI_AM261x/Cdd_Pwm_ModuleEntry/Cdd_Pwm_G0_TzCh2Isr</BSW-MODULE-ENTRY-REF>
            </BSW-MODULE-ENTRY-REF-CONDITIONAL>
          [!ENDIF!][!//
          [!IF "num:i($Channel) = '3'"!][!//
            <BSW-MODULE-ENTRY-REF-CONDITIONAL>
              <BSW-MODULE-ENTRY-REF DEST="BSW-MODULE-ENTRY">/Cdd_Pwm_TI_AM261x/Cdd_Pwm_ModuleEntry/Cdd_Pwm_G0_TzCh3Isr</BSW-MODULE-ENTRY-REF>
            </BSW-MODULE-ENTRY-REF-CONDITIONAL>
          [!ENDIF!][!//
          [!IF "num:i($Channel) = '4'"!][!//
            <BSW-MODULE-ENTRY-REF-CONDITIONAL>
              <BSW-MODULE-ENTRY-REF DEST="BSW-MODULE-ENTRY">/Cdd_Pwm_TI_AM261x/Cdd_Pwm_ModuleEntry/Cdd_Pwm_G0_TzCh4Isr</BSW-MODULE-ENTRY-REF>
            </BSW-MODULE-ENTRY-REF-CONDITIONAL>
          [!ENDIF!][!//
          [!IF "num:i($Channel) = '5'"!][!//
            <BSW-MODULE-ENTRY-REF-CONDITIONAL>
              <BSW-MODULE-ENTRY-REF DEST="BSW-MODULE-ENTRY">/Cdd_Pwm_TI_AM261x/Cdd_Pwm_ModuleEntry/Cdd_Pwm_G0_TzCh5Isr</BSW-MODULE-ENTRY-REF>
            </BSW-MODULE-ENTRY-REF-CONDITIONAL>
          [!ENDIF!][!//
          [!IF "num:i($Channel) = '6'"!][!//
            <BSW-MODULE-ENTRY-REF-CONDITIONAL>
              <BSW-MODULE-ENTRY-REF DEST="BSW-MODULE-ENTRY">/Cdd_Pwm_TI_AM261x/Cdd_Pwm_ModuleEntry/Cdd_Pwm_G0_TzCh6Isr</BSW-MODULE-ENTRY-REF>
            </BSW-MODULE-ENTRY-REF-CONDITIONAL>
          [!ENDIF!][!//
          [!IF "num:i($Channel) = '7'"!][!//
            <BSW-MODULE-ENTRY-REF-CONDITIONAL>
              <BSW-MODULE-ENTRY-REF DEST="BSW-MODULE-ENTRY">/Cdd_Pwm_TI_AM261x/Cdd_Pwm_ModuleEntry/Cdd_Pwm_G0_TzCh7Isr</BSW-MODULE-ENTRY-REF>
            </BSW-MODULE-ENTRY-REF-CONDITIONAL>
          [!ENDIF!][!//
          [!IF "num:i($Channel) = '8'"!][!//
            <BSW-MODULE-ENTRY-REF-CONDITIONAL>
              <BSW-MODULE-ENTRY-REF DEST="BSW-MODULE-ENTRY">/Cdd_Pwm_TI_AM261x/Cdd_Pwm_ModuleEntry/Cdd_Pwm_G0_TzCh8Isr</BSW-MODULE-ENTRY-REF>
            </BSW-MODULE-ENTRY-REF-CONDITIONAL>
          [!ENDIF!][!//
          [!IF "num:i($Channel) = '9'"!][!//
            <BSW-MODULE-ENTRY-REF-CONDITIONAL>
              <BSW-MODULE-ENTRY-REF DEST="BSW-MODULE-ENTRY">/Cdd_Pwm_TI_AM261x/Cdd_Pwm_ModuleEntry/Cdd_Pwm_G0_TzCh9Isr</BSW-MODULE-ENTRY-REF>
            </BSW-MODULE-ENTRY-REF-CONDITIONAL>
          [!ENDIF!][!//
          [!ELSEIF "num:i($Group) = '1'"!][!//
          [!IF "num:i($Channel) = '0'"!][!//
            <BSW-MODULE-ENTRY-REF-CONDITIONAL>
              <BSW-MODULE-ENTRY-REF DEST="BSW-MODULE-ENTRY">/Cdd_Pwm_TI_AM261x/Cdd_Pwm_ModuleEntry/Cdd_Pwm_G1_Ch0Isr</BSW-MODULE-ENTRY-REF>
            </BSW-MODULE-ENTRY-REF-CONDITIONAL>
          [!ENDIF!][!//
          [!IF "num:i($Channel) = '1'"!][!//
            <BSW-MODULE-ENTRY-REF-CONDITIONAL>
              <BSW-MODULE-ENTRY-REF DEST="BSW-MODULE-ENTRY">/Cdd_Pwm_TI_AM261x/Cdd_Pwm_ModuleEntry/Cdd_Pwm_G1_Ch1Isr</BSW-MODULE-ENTRY-REF>
            </BSW-MODULE-ENTRY-REF-CONDITIONAL>
          [!ENDIF!][!//
          [!IF "num:i($Channel) = '2'"!][!//
            <BSW-MODULE-ENTRY-REF-CONDITIONAL>
              <BSW-MODULE-ENTRY-REF DEST="BSW-MODULE-ENTRY">/Cdd_Pwm_TI_AM261x/Cdd_Pwm_ModuleEntry/Cdd_Pwm_G1_Ch2Isr</BSW-MODULE-ENTRY-REF>
            </BSW-MODULE-ENTRY-REF-CONDITIONAL>
          [!ENDIF!][!//
          [!IF "num:i($Channel) = '3'"!][!//
            <BSW-MODULE-ENTRY-REF-CONDITIONAL>
              <BSW-MODULE-ENTRY-REF DEST="BSW-MODULE-ENTRY">/Cdd_Pwm_TI_AM261x/Cdd_Pwm_ModuleEntry/Cdd_Pwm_G1_Ch3Isr</BSW-MODULE-ENTRY-REF>
            </BSW-MODULE-ENTRY-REF-CONDITIONAL>
          [!ENDIF!][!//
          [!IF "num:i($Channel) = '4'"!][!//
            <BSW-MODULE-ENTRY-REF-CONDITIONAL>
              <BSW-MODULE-ENTRY-REF DEST="BSW-MODULE-ENTRY">/Cdd_Pwm_TI_AM261x/Cdd_Pwm_ModuleEntry/Cdd_Pwm_G1_Ch4Isr</BSW-MODULE-ENTRY-REF>
            </BSW-MODULE-ENTRY-REF-CONDITIONAL>
          [!ENDIF!][!//
          [!IF "num:i($Channel) = '5'"!][!//
            <BSW-MODULE-ENTRY-REF-CONDITIONAL>
              <BSW-MODULE-ENTRY-REF DEST="BSW-MODULE-ENTRY">/Cdd_Pwm_TI_AM261x/Cdd_Pwm_ModuleEntry/Cdd_Pwm_G1_Ch5Isr</BSW-MODULE-ENTRY-REF>
            </BSW-MODULE-ENTRY-REF-CONDITIONAL>
          [!ENDIF!][!//
          [!IF "num:i($Channel) = '6'"!][!//
            <BSW-MODULE-ENTRY-REF-CONDITIONAL>
              <BSW-MODULE-ENTRY-REF DEST="BSW-MODULE-ENTRY">/Cdd_Pwm_TI_AM261x/Cdd_Pwm_ModuleEntry/Cdd_Pwm_G1_Ch6Isr</BSW-MODULE-ENTRY-REF>
            </BSW-MODULE-ENTRY-REF-CONDITIONAL>
          [!ENDIF!][!//
          [!IF "num:i($Channel) = '7'"!][!//
            <BSW-MODULE-ENTRY-REF-CONDITIONAL>
              <BSW-MODULE-ENTRY-REF DEST="BSW-MODULE-ENTRY">/Cdd_Pwm_TI_AM261x/Cdd_Pwm_ModuleEntry/Cdd_Pwm_G1_Ch7Isr</BSW-MODULE-ENTRY-REF>
            </BSW-MODULE-ENTRY-REF-CONDITIONAL>
          [!ENDIF!][!//
          [!IF "num:i($Channel) = '8'"!][!//
            <BSW-MODULE-ENTRY-REF-CONDITIONAL>
              <BSW-MODULE-ENTRY-REF DEST="BSW-MODULE-ENTRY">/Cdd_Pwm_TI_AM261x/Cdd_Pwm_ModuleEntry/Cdd_Pwm_G1_Ch8Isr</BSW-MODULE-ENTRY-REF>
            </BSW-MODULE-ENTRY-REF-CONDITIONAL>
          [!ENDIF!][!//
          [!IF "num:i($Channel) = '9'"!][!//
            <BSW-MODULE-ENTRY-REF-CONDITIONAL>
              <BSW-MODULE-ENTRY-REF DEST="BSW-MODULE-ENTRY">/Cdd_Pwm_TI_AM261x/Cdd_Pwm_ModuleEntry/Cdd_Pwm_G1_Ch9Isr</BSW-MODULE-ENTRY-REF>
            </BSW-MODULE-ENTRY-REF-CONDITIONAL>
          [!ENDIF!][!//
          [!IF "num:i($Channel) = '0'"!][!//
            <BSW-MODULE-ENTRY-REF-CONDITIONAL>
              <BSW-MODULE-ENTRY-REF DEST="BSW-MODULE-ENTRY">/Cdd_Pwm_TI_AM261x/Cdd_Pwm_ModuleEntry/Cdd_Pwm_G1_TzCh0Isr</BSW-MODULE-ENTRY-REF>
            </BSW-MODULE-ENTRY-REF-CONDITIONAL>
          [!ENDIF!][!//
          [!IF "num:i($Channel) = '1'"!][!//
            <BSW-MODULE-ENTRY-REF-CONDITIONAL>
              <BSW-MODULE-ENTRY-REF DEST="BSW-MODULE-ENTRY">/Cdd_Pwm_TI_AM261x/Cdd_Pwm_ModuleEntry/Cdd_Pwm_G1_TzCh1Isr</BSW-MODULE-ENTRY-REF>
            </BSW-MODULE-ENTRY-REF-CONDITIONAL>
          [!ENDIF!][!//
          [!IF "num:i($Channel) = '2'"!][!//
            <BSW-MODULE-ENTRY-REF-CONDITIONAL>
              <BSW-MODULE-ENTRY-REF DEST="BSW-MODULE-ENTRY">/Cdd_Pwm_TI_AM261x/Cdd_Pwm_ModuleEntry/Cdd_Pwm_G1_TzCh2Isr</BSW-MODULE-ENTRY-REF>
            </BSW-MODULE-ENTRY-REF-CONDITIONAL>
          [!ENDIF!][!//
          [!IF "num:i($Channel) = '3'"!][!//
            <BSW-MODULE-ENTRY-REF-CONDITIONAL>
              <BSW-MODULE-ENTRY-REF DEST="BSW-MODULE-ENTRY">/Cdd_Pwm_TI_AM261x/Cdd_Pwm_ModuleEntry/Cdd_Pwm_G1_TzCh3Isr</BSW-MODULE-ENTRY-REF>
            </BSW-MODULE-ENTRY-REF-CONDITIONAL>
          [!ENDIF!][!//
          [!IF "num:i($Channel) = '4'"!][!//
            <BSW-MODULE-ENTRY-REF-CONDITIONAL>
              <BSW-MODULE-ENTRY-REF DEST="BSW-MODULE-ENTRY">/Cdd_Pwm_TI_AM261x/Cdd_Pwm_ModuleEntry/Cdd_Pwm_G1_TzCh4Isr</BSW-MODULE-ENTRY-REF>
            </BSW-MODULE-ENTRY-REF-CONDITIONAL>
          [!ENDIF!][!//
          [!IF "num:i($Channel) = '5'"!][!//
            <BSW-MODULE-ENTRY-REF-CONDITIONAL>
              <BSW-MODULE-ENTRY-REF DEST="BSW-MODULE-ENTRY">/Cdd_Pwm_TI_AM261x/Cdd_Pwm_ModuleEntry/Cdd_Pwm_G1_TzCh5Isr</BSW-MODULE-ENTRY-REF>
            </BSW-MODULE-ENTRY-REF-CONDITIONAL>
          [!ENDIF!][!//
          [!IF "num:i($Channel) = '6'"!][!//
            <BSW-MODULE-ENTRY-REF-CONDITIONAL>
              <BSW-MODULE-ENTRY-REF DEST="BSW-MODULE-ENTRY">/Cdd_Pwm_TI_AM261x/Cdd_Pwm_ModuleEntry/Cdd_Pwm_G1_TzCh6Isr</BSW-MODULE-ENTRY-REF>
            </BSW-MODULE-ENTRY-REF-CONDITIONAL>
          [!ENDIF!][!//
          [!IF "num:i($Channel) = '7'"!][!//
            <BSW-MODULE-ENTRY-REF-CONDITIONAL>
              <BSW-MODULE-ENTRY-REF DEST="BSW-MODULE-ENTRY">/Cdd_Pwm_TI_AM261x/Cdd_Pwm_ModuleEntry/Cdd_Pwm_G1_TzCh7Isr</BSW-MODULE-ENTRY-REF>
            </BSW-MODULE-ENTRY-REF-CONDITIONAL>
          [!ENDIF!][!//
          [!IF "num:i($Channel) = '8'"!][!//
            <BSW-MODULE-ENTRY-REF-CONDITIONAL>
              <BSW-MODULE-ENTRY-REF DEST="BSW-MODULE-ENTRY">/Cdd_Pwm_TI_AM261x/Cdd_Pwm_ModuleEntry/Cdd_Pwm_G1_TzCh8Isr</BSW-MODULE-ENTRY-REF>
            </BSW-MODULE-ENTRY-REF-CONDITIONAL>
          [!ENDIF!][!//
          [!IF "num:i($Channel) = '9'"!][!//
            <BSW-MODULE-ENTRY-REF-CONDITIONAL>
              <BSW-MODULE-ENTRY-REF DEST="BSW-MODULE-ENTRY">/Cdd_Pwm_TI_AM261x/Cdd_Pwm_ModuleEntry/Cdd_Pwm_G1_TzCh9Isr</BSW-MODULE-ENTRY-REF>
            </BSW-MODULE-ENTRY-REF-CONDITIONAL>
          [!ENDIF!][!//
          [!ENDIF!][!//
          [!ENDLOOP!][!//
          [!IF "as:modconf('Cdd_Pwm')[1]/CddPwmConfigurationOfOptionalApis/CddPwmGetCounterApi"!][!//
            <BSW-MODULE-ENTRY-REF-CONDITIONAL>
              <BSW-MODULE-ENTRY-REF DEST="BSW-MODULE-ENTRY">/Cdd_Pwm_TI_AM261x/Cdd_Pwm_ModuleEntry/Cdd_Pwm_GetCounter</BSW-MODULE-ENTRY-REF>
            </BSW-MODULE-ENTRY-REF-CONDITIONAL>
          [!ENDIF!][!//
          [!IF "as:modconf('Cdd_Pwm')[1]/CddPwmConfigurationOfOptionalApis/CddPwmGetCounterStatus"!][!//
            <BSW-MODULE-ENTRY-REF-CONDITIONAL>
              <BSW-MODULE-ENTRY-REF DEST="BSW-MODULE-ENTRY">/Cdd_Pwm_TI_AM261x/Cdd_Pwm_ModuleEntry/Cdd_Pwm_GetCounterStatus</BSW-MODULE-ENTRY-REF>
            </BSW-MODULE-ENTRY-REF-CONDITIONAL>
          [!ENDIF!][!//
          [!IF "as:modconf('Cdd_Pwm')[1]/CddPwmConfigurationOfOptionalApis/CddPwmVersionInfoApi"!][!//
            <BSW-MODULE-ENTRY-REF-CONDITIONAL>
              <BSW-MODULE-ENTRY-REF DEST="BSW-MODULE-ENTRY">/Cdd_Pwm_TI_AM261x/Cdd_Pwm_ModuleEntry/Cdd_Pwm_GetVersionInfo</BSW-MODULE-ENTRY-REF>
            </BSW-MODULE-ENTRY-REF-CONDITIONAL>
          [!ENDIF!][!//
          [!IF "as:modconf('Cdd_Pwm')[1]/CddPwmGeneral/CddPwmHrSetPeriodDutyEnable"!][!//
            <BSW-MODULE-ENTRY-REF-CONDITIONAL>
              <BSW-MODULE-ENTRY-REF DEST="BSW-MODULE-ENTRY">/Cdd_Pwm_TI_AM261x/Cdd_Pwm_ModuleEntry/Cdd_Pwm_HrSetPeriodDutyPhase</BSW-MODULE-ENTRY-REF>
            </BSW-MODULE-ENTRY-REF-CONDITIONAL>
			<BSW-MODULE-ENTRY-REF-CONDITIONAL>
              <BSW-MODULE-ENTRY-REF DEST="BSW-MODULE-ENTRY">/Cdd_Pwm_TI_AM261x/Cdd_Pwm_ModuleEntry/Cdd_Pwm_HrSetPhaseShift</BSW-MODULE-ENTRY-REF>
            </BSW-MODULE-ENTRY-REF-CONDITIONAL>
			<BSW-MODULE-ENTRY-REF-CONDITIONAL>
              <BSW-MODULE-ENTRY-REF DEST="BSW-MODULE-ENTRY">/Cdd_Pwm_TI_AM261x/Cdd_Pwm_ModuleEntry/Cdd_Pwm_HrSetTimeBasePeriod</BSW-MODULE-ENTRY-REF>
            </BSW-MODULE-ENTRY-REF-CONDITIONAL>
			<BSW-MODULE-ENTRY-REF-CONDITIONAL>
              <BSW-MODULE-ENTRY-REF DEST="BSW-MODULE-ENTRY">/Cdd_Pwm_TI_AM261x/Cdd_Pwm_ModuleEntry/Cdd_Pwm_HrSetCounterCompareValue</BSW-MODULE-ENTRY-REF>
            </BSW-MODULE-ENTRY-REF-CONDITIONAL>
			<BSW-MODULE-ENTRY-REF-CONDITIONAL>
              <BSW-MODULE-ENTRY-REF DEST="BSW-MODULE-ENTRY">/Cdd_Pwm_TI_AM261x/Cdd_Pwm_ModuleEntry/Cdd_Pwm_HrSetXcmpRegValue</BSW-MODULE-ENTRY-REF>
            </BSW-MODULE-ENTRY-REF-CONDITIONAL>
          [!ENDIF!][!//
          [!IF "as:modconf('Cdd_Pwm')[1]/CddPwmGeneral/CddPwmHrSfoCalibrationEnable"!][!//
            <BSW-MODULE-ENTRY-REF-CONDITIONAL>
              <BSW-MODULE-ENTRY-REF DEST="BSW-MODULE-ENTRY">/Cdd_Pwm_TI_AM261x/Cdd_Pwm_ModuleEntry/Cdd_Pwm_HrSfoCalibration</BSW-MODULE-ENTRY-REF>
            </BSW-MODULE-ENTRY-REF-CONDITIONAL>
          [!ENDIF!][!//
          [!IF "as:modconf('Cdd_Pwm')[1]/CddPwmGeneral/CddPwmHrSfoStatusEnable"!][!//
            <BSW-MODULE-ENTRY-REF-CONDITIONAL>
              <BSW-MODULE-ENTRY-REF DEST="BSW-MODULE-ENTRY">/Cdd_Pwm_TI_AM261x/Cdd_Pwm_ModuleEntry/Cdd_Pwm_HrSfoStatus</BSW-MODULE-ENTRY-REF>
            </BSW-MODULE-ENTRY-REF-CONDITIONAL>
          [!ENDIF!][!//
            <BSW-MODULE-ENTRY-REF-CONDITIONAL>
              <BSW-MODULE-ENTRY-REF DEST="BSW-MODULE-ENTRY">/Cdd_Pwm_TI_AM261x/Cdd_Pwm_ModuleEntry/Cdd_Pwm_Init</BSW-MODULE-ENTRY-REF>
            </BSW-MODULE-ENTRY-REF-CONDITIONAL>
          [!IF "as:modconf('Cdd_Pwm')[1]/CddPwmConfigurationOfOptionalApis/CddPwmEnableRegisterReadbackApi"!][!//
            <BSW-MODULE-ENTRY-REF-CONDITIONAL>
              <BSW-MODULE-ENTRY-REF DEST="BSW-MODULE-ENTRY">/Cdd_Pwm_TI_AM261x/Cdd_Pwm_ModuleEntry/Cdd_Pwm_RegisterReadback</BSW-MODULE-ENTRY-REF>
            </BSW-MODULE-ENTRY-REF-CONDITIONAL>
          [!ENDIF!][!//
          [!IF "as:modconf('Cdd_Pwm')[1]/CddPwmConfigurationOfOptionalApis/CddPwmSetAbsoluteThreshold"!][!//
            <BSW-MODULE-ENTRY-REF-CONDITIONAL>
              <BSW-MODULE-ENTRY-REF DEST="BSW-MODULE-ENTRY">/Cdd_Pwm_TI_AM261x/Cdd_Pwm_ModuleEntry/Cdd_Pwm_SetAbsoluteThreshold</BSW-MODULE-ENTRY-REF>
            </BSW-MODULE-ENTRY-REF-CONDITIONAL>
          [!ENDIF!][!//
          [!IF "as:modconf('Cdd_Pwm')[1]/CddPwmConfigurationOfOptionalApis/CddPwmSetAdcTriggerApi"!][!//
            <BSW-MODULE-ENTRY-REF-CONDITIONAL>
              <BSW-MODULE-ENTRY-REF DEST="BSW-MODULE-ENTRY">/Cdd_Pwm_TI_AM261x/Cdd_Pwm_ModuleEntry/Cdd_Pwm_SetAdcTrigger</BSW-MODULE-ENTRY-REF>
            </BSW-MODULE-ENTRY-REF-CONDITIONAL>
          [!ENDIF!][!//
          [!IF "as:modconf('Cdd_Pwm')[1]/CddPwmConfigurationOfOptionalApis/CddPwmSetOutputToIdle"!][!//
            <BSW-MODULE-ENTRY-REF-CONDITIONAL>
              <BSW-MODULE-ENTRY-REF DEST="BSW-MODULE-ENTRY">/Cdd_Pwm_TI_AM261x/Cdd_Pwm_ModuleEntry/Cdd_Pwm_SetOutputToIdle</BSW-MODULE-ENTRY-REF>
            </BSW-MODULE-ENTRY-REF-CONDITIONAL>
          [!ENDIF!][!//
          [!IF "as:modconf('Cdd_Pwm')[1]/CddPwmConfigurationOfOptionalApis/CddPwmSetPeriodDutyPhase"!][!//
            <BSW-MODULE-ENTRY-REF-CONDITIONAL>
              <BSW-MODULE-ENTRY-REF DEST="BSW-MODULE-ENTRY">/Cdd_Pwm_TI_AM261x/Cdd_Pwm_ModuleEntry/Cdd_Pwm_SetPeriodDutyPhase</BSW-MODULE-ENTRY-REF>
            </BSW-MODULE-ENTRY-REF-CONDITIONAL>
			<BSW-MODULE-ENTRY-REF-CONDITIONAL>
              <BSW-MODULE-ENTRY-REF DEST="BSW-MODULE-ENTRY">/Cdd_Pwm_TI_AM261x/Cdd_Pwm_ModuleEntry/Cdd_Pwm_SetTimeBaseCounterMode</BSW-MODULE-ENTRY-REF>
            </BSW-MODULE-ENTRY-REF-CONDITIONAL>
			<BSW-MODULE-ENTRY-REF-CONDITIONAL>
              <BSW-MODULE-ENTRY-REF DEST="BSW-MODULE-ENTRY">/Cdd_Pwm_TI_AM261x/Cdd_Pwm_ModuleEntry/Cdd_Pwm_SetPhaseShift</BSW-MODULE-ENTRY-REF>
            </BSW-MODULE-ENTRY-REF-CONDITIONAL>
			<BSW-MODULE-ENTRY-REF-CONDITIONAL>
              <BSW-MODULE-ENTRY-REF DEST="BSW-MODULE-ENTRY">/Cdd_Pwm_TI_AM261x/Cdd_Pwm_ModuleEntry/Cdd_Pwm_SetTimeBasePeriod</BSW-MODULE-ENTRY-REF>
            </BSW-MODULE-ENTRY-REF-CONDITIONAL>
			<BSW-MODULE-ENTRY-REF-CONDITIONAL>
              <BSW-MODULE-ENTRY-REF DEST="BSW-MODULE-ENTRY">/Cdd_Pwm_TI_AM261x/Cdd_Pwm_ModuleEntry/Cdd_Pwm_SetCounterCompareValue</BSW-MODULE-ENTRY-REF>
            </BSW-MODULE-ENTRY-REF-CONDITIONAL>
			<BSW-MODULE-ENTRY-REF-CONDITIONAL>
              <BSW-MODULE-ENTRY-REF DEST="BSW-MODULE-ENTRY">/Cdd_Pwm_TI_AM261x/Cdd_Pwm_ModuleEntry/Cdd_Pwm_SetXcmpRegValue</BSW-MODULE-ENTRY-REF>
            </BSW-MODULE-ENTRY-REF-CONDITIONAL>
			<BSW-MODULE-ENTRY-REF-CONDITIONAL>
              <BSW-MODULE-ENTRY-REF DEST="BSW-MODULE-ENTRY">/Cdd_Pwm_TI_AM261x/Cdd_Pwm_ModuleEntry/Cdd_Pwm_SetXMinMaxRegValue</BSW-MODULE-ENTRY-REF>
            </BSW-MODULE-ENTRY-REF-CONDITIONAL>
			<BSW-MODULE-ENTRY-REF-CONDITIONAL>
              <BSW-MODULE-ENTRY-REF DEST="BSW-MODULE-ENTRY">/Cdd_Pwm_TI_AM261x/Cdd_Pwm_ModuleEntry/Cdd_Pwm_SetCmpShadowRegValue</BSW-MODULE-ENTRY-REF>
            </BSW-MODULE-ENTRY-REF-CONDITIONAL>
          [!ENDIF!][!//
          [!IF "as:modconf('Cdd_Pwm')[1]/CddPwmConfigurationOfOptionalApis/CddPwmSetPinAction"!][!//
            <BSW-MODULE-ENTRY-REF-CONDITIONAL>
              <BSW-MODULE-ENTRY-REF DEST="BSW-MODULE-ENTRY">/Cdd_Pwm_TI_AM261x/Cdd_Pwm_ModuleEntry/Cdd_Pwm_SetPinAction</BSW-MODULE-ENTRY-REF>
            </BSW-MODULE-ENTRY-REF-CONDITIONAL>
          [!ENDIF!][!//
          [!IF "as:modconf('Cdd_Pwm')[1]/CddPwmConfigurationOfOptionalApis/CddPwmSetRelativeThreshold"!][!//
            <BSW-MODULE-ENTRY-REF-CONDITIONAL>
              <BSW-MODULE-ENTRY-REF DEST="BSW-MODULE-ENTRY">/Cdd_Pwm_TI_AM261x/Cdd_Pwm_ModuleEntry/Cdd_Pwm_SetRelativeThreshold</BSW-MODULE-ENTRY-REF>
            </BSW-MODULE-ENTRY-REF-CONDITIONAL>
          [!ENDIF!][!//
            <BSW-MODULE-ENTRY-REF-CONDITIONAL>
              <BSW-MODULE-ENTRY-REF DEST="BSW-MODULE-ENTRY">/Cdd_Pwm_TI_AM261x/Cdd_Pwm_ModuleEntry/Cdd_Pwm_StartChannelCounter</BSW-MODULE-ENTRY-REF>
            </BSW-MODULE-ENTRY-REF-CONDITIONAL>
            <BSW-MODULE-ENTRY-REF-CONDITIONAL>
              <BSW-MODULE-ENTRY-REF DEST="BSW-MODULE-ENTRY">/Cdd_Pwm_TI_AM261x/Cdd_Pwm_ModuleEntry/Cdd_Pwm_StopChannelCounter</BSW-MODULE-ENTRY-REF>
            </BSW-MODULE-ENTRY-REF-CONDITIONAL>
          [!IF "as:modconf('Cdd_Pwm')[1]/CddPwmGeneral/CddPwmChannelTimerBaseSyncEnable"!][!//
            <BSW-MODULE-ENTRY-REF-CONDITIONAL>
              <BSW-MODULE-ENTRY-REF DEST="BSW-MODULE-ENTRY">/Cdd_Pwm_TI_AM261x/Cdd_Pwm_ModuleEntry/Cdd_Pwm_SyncDisable</BSW-MODULE-ENTRY-REF>
            </BSW-MODULE-ENTRY-REF-CONDITIONAL>
            <BSW-MODULE-ENTRY-REF-CONDITIONAL>
              <BSW-MODULE-ENTRY-REF DEST="BSW-MODULE-ENTRY">/Cdd_Pwm_TI_AM261x/Cdd_Pwm_ModuleEntry/Cdd_Pwm_SyncEnable</BSW-MODULE-ENTRY-REF>
            </BSW-MODULE-ENTRY-REF-CONDITIONAL>
          [!ENDIF!][!//
          [!IF "as:modconf('Cdd_Pwm')[1]/CddPwmGeneral/CddPwmTripZoneEnable"!][!//
            <BSW-MODULE-ENTRY-REF-CONDITIONAL>
              <BSW-MODULE-ENTRY-REF DEST="BSW-MODULE-ENTRY">/Cdd_Pwm_TI_AM261x/Cdd_Pwm_ModuleEntry/Cdd_Pwm_TzEventStatusClear</BSW-MODULE-ENTRY-REF>
            </BSW-MODULE-ENTRY-REF-CONDITIONAL>
            <BSW-MODULE-ENTRY-REF-CONDITIONAL>
              <BSW-MODULE-ENTRY-REF DEST="BSW-MODULE-ENTRY">/Cdd_Pwm_TI_AM261x/Cdd_Pwm_ModuleEntry/Cdd_Pwm_TzGetEventStatus</BSW-MODULE-ENTRY-REF>
            </BSW-MODULE-ENTRY-REF-CONDITIONAL>
            <BSW-MODULE-ENTRY-REF-CONDITIONAL>
              <BSW-MODULE-ENTRY-REF DEST="BSW-MODULE-ENTRY">/Cdd_Pwm_TI_AM261x/Cdd_Pwm_ModuleEntry/Cdd_Pwm_TzIntrDisable</BSW-MODULE-ENTRY-REF>
            </BSW-MODULE-ENTRY-REF-CONDITIONAL>
            <BSW-MODULE-ENTRY-REF-CONDITIONAL>
              <BSW-MODULE-ENTRY-REF DEST="BSW-MODULE-ENTRY">/Cdd_Pwm_TI_AM261x/Cdd_Pwm_ModuleEntry/Cdd_Pwm_TzIntrEnable</BSW-MODULE-ENTRY-REF>
            </BSW-MODULE-ENTRY-REF-CONDITIONAL>
            <BSW-MODULE-ENTRY-REF-CONDITIONAL>
              <BSW-MODULE-ENTRY-REF DEST="BSW-MODULE-ENTRY">/Cdd_Pwm_TI_AM261x/Cdd_Pwm_ModuleEntry/Cdd_Pwm_TzTripEventDisable</BSW-MODULE-ENTRY-REF>
            </BSW-MODULE-ENTRY-REF-CONDITIONAL>
            <BSW-MODULE-ENTRY-REF-CONDITIONAL>
              <BSW-MODULE-ENTRY-REF DEST="BSW-MODULE-ENTRY">/Cdd_Pwm_TI_AM261x/Cdd_Pwm_ModuleEntry/Cdd_Pwm_TzTripEventEnable</BSW-MODULE-ENTRY-REF>
            </BSW-MODULE-ENTRY-REF-CONDITIONAL>
          [!ENDIF!][!//
          </IMPLEMENTED-ENTRYS>
          <MODULE-ID>255</MODULE-ID>
        [!IF "as:modconf('Cdd_Pwm')[1]/CddPwmGeneral/CddPwmDevErrorDetect"!][!//
          <BSW-MODULE-DEPENDENCYS>
            <BSW-MODULE-DEPENDENCY UUID="2920ab88-5686-476d-b2d6-1e115a6997ba">
              <SHORT-NAME>Det</SHORT-NAME>
              <TARGET-MODULE-ID>15</TARGET-MODULE-ID>
              <TARGET-MODULE-REFS>
                <BSW-MODULE-DESCRIPTION-REF-CONDITIONAL>
                  <BSW-MODULE-DESCRIPTION-REF DEST="BSW-MODULE-DESCRIPTION">/AUTOSAR_Det/Det</BSW-MODULE-DESCRIPTION-REF>
                </BSW-MODULE-DESCRIPTION-REF-CONDITIONAL>
              </TARGET-MODULE-REFS>
            </BSW-MODULE-DEPENDENCY>
          </BSW-MODULE-DEPENDENCYS>
        [!ENDIF!][!//
          <INTERNAL-BEHAVIORS>
            <BSW-INTERNAL-BEHAVIOR UUID="e90894d1-e602-443f-99b6-73c0f777f13e">
              <SHORT-NAME>Cdd_Pwm_Behavior</SHORT-NAME>
              <EXCLUSIVE-AREAS>
                <EXCLUSIVE-AREA UUID="0e7d36fa-9d8f-4809-aa4c-044c63f1a0e8">
                  <SHORT-NAME>PWM_EXCLUSIVE_AREA_0</SHORT-NAME>
                </EXCLUSIVE-AREA>
              </EXCLUSIVE-AREAS>
              <ENTITYS>
              [!IF "as:modconf('Cdd_Pwm')[1]/CddPwmGeneral/CddPwmChopperEnable = 'true'"!][!//
                <BSW-CALLED-ENTITY UUID="88860c7d-b2cc-4326-ad7a-5558117b829d">
                  <SHORT-NAME>Cdd_Pwm_ChopperCfg</SHORT-NAME>
                  <CAN-ENTER-EXCLUSIVE-AREA-REFS>
                    <CAN-ENTER-EXCLUSIVE-AREA-REF DEST="EXCLUSIVE-AREA">/Cdd_Pwm_TI_AM261x/Cdd_Pwm/Cdd_Pwm_Behavior/PWM_EXCLUSIVE_AREA_0</CAN-ENTER-EXCLUSIVE-AREA-REF>
                  </CAN-ENTER-EXCLUSIVE-AREA-REFS>
                  <REENTRANCY-LEVEL>NON-REENTRANT</REENTRANCY-LEVEL>
                [!IF "as:modconf('Cdd_Pwm')[1]/CddPwmGeneral/CddPwmDevErrorDetect"!][!//
                  <CALL-POINTS>
                    <BSW-DIRECT-CALL-POINT>
                      <SHORT-NAME>Det</SHORT-NAME>
                      <CALLED-ENTRY-REF DEST="BSW-MODULE-ENTRY">/AUTOSAR_Det/BSWModuleEntry/Det_ReportError</CALLED-ENTRY-REF>
                    </BSW-DIRECT-CALL-POINT>
                  </CALL-POINTS>
                [!ENDIF!][!//
                  <IMPLEMENTED-ENTRY-REF DEST="BSW-MODULE-ENTRY">/Cdd_Pwm_TI_AM261x/Cdd_Pwm_ModuleEntry/Cdd_Pwm_ChopperCfg</IMPLEMENTED-ENTRY-REF>
                </BSW-CALLED-ENTITY>
                <BSW-CALLED-ENTITY UUID="e99dc420-55c3-4af2-b28c-45b6a08bba93">
                  <SHORT-NAME>Cdd_Pwm_ChopperEnable</SHORT-NAME>
                  <CAN-ENTER-EXCLUSIVE-AREA-REFS>
                    <CAN-ENTER-EXCLUSIVE-AREA-REF DEST="EXCLUSIVE-AREA">/Cdd_Pwm_TI_AM261x/Cdd_Pwm/Cdd_Pwm_Behavior/PWM_EXCLUSIVE_AREA_0</CAN-ENTER-EXCLUSIVE-AREA-REF>
                  </CAN-ENTER-EXCLUSIVE-AREA-REFS>
                  <REENTRANCY-LEVEL>NON-REENTRANT</REENTRANCY-LEVEL>
                  <IMPLEMENTED-ENTRY-REF DEST="BSW-MODULE-ENTRY">/Cdd_Pwm_TI_AM261x/Cdd_Pwm_ModuleEntry/Cdd_Pwm_ChopperEnable</IMPLEMENTED-ENTRY-REF>
                </BSW-CALLED-ENTITY>
              [!ENDIF!][!//
              [!IF "as:modconf('Cdd_Pwm')[1]/CddPwmConfigurationOfOptionalApis/CddPwmGetCounterStatus"!][!//
                <BSW-CALLED-ENTITY UUID="fa5bc6c2-76cd-444b-ac05-b47e6cf9dd34">
                  <SHORT-NAME>Cdd_Pwm_ClearCounterStatus</SHORT-NAME>
                  <CAN-ENTER-EXCLUSIVE-AREA-REFS>
                    <CAN-ENTER-EXCLUSIVE-AREA-REF DEST="EXCLUSIVE-AREA">/Cdd_Pwm_TI_AM261x/Cdd_Pwm/Cdd_Pwm_Behavior/PWM_EXCLUSIVE_AREA_0</CAN-ENTER-EXCLUSIVE-AREA-REF>
                  </CAN-ENTER-EXCLUSIVE-AREA-REFS>
                  <REENTRANCY-LEVEL>NON-REENTRANT</REENTRANCY-LEVEL>
                  <IMPLEMENTED-ENTRY-REF DEST="BSW-MODULE-ENTRY">/Cdd_Pwm_TI_AM261x/Cdd_Pwm_ModuleEntry/Cdd_Pwm_ClearCounterStatus</IMPLEMENTED-ENTRY-REF>
                </BSW-CALLED-ENTITY>
              [!ENDIF!][!//
              [!IF "as:modconf('Cdd_Pwm')[1]/CddPwmConfigurationOfOptionalApis/CddPwmCounterComparatorCfg"!][!//
                <BSW-CALLED-ENTITY UUID="1cb07986-a14a-49e4-83e7-0d844a0fa69f">
                  <SHORT-NAME>Cdd_Pwm_CounterComparatorCfg</SHORT-NAME>
                  <CAN-ENTER-EXCLUSIVE-AREA-REFS>
                    <CAN-ENTER-EXCLUSIVE-AREA-REF DEST="EXCLUSIVE-AREA">/Cdd_Pwm_TI_AM261x/Cdd_Pwm/Cdd_Pwm_Behavior/PWM_EXCLUSIVE_AREA_0</CAN-ENTER-EXCLUSIVE-AREA-REF>
                  </CAN-ENTER-EXCLUSIVE-AREA-REFS>
                  <REENTRANCY-LEVEL>NON-REENTRANT</REENTRANCY-LEVEL>
                  <IMPLEMENTED-ENTRY-REF DEST="BSW-MODULE-ENTRY">/Cdd_Pwm_TI_AM261x/Cdd_Pwm_ModuleEntry/Cdd_Pwm_CounterComparatorCfg</IMPLEMENTED-ENTRY-REF>
                </BSW-CALLED-ENTITY>
              [!ENDIF!][!//
              [!IF "as:modconf('Cdd_Pwm')[1]/CddPwmConfigurationOfOptionalApis/CddPwmDeInitApi"!][!//
                <BSW-CALLED-ENTITY UUID="d3fa43d3-acd0-48a5-9e62-f7375493b22d">
                  <SHORT-NAME>Cdd_Pwm_DeInit</SHORT-NAME>
                  <REENTRANCY-LEVEL>NON-REENTRANT</REENTRANCY-LEVEL>
                  <IMPLEMENTED-ENTRY-REF DEST="BSW-MODULE-ENTRY">/Cdd_Pwm_TI_AM261x/Cdd_Pwm_ModuleEntry/Cdd_Pwm_DeInit</IMPLEMENTED-ENTRY-REF>
                </BSW-CALLED-ENTITY>
              [!ENDIF!][!//
              [!IF "as:modconf('Cdd_Pwm')[1]/CddPwmGeneral/CddPwmDeadBandEnable"!][!//
                <BSW-CALLED-ENTITY UUID="c11daaf8-12ce-40c3-83ee-20da8d0a7db8">
                  <SHORT-NAME>Cdd_Pwm_DeadbandBypass</SHORT-NAME>
                  <CAN-ENTER-EXCLUSIVE-AREA-REFS>
                    <CAN-ENTER-EXCLUSIVE-AREA-REF DEST="EXCLUSIVE-AREA">/Cdd_Pwm_TI_AM261x/Cdd_Pwm/Cdd_Pwm_Behavior/PWM_EXCLUSIVE_AREA_0</CAN-ENTER-EXCLUSIVE-AREA-REF>
                  </CAN-ENTER-EXCLUSIVE-AREA-REFS>
                  <REENTRANCY-LEVEL>NON-REENTRANT</REENTRANCY-LEVEL>
                  <IMPLEMENTED-ENTRY-REF DEST="BSW-MODULE-ENTRY">/Cdd_Pwm_TI_AM261x/Cdd_Pwm_ModuleEntry/Cdd_Pwm_DeadbandBypass</IMPLEMENTED-ENTRY-REF>
                </BSW-CALLED-ENTITY>
                <BSW-CALLED-ENTITY UUID="83eb4f36-41cf-496c-83e5-234edd1179c3">
                  <SHORT-NAME>Cdd_Pwm_DeadbandCfg</SHORT-NAME>
                  <CAN-ENTER-EXCLUSIVE-AREA-REFS>
                    <CAN-ENTER-EXCLUSIVE-AREA-REF DEST="EXCLUSIVE-AREA">/Cdd_Pwm_TI_AM261x/Cdd_Pwm/Cdd_Pwm_Behavior/PWM_EXCLUSIVE_AREA_0</CAN-ENTER-EXCLUSIVE-AREA-REF>
                  </CAN-ENTER-EXCLUSIVE-AREA-REFS>
                  <REENTRANCY-LEVEL>NON-REENTRANT</REENTRANCY-LEVEL>
                [!IF "as:modconf('Cdd_Pwm')[1]/CddPwmGeneral/CddPwmDevErrorDetect"!][!//
                  <CALL-POINTS>
                    <BSW-DIRECT-CALL-POINT>
                      <SHORT-NAME>Det</SHORT-NAME>
                      <CALLED-ENTRY-REF DEST="BSW-MODULE-ENTRY">/AUTOSAR_Det/BSWModuleEntry/Det_ReportError</CALLED-ENTRY-REF>
                    </BSW-DIRECT-CALL-POINT>
                  </CALL-POINTS>
                [!ENDIF!][!//
                  <IMPLEMENTED-ENTRY-REF DEST="BSW-MODULE-ENTRY">/Cdd_Pwm_TI_AM261x/Cdd_Pwm_ModuleEntry/Cdd_Pwm_DeadbandCfg</IMPLEMENTED-ENTRY-REF>
                </BSW-CALLED-ENTITY>
				<BSW-CALLED-ENTITY UUID="0407c44a-1856-4264-9ed2-a03e9e39209e">
                  <SHORT-NAME>Cdd_Pwm_SetRisingEdgeDelay</SHORT-NAME>
                  <REENTRANCY-LEVEL>NON-REENTRANT</REENTRANCY-LEVEL>
                  <IMPLEMENTED-ENTRY-REF DEST="BSW-MODULE-ENTRY">/Cdd_Pwm_TI_AM261x/Cdd_Pwm_ModuleEntry/Cdd_Pwm_SetRisingEdgeDelay</IMPLEMENTED-ENTRY-REF>
                </BSW-CALLED-ENTITY>
				<BSW-CALLED-ENTITY UUID="4792620c-7047-4c90-927f-d972d124f3cb">
                  <SHORT-NAME>Cdd_Pwm_SetFallingEdgeDelay</SHORT-NAME>
                  <REENTRANCY-LEVEL>NON-REENTRANT</REENTRANCY-LEVEL>
                  <IMPLEMENTED-ENTRY-REF DEST="BSW-MODULE-ENTRY">/Cdd_Pwm_TI_AM261x/Cdd_Pwm_ModuleEntry/Cdd_Pwm_SetFallingEdgeDelay</IMPLEMENTED-ENTRY-REF>
                </BSW-CALLED-ENTITY>
				<BSW-CALLED-ENTITY UUID="42eb1683-e1e8-4082-8f95-2f20d01b8731">
                  <SHORT-NAME>Cdd_Pwm_SetMinDeadbandDelay</SHORT-NAME>
                  <REENTRANCY-LEVEL>NON-REENTRANT</REENTRANCY-LEVEL>
                  <IMPLEMENTED-ENTRY-REF DEST="BSW-MODULE-ENTRY">/Cdd_Pwm_TI_AM261x/Cdd_Pwm_ModuleEntry/Cdd_Pwm_SetMinDeadbandDelay</IMPLEMENTED-ENTRY-REF>
                </BSW-CALLED-ENTITY>
				<BSW-CALLED-ENTITY UUID="0d20c984-b50e-4502-9c2c-c509455154cb">
                  <SHORT-NAME>Cdd_Pwm_HrSetRisingEdgeDelay</SHORT-NAME>
                  <REENTRANCY-LEVEL>NON-REENTRANT</REENTRANCY-LEVEL>
                  <IMPLEMENTED-ENTRY-REF DEST="BSW-MODULE-ENTRY">/Cdd_Pwm_TI_AM261x/Cdd_Pwm_ModuleEntry/Cdd_Pwm_HrSetRisingEdgeDelay</IMPLEMENTED-ENTRY-REF>
                </BSW-CALLED-ENTITY>
				<BSW-CALLED-ENTITY UUID="228eec55-6006-479b-a283-0a47af4890a0">
                  <SHORT-NAME>Cdd_Pwm_HrSetFallingEdgeDelay</SHORT-NAME>
                  <REENTRANCY-LEVEL>NON-REENTRANT</REENTRANCY-LEVEL>
                  <IMPLEMENTED-ENTRY-REF DEST="BSW-MODULE-ENTRY">/Cdd_Pwm_TI_AM261x/Cdd_Pwm_ModuleEntry/Cdd_Pwm_HrSetFallingEdgeDelay</IMPLEMENTED-ENTRY-REF>
                </BSW-CALLED-ENTITY>
              [!ENDIF!][!//
              [!IF "as:modconf('Cdd_Pwm')[1]/CddPwmConfigurationOfOptionalApis/CddPwmNotificationSupported"!][!//
                <BSW-CALLED-ENTITY UUID="b3ed811e-0535-4656-8f54-e5a0d320f420">
                  <SHORT-NAME>Cdd_Pwm_DisableNotification</SHORT-NAME>
                  <CAN-ENTER-EXCLUSIVE-AREA-REFS>
                    <CAN-ENTER-EXCLUSIVE-AREA-REF DEST="EXCLUSIVE-AREA">/Cdd_Pwm_TI_AM261x/Cdd_Pwm/Cdd_Pwm_Behavior/PWM_EXCLUSIVE_AREA_0</CAN-ENTER-EXCLUSIVE-AREA-REF>
                  </CAN-ENTER-EXCLUSIVE-AREA-REFS>
                  <REENTRANCY-LEVEL>NON-REENTRANT</REENTRANCY-LEVEL>
                [!IF "as:modconf('Cdd_Pwm')[1]/CddPwmGeneral/CddPwmDevErrorDetect"!][!//
                  <CALL-POINTS>
                    <BSW-DIRECT-CALL-POINT>
                      <SHORT-NAME>Det</SHORT-NAME>
                      <CALLED-ENTRY-REF DEST="BSW-MODULE-ENTRY">/AUTOSAR_Det/BSWModuleEntry/Det_ReportError</CALLED-ENTRY-REF>
                    </BSW-DIRECT-CALL-POINT>
                  </CALL-POINTS>
                [!ENDIF!][!//
                  <IMPLEMENTED-ENTRY-REF DEST="BSW-MODULE-ENTRY">/Cdd_Pwm_TI_AM261x/Cdd_Pwm_ModuleEntry/Cdd_Pwm_DisableNotification</IMPLEMENTED-ENTRY-REF>
                </BSW-CALLED-ENTITY>
                <BSW-CALLED-ENTITY UUID="c251dcf9-0fc5-497a-959b-31cfd6059217">
                  <SHORT-NAME>Cdd_Pwm_EnableNotification</SHORT-NAME>
                  <CAN-ENTER-EXCLUSIVE-AREA-REFS>
                    <CAN-ENTER-EXCLUSIVE-AREA-REF DEST="EXCLUSIVE-AREA">/Cdd_Pwm_TI_AM261x/Cdd_Pwm/Cdd_Pwm_Behavior/PWM_EXCLUSIVE_AREA_0</CAN-ENTER-EXCLUSIVE-AREA-REF>
                  </CAN-ENTER-EXCLUSIVE-AREA-REFS>
                  <REENTRANCY-LEVEL>NON-REENTRANT</REENTRANCY-LEVEL>
                [!IF "as:modconf('Cdd_Pwm')[1]/CddPwmGeneral/CddPwmDevErrorDetect"!][!//
                  <CALL-POINTS>
                    <BSW-DIRECT-CALL-POINT>
                      <SHORT-NAME>Det</SHORT-NAME>
                      <CALLED-ENTRY-REF DEST="BSW-MODULE-ENTRY">/AUTOSAR_Det/BSWModuleEntry/Det_ReportError</CALLED-ENTRY-REF>
                    </BSW-DIRECT-CALL-POINT>
                  </CALL-POINTS>
                [!ENDIF!][!//
                  <IMPLEMENTED-ENTRY-REF DEST="BSW-MODULE-ENTRY">/Cdd_Pwm_TI_AM261x/Cdd_Pwm_ModuleEntry/Cdd_Pwm_EnableNotification</IMPLEMENTED-ENTRY-REF>
                </BSW-CALLED-ENTITY>
              [!ENDIF!][!//
                <BSW-CALLED-ENTITY UUID="b5e060b4-ecc9-4837-a307-a6a7edd0ec1f">
                  <SHORT-NAME>Cdd_Pwm_EtGetEventCount</SHORT-NAME>
                  <REENTRANCY-LEVEL>SINGLE-CORE-REENTRANT</REENTRANCY-LEVEL>
                  <IMPLEMENTED-ENTRY-REF DEST="BSW-MODULE-ENTRY">/Cdd_Pwm_TI_AM261x/Cdd_Pwm_ModuleEntry/Cdd_Pwm_EtGetEventCount</IMPLEMENTED-ENTRY-REF>
                </BSW-CALLED-ENTITY>
                <BSW-CALLED-ENTITY UUID="9292623e-3d40-4f2b-8189-a5b53f768f9f">
                  <SHORT-NAME>Cdd_Pwm_EtIntrClear</SHORT-NAME>
                  <CAN-ENTER-EXCLUSIVE-AREA-REFS>
                    <CAN-ENTER-EXCLUSIVE-AREA-REF DEST="EXCLUSIVE-AREA">/Cdd_Pwm_TI_AM261x/Cdd_Pwm/Cdd_Pwm_Behavior/PWM_EXCLUSIVE_AREA_0</CAN-ENTER-EXCLUSIVE-AREA-REF>
                  </CAN-ENTER-EXCLUSIVE-AREA-REFS>
                  <REENTRANCY-LEVEL>NON-REENTRANT</REENTRANCY-LEVEL>
                  <IMPLEMENTED-ENTRY-REF DEST="BSW-MODULE-ENTRY">/Cdd_Pwm_TI_AM261x/Cdd_Pwm_ModuleEntry/Cdd_Pwm_EtIntrClear</IMPLEMENTED-ENTRY-REF>
                </BSW-CALLED-ENTITY>
                <BSW-CALLED-ENTITY UUID="1148eaa8-f900-4e73-ad8c-3b2cf97e1f64">
                  <SHORT-NAME>Cdd_Pwm_EtIntrStatus</SHORT-NAME>
                  <CAN-ENTER-EXCLUSIVE-AREA-REFS>
                    <CAN-ENTER-EXCLUSIVE-AREA-REF DEST="EXCLUSIVE-AREA">/Cdd_Pwm_TI_AM261x/Cdd_Pwm/Cdd_Pwm_Behavior/PWM_EXCLUSIVE_AREA_0</CAN-ENTER-EXCLUSIVE-AREA-REF>
                  </CAN-ENTER-EXCLUSIVE-AREA-REFS>
                  <REENTRANCY-LEVEL>SINGLE-CORE-REENTRANT</REENTRANCY-LEVEL>
                  <IMPLEMENTED-ENTRY-REF DEST="BSW-MODULE-ENTRY">/Cdd_Pwm_TI_AM261x/Cdd_Pwm_ModuleEntry/Cdd_Pwm_EtIntrStatus</IMPLEMENTED-ENTRY-REF>
                </BSW-CALLED-ENTITY>
              [!LOOP "as:modconf('Cdd_Pwm')[1]/CddPwmConfigSet/*/CddPwmChannel/*"!]
              [!VAR "CddGroup" = "(num:i(substring-after(CddPwmGroupUnit,'CDD_PWM_CONTROLSS_G')))"!]
              [!VAR "CddChannel" = "(num:i(substring-after(CddPwmHwChannel,'CDD_PWM_CHANNEL_')))"!]
              [!IF "num:i($CddGroup) = '0'"!][!//
              [!IF "num:i($CddChannel) = '0'"!][!//
                <BSW-INTERRUPT-ENTITY UUID="63139a6f-a38a-449c-af3f-2d983fac8ed8">
                  <SHORT-NAME>Cdd_Pwm_G0_Ch0Isr</SHORT-NAME>
                  <REENTRANCY-LEVEL>NON-REENTRANT</REENTRANCY-LEVEL>
                  <IMPLEMENTED-ENTRY-REF DEST="BSW-MODULE-ENTRY">/Cdd_Pwm_TI_AM261x/Cdd_Pwm_ModuleEntry/Cdd_Pwm_G0_Ch0Isr</IMPLEMENTED-ENTRY-REF>
                [!IF "as:modconf('Cdd_Pwm')[1]/CddPwmGeneral/CddPwmTypeofInterruptFunction = 'CDD_PWM_ISR_CAT2'"!][!//
                  <INTERRUPT-CATEGORY>CAT-2</INTERRUPT-CATEGORY>
                [!ELSE!][!//
                  <INTERRUPT-CATEGORY>CAT-1</INTERRUPT-CATEGORY>
                [!ENDIF!][!//
                  <INTERRUPT-SOURCE>Hardware</INTERRUPT-SOURCE>
                </BSW-INTERRUPT-ENTITY>
              [!ENDIF!][!//
              [!IF "num:i($CddChannel) = '1'"!][!//
                <BSW-INTERRUPT-ENTITY UUID="2e067f35-ff64-42b5-948e-f79cfb628c73">
                  <SHORT-NAME>Cdd_Pwm_G0_Ch1Isr</SHORT-NAME>
                  <REENTRANCY-LEVEL>NON-REENTRANT</REENTRANCY-LEVEL>
                  <IMPLEMENTED-ENTRY-REF DEST="BSW-MODULE-ENTRY">/Cdd_Pwm_TI_AM261x/Cdd_Pwm_ModuleEntry/Cdd_Pwm_G0_Ch1Isr</IMPLEMENTED-ENTRY-REF>
                [!IF "as:modconf('Cdd_Pwm')[1]/CddPwmGeneral/CddPwmTypeofInterruptFunction = 'CDD_PWM_ISR_CAT2'"!][!//
                  <INTERRUPT-CATEGORY>CAT-2</INTERRUPT-CATEGORY>
                [!ELSE!][!//
                  <INTERRUPT-CATEGORY>CAT-1</INTERRUPT-CATEGORY>
                [!ENDIF!][!//
                  <INTERRUPT-SOURCE>Hardware</INTERRUPT-SOURCE>
                </BSW-INTERRUPT-ENTITY>
              [!ENDIF!][!//
              [!IF "num:i($CddChannel) = '2'"!][!//
                <BSW-INTERRUPT-ENTITY UUID="0b6d687b-0219-4a27-b2c2-f8beb392076b">
                  <SHORT-NAME>Cdd_Pwm_G0_Ch2Isr</SHORT-NAME>
                  <REENTRANCY-LEVEL>NON-REENTRANT</REENTRANCY-LEVEL>
                  <IMPLEMENTED-ENTRY-REF DEST="BSW-MODULE-ENTRY">/Cdd_Pwm_TI_AM261x/Cdd_Pwm_ModuleEntry/Cdd_Pwm_G0_Ch2Isr</IMPLEMENTED-ENTRY-REF>
                [!IF "as:modconf('Cdd_Pwm')[1]/CddPwmGeneral/CddPwmTypeofInterruptFunction = 'CDD_PWM_ISR_CAT2'"!][!//
                  <INTERRUPT-CATEGORY>CAT-2</INTERRUPT-CATEGORY>
                [!ELSE!][!//
                  <INTERRUPT-CATEGORY>CAT-1</INTERRUPT-CATEGORY>
                [!ENDIF!][!//
                  <INTERRUPT-SOURCE>Hardware</INTERRUPT-SOURCE>
                </BSW-INTERRUPT-ENTITY>
              [!ENDIF!][!//
              [!IF "num:i($CddChannel) = '3'"!][!//
                <BSW-INTERRUPT-ENTITY UUID="7e0e3327-9b81-4438-a395-fec38aae45ae">
                  <SHORT-NAME>Cdd_Pwm_G0_Ch3Isr</SHORT-NAME>
                  <REENTRANCY-LEVEL>NON-REENTRANT</REENTRANCY-LEVEL>
                  <IMPLEMENTED-ENTRY-REF DEST="BSW-MODULE-ENTRY">/Cdd_Pwm_TI_AM261x/Cdd_Pwm_ModuleEntry/Cdd_Pwm_G0_Ch3Isr</IMPLEMENTED-ENTRY-REF>
                [!IF "as:modconf('Cdd_Pwm')[1]/CddPwmGeneral/CddPwmTypeofInterruptFunction = 'CDD_PWM_ISR_CAT2'"!][!//
                  <INTERRUPT-CATEGORY>CAT-2</INTERRUPT-CATEGORY>
                [!ELSE!][!//
                  <INTERRUPT-CATEGORY>CAT-1</INTERRUPT-CATEGORY>
                [!ENDIF!][!//
                  <INTERRUPT-SOURCE>Hardware</INTERRUPT-SOURCE>
                </BSW-INTERRUPT-ENTITY>
              [!ENDIF!][!//
              [!IF "num:i($CddChannel) = '4'"!][!//
                <BSW-INTERRUPT-ENTITY UUID="f4064529-389b-4576-ae45-3218e94cfd7b">
                  <SHORT-NAME>Cdd_Pwm_G0_Ch4Isr</SHORT-NAME>
                  <REENTRANCY-LEVEL>NON-REENTRANT</REENTRANCY-LEVEL>
                  <IMPLEMENTED-ENTRY-REF DEST="BSW-MODULE-ENTRY">/Cdd_Pwm_TI_AM261x/Cdd_Pwm_ModuleEntry/Cdd_Pwm_G0_Ch4Isr</IMPLEMENTED-ENTRY-REF>
                [!IF "as:modconf('Cdd_Pwm')[1]/CddPwmGeneral/CddPwmTypeofInterruptFunction = 'CDD_PWM_ISR_CAT2'"!][!//
                  <INTERRUPT-CATEGORY>CAT-2</INTERRUPT-CATEGORY>
                [!ELSE!][!//
                  <INTERRUPT-CATEGORY>CAT-1</INTERRUPT-CATEGORY>
                [!ENDIF!][!//
                  <INTERRUPT-SOURCE>Hardware</INTERRUPT-SOURCE>
                </BSW-INTERRUPT-ENTITY>
              [!ENDIF!][!//
              [!IF "num:i($CddChannel) = '5'"!][!//
                <BSW-INTERRUPT-ENTITY UUID="f3bfd963-ac2e-4358-b436-ad92bd52afcc">
                  <SHORT-NAME>Cdd_Pwm_G0_Ch5Isr</SHORT-NAME>
                  <REENTRANCY-LEVEL>NON-REENTRANT</REENTRANCY-LEVEL>
                  <IMPLEMENTED-ENTRY-REF DEST="BSW-MODULE-ENTRY">/Cdd_Pwm_TI_AM261x/Cdd_Pwm_ModuleEntry/Cdd_Pwm_G0_Ch5Isr</IMPLEMENTED-ENTRY-REF>
                [!IF "as:modconf('Cdd_Pwm')[1]/CddPwmGeneral/CddPwmTypeofInterruptFunction = 'CDD_PWM_ISR_CAT2'"!][!//
                  <INTERRUPT-CATEGORY>CAT-2</INTERRUPT-CATEGORY>
                [!ELSE!][!//
                  <INTERRUPT-CATEGORY>CAT-1</INTERRUPT-CATEGORY>
                [!ENDIF!][!//
                  <INTERRUPT-SOURCE>Hardware</INTERRUPT-SOURCE>
                </BSW-INTERRUPT-ENTITY>
              [!ENDIF!][!//
              [!IF "num:i($CddChannel) = '6'"!][!//
                <BSW-INTERRUPT-ENTITY UUID="d5941174-51bd-4c19-a6e9-b53c99c64a23">
                  <SHORT-NAME>Cdd_Pwm_G0_Ch6Isr</SHORT-NAME>
                  <REENTRANCY-LEVEL>NON-REENTRANT</REENTRANCY-LEVEL>
                  <IMPLEMENTED-ENTRY-REF DEST="BSW-MODULE-ENTRY">/Cdd_Pwm_TI_AM261x/Cdd_Pwm_ModuleEntry/Cdd_Pwm_G0_Ch6Isr</IMPLEMENTED-ENTRY-REF>
                [!IF "as:modconf('Cdd_Pwm')[1]/CddPwmGeneral/CddPwmTypeofInterruptFunction = 'CDD_PWM_ISR_CAT2'"!][!//
                  <INTERRUPT-CATEGORY>CAT-2</INTERRUPT-CATEGORY>
                [!ELSE!][!//
                  <INTERRUPT-CATEGORY>CAT-1</INTERRUPT-CATEGORY>
                [!ENDIF!][!//
                  <INTERRUPT-SOURCE>Hardware</INTERRUPT-SOURCE>
                </BSW-INTERRUPT-ENTITY>
              [!ENDIF!][!//
              [!IF "num:i($CddChannel) = '7'"!][!//
                <BSW-INTERRUPT-ENTITY UUID="552aa5f0-bb47-40db-a0be-f861f555080e">
                  <SHORT-NAME>Cdd_Pwm_G0_Ch7Isr</SHORT-NAME>
                  <REENTRANCY-LEVEL>NON-REENTRANT</REENTRANCY-LEVEL>
                  <IMPLEMENTED-ENTRY-REF DEST="BSW-MODULE-ENTRY">/Cdd_Pwm_TI_AM261x/Cdd_Pwm_ModuleEntry/Cdd_Pwm_G0_Ch7Isr</IMPLEMENTED-ENTRY-REF>
                [!IF "as:modconf('Cdd_Pwm')[1]/CddPwmGeneral/CddPwmTypeofInterruptFunction = 'CDD_PWM_ISR_CAT2'"!][!//
                  <INTERRUPT-CATEGORY>CAT-2</INTERRUPT-CATEGORY>
                [!ELSE!][!//
                  <INTERRUPT-CATEGORY>CAT-1</INTERRUPT-CATEGORY>
                [!ENDIF!][!//
                  <INTERRUPT-SOURCE>Hardware</INTERRUPT-SOURCE>
                </BSW-INTERRUPT-ENTITY>
              [!ENDIF!][!//
              [!IF "num:i($CddChannel) = '8'"!][!//
                <BSW-INTERRUPT-ENTITY UUID="5981319f-670f-474b-9219-f1a689e92de8">
                  <SHORT-NAME>Cdd_Pwm_G0_Ch8Isr</SHORT-NAME>
                  <REENTRANCY-LEVEL>NON-REENTRANT</REENTRANCY-LEVEL>
                  <IMPLEMENTED-ENTRY-REF DEST="BSW-MODULE-ENTRY">/Cdd_Pwm_TI_AM261x/Cdd_Pwm_ModuleEntry/Cdd_Pwm_G0_Ch8Isr</IMPLEMENTED-ENTRY-REF>
                [!IF "as:modconf('Cdd_Pwm')[1]/CddPwmGeneral/CddPwmTypeofInterruptFunction = 'CDD_PWM_ISR_CAT2'"!][!//
                  <INTERRUPT-CATEGORY>CAT-2</INTERRUPT-CATEGORY>
                [!ELSE!][!//
                  <INTERRUPT-CATEGORY>CAT-1</INTERRUPT-CATEGORY>
                [!ENDIF!][!//
                  <INTERRUPT-SOURCE>Hardware</INTERRUPT-SOURCE>
                </BSW-INTERRUPT-ENTITY>
              [!ENDIF!][!//
              [!IF "num:i($CddChannel) = '9'"!][!//
                <BSW-INTERRUPT-ENTITY UUID="b0b5294a-34e0-4472-a812-d2fcc3d285e8">
                  <SHORT-NAME>Cdd_Pwm_G0_Ch9Isr</SHORT-NAME>
                  <REENTRANCY-LEVEL>NON-REENTRANT</REENTRANCY-LEVEL>
                  <IMPLEMENTED-ENTRY-REF DEST="BSW-MODULE-ENTRY">/Cdd_Pwm_TI_AM261x/Cdd_Pwm_ModuleEntry/Cdd_Pwm_G0_Ch9Isr</IMPLEMENTED-ENTRY-REF>
                [!IF "as:modconf('Cdd_Pwm')[1]/CddPwmGeneral/CddPwmTypeofInterruptFunction = 'CDD_PWM_ISR_CAT2'"!][!//
                  <INTERRUPT-CATEGORY>CAT-2</INTERRUPT-CATEGORY>
                [!ELSE!][!//
                  <INTERRUPT-CATEGORY>CAT-1</INTERRUPT-CATEGORY>
                [!ENDIF!][!//
                  <INTERRUPT-SOURCE>Hardware</INTERRUPT-SOURCE>
                </BSW-INTERRUPT-ENTITY>
              [!ENDIF!][!//
              [!IF "num:i($CddChannel) = '0'"!][!//
                <BSW-INTERRUPT-ENTITY UUID="d03d4552-3a3a-4af8-904a-ea76c9c17700">
                  <SHORT-NAME>Cdd_Pwm_G0_TzCh0Isr</SHORT-NAME>
                  <REENTRANCY-LEVEL>NON-REENTRANT</REENTRANCY-LEVEL>
                  <IMPLEMENTED-ENTRY-REF DEST="BSW-MODULE-ENTRY">/Cdd_Pwm_TI_AM261x/Cdd_Pwm_ModuleEntry/Cdd_Pwm_G0_TzCh0Isr</IMPLEMENTED-ENTRY-REF>
                [!IF "as:modconf('Cdd_Pwm')[1]/CddPwmGeneral/CddPwmTypeofInterruptFunction = 'CDD_PWM_ISR_CAT2'"!][!//
                  <INTERRUPT-CATEGORY>CAT-2</INTERRUPT-CATEGORY>
                [!ELSE!][!//
                  <INTERRUPT-CATEGORY>CAT-1</INTERRUPT-CATEGORY>
                [!ENDIF!][!//
                  <INTERRUPT-SOURCE>Hardware</INTERRUPT-SOURCE>
                </BSW-INTERRUPT-ENTITY>
              [!ENDIF!][!//
              [!IF "num:i($CddChannel) = '1'"!][!//
                <BSW-INTERRUPT-ENTITY UUID="50637d54-7edf-4f54-800a-86f7b1e2afda">
                  <SHORT-NAME>Cdd_Pwm_G0_TzCh1Isr</SHORT-NAME>
                  <REENTRANCY-LEVEL>NON-REENTRANT</REENTRANCY-LEVEL>
                  <IMPLEMENTED-ENTRY-REF DEST="BSW-MODULE-ENTRY">/Cdd_Pwm_TI_AM261x/Cdd_Pwm_ModuleEntry/Cdd_Pwm_G0_TzCh1Isr</IMPLEMENTED-ENTRY-REF>
                [!IF "as:modconf('Cdd_Pwm')[1]/CddPwmGeneral/CddPwmTypeofInterruptFunction = 'CDD_PWM_ISR_CAT2'"!][!//
                  <INTERRUPT-CATEGORY>CAT-2</INTERRUPT-CATEGORY>
                [!ELSE!][!//
                  <INTERRUPT-CATEGORY>CAT-1</INTERRUPT-CATEGORY>
                [!ENDIF!][!//
                  <INTERRUPT-SOURCE>Hardware</INTERRUPT-SOURCE>
                </BSW-INTERRUPT-ENTITY>
              [!ENDIF!][!//
              [!IF "num:i($CddChannel) = '2'"!][!//
                <BSW-INTERRUPT-ENTITY UUID="409bb255-93c1-433f-82d3-f651df47e24f">
                  <SHORT-NAME>Cdd_Pwm_G0_TzCh2Isr</SHORT-NAME>
                  <REENTRANCY-LEVEL>NON-REENTRANT</REENTRANCY-LEVEL>
                  <IMPLEMENTED-ENTRY-REF DEST="BSW-MODULE-ENTRY">/Cdd_Pwm_TI_AM261x/Cdd_Pwm_ModuleEntry/Cdd_Pwm_G0_TzCh2Isr</IMPLEMENTED-ENTRY-REF>
                [!IF "as:modconf('Cdd_Pwm')[1]/CddPwmGeneral/CddPwmTypeofInterruptFunction = 'CDD_PWM_ISR_CAT2'"!][!//
                  <INTERRUPT-CATEGORY>CAT-2</INTERRUPT-CATEGORY>
                [!ELSE!][!//
                  <INTERRUPT-CATEGORY>CAT-1</INTERRUPT-CATEGORY>
                [!ENDIF!][!//
                  <INTERRUPT-SOURCE>Hardware</INTERRUPT-SOURCE>
                </BSW-INTERRUPT-ENTITY>
              [!ENDIF!][!//
              [!IF "num:i($CddChannel) = '3'"!][!//
                <BSW-INTERRUPT-ENTITY UUID="284b8e67-4e19-4a0a-8ab7-ae344f070ecd">
                  <SHORT-NAME>Cdd_Pwm_G0_TzCh3Isr</SHORT-NAME>
                  <REENTRANCY-LEVEL>NON-REENTRANT</REENTRANCY-LEVEL>
                  <IMPLEMENTED-ENTRY-REF DEST="BSW-MODULE-ENTRY">/Cdd_Pwm_TI_AM261x/Cdd_Pwm_ModuleEntry/Cdd_Pwm_G0_TzCh3Isr</IMPLEMENTED-ENTRY-REF>
                [!IF "as:modconf('Cdd_Pwm')[1]/CddPwmGeneral/CddPwmTypeofInterruptFunction = 'CDD_PWM_ISR_CAT2'"!][!//
                  <INTERRUPT-CATEGORY>CAT-2</INTERRUPT-CATEGORY>
                [!ELSE!][!//
                  <INTERRUPT-CATEGORY>CAT-1</INTERRUPT-CATEGORY>
                [!ENDIF!][!//
                  <INTERRUPT-SOURCE>Hardware</INTERRUPT-SOURCE>
                </BSW-INTERRUPT-ENTITY>
              [!ENDIF!][!//
              [!IF "num:i($CddChannel) = '4'"!][!//
                <BSW-INTERRUPT-ENTITY UUID="8236d5e9-7f75-4ccd-adf8-6c31d17e772d">
                  <SHORT-NAME>Cdd_Pwm_G0_TzCh4Isr</SHORT-NAME>
                  <REENTRANCY-LEVEL>NON-REENTRANT</REENTRANCY-LEVEL>
                  <IMPLEMENTED-ENTRY-REF DEST="BSW-MODULE-ENTRY">/Cdd_Pwm_TI_AM261x/Cdd_Pwm_ModuleEntry/Cdd_Pwm_G0_TzCh4Isr</IMPLEMENTED-ENTRY-REF>
                [!IF "as:modconf('Cdd_Pwm')[1]/CddPwmGeneral/CddPwmTypeofInterruptFunction = 'CDD_PWM_ISR_CAT2'"!][!//
                  <INTERRUPT-CATEGORY>CAT-2</INTERRUPT-CATEGORY>
                [!ELSE!][!//
                  <INTERRUPT-CATEGORY>CAT-1</INTERRUPT-CATEGORY>
                [!ENDIF!][!//
                  <INTERRUPT-SOURCE>Hardware</INTERRUPT-SOURCE>
                </BSW-INTERRUPT-ENTITY>
              [!ENDIF!][!//
              [!IF "num:i($CddChannel) = '5'"!][!//
                <BSW-INTERRUPT-ENTITY UUID="35e011ad-0c5e-4506-b911-ac82ecc08e74">
                  <SHORT-NAME>Cdd_Pwm_G0_TzCh5Isr</SHORT-NAME>
                  <REENTRANCY-LEVEL>NON-REENTRANT</REENTRANCY-LEVEL>
                  <IMPLEMENTED-ENTRY-REF DEST="BSW-MODULE-ENTRY">/Cdd_Pwm_TI_AM261x/Cdd_Pwm_ModuleEntry/Cdd_Pwm_G0_TzCh5Isr</IMPLEMENTED-ENTRY-REF>
                [!IF "as:modconf('Cdd_Pwm')[1]/CddPwmGeneral/CddPwmTypeofInterruptFunction = 'CDD_PWM_ISR_CAT2'"!][!//
                  <INTERRUPT-CATEGORY>CAT-2</INTERRUPT-CATEGORY>
                [!ELSE!][!//
                  <INTERRUPT-CATEGORY>CAT-1</INTERRUPT-CATEGORY>
                [!ENDIF!][!//
                  <INTERRUPT-SOURCE>Hardware</INTERRUPT-SOURCE>
                </BSW-INTERRUPT-ENTITY>
              [!ENDIF!][!//
              [!IF "num:i($CddChannel) = '6'"!][!//
                <BSW-INTERRUPT-ENTITY UUID="c57f20ae-36ec-43fd-80df-18147f43892a">
                  <SHORT-NAME>Cdd_Pwm_G0_TzCh6Isr</SHORT-NAME>
                  <REENTRANCY-LEVEL>NON-REENTRANT</REENTRANCY-LEVEL>
                  <IMPLEMENTED-ENTRY-REF DEST="BSW-MODULE-ENTRY">/Cdd_Pwm_TI_AM261x/Cdd_Pwm_ModuleEntry/Cdd_Pwm_G0_TzCh6Isr</IMPLEMENTED-ENTRY-REF>
                [!IF "as:modconf('Cdd_Pwm')[1]/CddPwmGeneral/CddPwmTypeofInterruptFunction = 'CDD_PWM_ISR_CAT2'"!][!//
                  <INTERRUPT-CATEGORY>CAT-2</INTERRUPT-CATEGORY>
                [!ELSE!][!//
                  <INTERRUPT-CATEGORY>CAT-1</INTERRUPT-CATEGORY>
                [!ENDIF!][!//
                  <INTERRUPT-SOURCE>Hardware</INTERRUPT-SOURCE>
                </BSW-INTERRUPT-ENTITY>
              [!ENDIF!][!//
              [!IF "num:i($CddChannel) = '7'"!][!//
                <BSW-INTERRUPT-ENTITY UUID="7d85eb42-9a3c-4d5f-881d-7fb8cf77b839">
                  <SHORT-NAME>Cdd_Pwm_G0_TzCh7Isr</SHORT-NAME>
                  <REENTRANCY-LEVEL>NON-REENTRANT</REENTRANCY-LEVEL>
                  <IMPLEMENTED-ENTRY-REF DEST="BSW-MODULE-ENTRY">/Cdd_Pwm_TI_AM261x/Cdd_Pwm_ModuleEntry/Cdd_Pwm_G0_TzCh7Isr</IMPLEMENTED-ENTRY-REF>
                [!IF "as:modconf('Cdd_Pwm')[1]/CddPwmGeneral/CddPwmTypeofInterruptFunction = 'CDD_PWM_ISR_CAT2'"!][!//
                  <INTERRUPT-CATEGORY>CAT-2</INTERRUPT-CATEGORY>
                [!ELSE!][!//
                  <INTERRUPT-CATEGORY>CAT-1</INTERRUPT-CATEGORY>
                [!ENDIF!][!//
                  <INTERRUPT-SOURCE>Hardware</INTERRUPT-SOURCE>
                </BSW-INTERRUPT-ENTITY>
              [!ENDIF!][!//
              [!IF "num:i($CddChannel) = '8'"!][!//
                <BSW-INTERRUPT-ENTITY UUID="8365cdf7-bf4d-4864-a7a7-dcdce4778045">
                  <SHORT-NAME>Cdd_Pwm_G0_TzCh8Isr</SHORT-NAME>
                  <REENTRANCY-LEVEL>NON-REENTRANT</REENTRANCY-LEVEL>
                  <IMPLEMENTED-ENTRY-REF DEST="BSW-MODULE-ENTRY">/Cdd_Pwm_TI_AM261x/Cdd_Pwm_ModuleEntry/Cdd_Pwm_G0_TzCh8Isr</IMPLEMENTED-ENTRY-REF>
                [!IF "as:modconf('Cdd_Pwm')[1]/CddPwmGeneral/CddPwmTypeofInterruptFunction = 'CDD_PWM_ISR_CAT2'"!][!//
                  <INTERRUPT-CATEGORY>CAT-2</INTERRUPT-CATEGORY>
                [!ELSE!][!//
                  <INTERRUPT-CATEGORY>CAT-1</INTERRUPT-CATEGORY>
                [!ENDIF!][!//
                  <INTERRUPT-SOURCE>Hardware</INTERRUPT-SOURCE>
                </BSW-INTERRUPT-ENTITY>
              [!ENDIF!][!//
              [!IF "num:i($CddChannel) = '9'"!][!//
                <BSW-INTERRUPT-ENTITY UUID="9fc21e33-91dd-40d5-a83d-9358e514643d">
                  <SHORT-NAME>Cdd_Pwm_G0_TzCh9Isr</SHORT-NAME>
                  <REENTRANCY-LEVEL>NON-REENTRANT</REENTRANCY-LEVEL>
                  <IMPLEMENTED-ENTRY-REF DEST="BSW-MODULE-ENTRY">/Cdd_Pwm_TI_AM261x/Cdd_Pwm_ModuleEntry/Cdd_Pwm_G0_TzCh9Isr</IMPLEMENTED-ENTRY-REF>
                [!IF "as:modconf('Cdd_Pwm')[1]/CddPwmGeneral/CddPwmTypeofInterruptFunction = 'CDD_PWM_ISR_CAT2'"!][!//
                  <INTERRUPT-CATEGORY>CAT-2</INTERRUPT-CATEGORY>
                [!ELSE!][!//
                  <INTERRUPT-CATEGORY>CAT-1</INTERRUPT-CATEGORY>
                [!ENDIF!][!//
                  <INTERRUPT-SOURCE>Hardware</INTERRUPT-SOURCE>
                </BSW-INTERRUPT-ENTITY>
              [!ENDIF!][!//
              [!ELSEIF "num:i($CddGroup) = '1'"!][!//
              [!IF "num:i($CddChannel) = '0'"!][!//
                <BSW-INTERRUPT-ENTITY UUID="c503a4d6-1f38-4466-9e5f-6ac4f1fb9600">
                  <SHORT-NAME>Cdd_Pwm_G1_Ch0Isr</SHORT-NAME>
                  <REENTRANCY-LEVEL>NON-REENTRANT</REENTRANCY-LEVEL>
                  <IMPLEMENTED-ENTRY-REF DEST="BSW-MODULE-ENTRY">/Cdd_Pwm_TI_AM261x/Cdd_Pwm_ModuleEntry/Cdd_Pwm_G1_Ch0Isr</IMPLEMENTED-ENTRY-REF>
                [!IF "as:modconf('Cdd_Pwm')[1]/CddPwmGeneral/CddPwmTypeofInterruptFunction = 'CDD_PWM_ISR_CAT2'"!][!//
                  <INTERRUPT-CATEGORY>CAT-2</INTERRUPT-CATEGORY>
                [!ELSE!][!//
                  <INTERRUPT-CATEGORY>CAT-1</INTERRUPT-CATEGORY>
                [!ENDIF!][!//
                  <INTERRUPT-SOURCE>Hardware</INTERRUPT-SOURCE>
                </BSW-INTERRUPT-ENTITY>
              [!ENDIF!][!//
              [!IF "num:i($CddChannel) = '1'"!][!//
                <BSW-INTERRUPT-ENTITY UUID="baeeee79-4cb3-4e30-964f-b047b15d4404">
                  <SHORT-NAME>Cdd_Pwm_G1_Ch1Isr</SHORT-NAME>
                  <REENTRANCY-LEVEL>NON-REENTRANT</REENTRANCY-LEVEL>
                  <IMPLEMENTED-ENTRY-REF DEST="BSW-MODULE-ENTRY">/Cdd_Pwm_TI_AM261x/Cdd_Pwm_ModuleEntry/Cdd_Pwm_G1_Ch1Isr</IMPLEMENTED-ENTRY-REF>
                [!IF "as:modconf('Cdd_Pwm')[1]/CddPwmGeneral/CddPwmTypeofInterruptFunction = 'CDD_PWM_ISR_CAT2'"!][!//
                  <INTERRUPT-CATEGORY>CAT-2</INTERRUPT-CATEGORY>
                [!ELSE!][!//
                  <INTERRUPT-CATEGORY>CAT-1</INTERRUPT-CATEGORY>
                [!ENDIF!][!//
                  <INTERRUPT-SOURCE>Hardware</INTERRUPT-SOURCE>
                </BSW-INTERRUPT-ENTITY>
              [!ENDIF!][!//
              [!IF "num:i($CddChannel) = '2'"!][!//
                <BSW-INTERRUPT-ENTITY UUID="5709ac18-8dcc-454d-9035-b7407e7a9319">
                  <SHORT-NAME>Cdd_Pwm_G1_Ch2Isr</SHORT-NAME>
                  <REENTRANCY-LEVEL>NON-REENTRANT</REENTRANCY-LEVEL>
                  <IMPLEMENTED-ENTRY-REF DEST="BSW-MODULE-ENTRY">/Cdd_Pwm_TI_AM261x/Cdd_Pwm_ModuleEntry/Cdd_Pwm_G1_Ch2Isr</IMPLEMENTED-ENTRY-REF>
                [!IF "as:modconf('Cdd_Pwm')[1]/CddPwmGeneral/CddPwmTypeofInterruptFunction = 'CDD_PWM_ISR_CAT2'"!][!//
                  <INTERRUPT-CATEGORY>CAT-2</INTERRUPT-CATEGORY>
                [!ELSE!][!//
                  <INTERRUPT-CATEGORY>CAT-1</INTERRUPT-CATEGORY>
                [!ENDIF!][!//
                  <INTERRUPT-SOURCE>Hardware</INTERRUPT-SOURCE>
                </BSW-INTERRUPT-ENTITY>
              [!ENDIF!][!//
              [!IF "num:i($CddChannel) = '3'"!][!//
                <BSW-INTERRUPT-ENTITY UUID="a4395272-8549-46de-aec6-5fd2afece801">
                  <SHORT-NAME>Cdd_Pwm_G1_Ch3Isr</SHORT-NAME>
                  <REENTRANCY-LEVEL>NON-REENTRANT</REENTRANCY-LEVEL>
                  <IMPLEMENTED-ENTRY-REF DEST="BSW-MODULE-ENTRY">/Cdd_Pwm_TI_AM261x/Cdd_Pwm_ModuleEntry/Cdd_Pwm_G1_Ch3Isr</IMPLEMENTED-ENTRY-REF>
                [!IF "as:modconf('Cdd_Pwm')[1]/CddPwmGeneral/CddPwmTypeofInterruptFunction = 'CDD_PWM_ISR_CAT2'"!][!//
                  <INTERRUPT-CATEGORY>CAT-2</INTERRUPT-CATEGORY>
                [!ELSE!][!//
                  <INTERRUPT-CATEGORY>CAT-1</INTERRUPT-CATEGORY>
                [!ENDIF!][!//
                  <INTERRUPT-SOURCE>Hardware</INTERRUPT-SOURCE>
                </BSW-INTERRUPT-ENTITY>
              [!ENDIF!][!//
              [!IF "num:i($CddChannel) = '4'"!][!//
                <BSW-INTERRUPT-ENTITY UUID="ad5b5eea-c85a-4e7e-8445-454f28fc76d1">
                  <SHORT-NAME>Cdd_Pwm_G1_Ch4Isr</SHORT-NAME>
                  <REENTRANCY-LEVEL>NON-REENTRANT</REENTRANCY-LEVEL>
                  <IMPLEMENTED-ENTRY-REF DEST="BSW-MODULE-ENTRY">/Cdd_Pwm_TI_AM261x/Cdd_Pwm_ModuleEntry/Cdd_Pwm_G1_Ch4Isr</IMPLEMENTED-ENTRY-REF>
                [!IF "as:modconf('Cdd_Pwm')[1]/CddPwmGeneral/CddPwmTypeofInterruptFunction = 'CDD_PWM_ISR_CAT2'"!][!//
                  <INTERRUPT-CATEGORY>CAT-2</INTERRUPT-CATEGORY>
                [!ELSE!][!//
                  <INTERRUPT-CATEGORY>CAT-1</INTERRUPT-CATEGORY>
                [!ENDIF!][!//
                  <INTERRUPT-SOURCE>Hardware</INTERRUPT-SOURCE>
                </BSW-INTERRUPT-ENTITY>
              [!ENDIF!][!//
              [!IF "num:i($CddChannel) = '5'"!][!//
                <BSW-INTERRUPT-ENTITY UUID="07e3a7ce-ad40-4480-b6f4-a41e154965b0">
                  <SHORT-NAME>Cdd_Pwm_G1_Ch5Isr</SHORT-NAME>
                  <REENTRANCY-LEVEL>NON-REENTRANT</REENTRANCY-LEVEL>
                  <IMPLEMENTED-ENTRY-REF DEST="BSW-MODULE-ENTRY">/Cdd_Pwm_TI_AM261x/Cdd_Pwm_ModuleEntry/Cdd_Pwm_G1_Ch5Isr</IMPLEMENTED-ENTRY-REF>
                [!IF "as:modconf('Cdd_Pwm')[1]/CddPwmGeneral/CddPwmTypeofInterruptFunction = 'CDD_PWM_ISR_CAT2'"!][!//
                  <INTERRUPT-CATEGORY>CAT-2</INTERRUPT-CATEGORY>
                [!ELSE!][!//
                  <INTERRUPT-CATEGORY>CAT-1</INTERRUPT-CATEGORY>
                [!ENDIF!][!//
                  <INTERRUPT-SOURCE>Hardware</INTERRUPT-SOURCE>
                </BSW-INTERRUPT-ENTITY>
              [!ENDIF!][!//
              [!IF "num:i($CddChannel) = '6'"!][!//
                <BSW-INTERRUPT-ENTITY UUID="b5bfa310-1a5b-4126-ace7-230555fd713a">
                  <SHORT-NAME>Cdd_Pwm_G1_Ch6Isr</SHORT-NAME>
                  <REENTRANCY-LEVEL>NON-REENTRANT</REENTRANCY-LEVEL>
                  <IMPLEMENTED-ENTRY-REF DEST="BSW-MODULE-ENTRY">/Cdd_Pwm_TI_AM261x/Cdd_Pwm_ModuleEntry/Cdd_Pwm_G1_Ch6Isr</IMPLEMENTED-ENTRY-REF>
                [!IF "as:modconf('Cdd_Pwm')[1]/CddPwmGeneral/CddPwmTypeofInterruptFunction = 'CDD_PWM_ISR_CAT2'"!][!//
                  <INTERRUPT-CATEGORY>CAT-2</INTERRUPT-CATEGORY>
                [!ELSE!][!//
                  <INTERRUPT-CATEGORY>CAT-1</INTERRUPT-CATEGORY>
                [!ENDIF!][!//
                  <INTERRUPT-SOURCE>Hardware</INTERRUPT-SOURCE>
                </BSW-INTERRUPT-ENTITY>
              [!ENDIF!][!//
              [!IF "num:i($CddChannel) = '7'"!][!//
                <BSW-INTERRUPT-ENTITY UUID="76557256-295c-4fe9-b3b1-4e978285f707">
                  <SHORT-NAME>Cdd_Pwm_G1_Ch7Isr</SHORT-NAME>
                  <REENTRANCY-LEVEL>NON-REENTRANT</REENTRANCY-LEVEL>
                  <IMPLEMENTED-ENTRY-REF DEST="BSW-MODULE-ENTRY">/Cdd_Pwm_TI_AM261x/Cdd_Pwm_ModuleEntry/Cdd_Pwm_G1_Ch7Isr</IMPLEMENTED-ENTRY-REF>
                [!IF "as:modconf('Cdd_Pwm')[1]/CddPwmGeneral/CddPwmTypeofInterruptFunction = 'CDD_PWM_ISR_CAT2'"!][!//
                  <INTERRUPT-CATEGORY>CAT-2</INTERRUPT-CATEGORY>
                [!ELSE!][!//
                  <INTERRUPT-CATEGORY>CAT-1</INTERRUPT-CATEGORY>
                [!ENDIF!][!//
                  <INTERRUPT-SOURCE>Hardware</INTERRUPT-SOURCE>
                </BSW-INTERRUPT-ENTITY>
              [!ENDIF!][!//
              [!IF "num:i($CddChannel) = '8'"!][!//
                <BSW-INTERRUPT-ENTITY UUID="8097d590-62f1-405f-a404-897b9b7d4c4e">
                  <SHORT-NAME>Cdd_Pwm_G1_Ch8Isr</SHORT-NAME>
                  <REENTRANCY-LEVEL>NON-REENTRANT</REENTRANCY-LEVEL>
                  <IMPLEMENTED-ENTRY-REF DEST="BSW-MODULE-ENTRY">/Cdd_Pwm_TI_AM261x/Cdd_Pwm_ModuleEntry/Cdd_Pwm_G1_Ch8Isr</IMPLEMENTED-ENTRY-REF>
                [!IF "as:modconf('Cdd_Pwm')[1]/CddPwmGeneral/CddPwmTypeofInterruptFunction = 'CDD_PWM_ISR_CAT2'"!][!//
                  <INTERRUPT-CATEGORY>CAT-2</INTERRUPT-CATEGORY>
                [!ELSE!][!//
                  <INTERRUPT-CATEGORY>CAT-1</INTERRUPT-CATEGORY>
                [!ENDIF!][!//
                  <INTERRUPT-SOURCE>Hardware</INTERRUPT-SOURCE>
                </BSW-INTERRUPT-ENTITY>
              [!ENDIF!][!//
              [!IF "num:i($CddChannel) = '9'"!][!//
                <BSW-INTERRUPT-ENTITY UUID="a06d974e-225b-474a-9e18-13534d670708">
                  <SHORT-NAME>Cdd_Pwm_G1_Ch9Isr</SHORT-NAME>
                  <REENTRANCY-LEVEL>NON-REENTRANT</REENTRANCY-LEVEL>
                  <IMPLEMENTED-ENTRY-REF DEST="BSW-MODULE-ENTRY">/Cdd_Pwm_TI_AM261x/Cdd_Pwm_ModuleEntry/Cdd_Pwm_G1_Ch9Isr</IMPLEMENTED-ENTRY-REF>
                [!IF "as:modconf('Cdd_Pwm')[1]/CddPwmGeneral/CddPwmTypeofInterruptFunction = 'CDD_PWM_ISR_CAT2'"!][!//
                  <INTERRUPT-CATEGORY>CAT-2</INTERRUPT-CATEGORY>
                [!ELSE!][!//
                  <INTERRUPT-CATEGORY>CAT-1</INTERRUPT-CATEGORY>
                [!ENDIF!][!//
                  <INTERRUPT-SOURCE>Hardware</INTERRUPT-SOURCE>
                </BSW-INTERRUPT-ENTITY>
              [!ENDIF!][!//
              [!IF "num:i($CddChannel) = '0'"!][!//
                <BSW-INTERRUPT-ENTITY UUID="33cadb6c-8eae-415f-881e-f3449793f48a">
                  <SHORT-NAME>Cdd_Pwm_G1_TzCh0Isr</SHORT-NAME>
                  <REENTRANCY-LEVEL>NON-REENTRANT</REENTRANCY-LEVEL>
                  <IMPLEMENTED-ENTRY-REF DEST="BSW-MODULE-ENTRY">/Cdd_Pwm_TI_AM261x/Cdd_Pwm_ModuleEntry/Cdd_Pwm_G1_TzCh0Isr</IMPLEMENTED-ENTRY-REF>
                [!IF "as:modconf('Cdd_Pwm')[1]/CddPwmGeneral/CddPwmTypeofInterruptFunction = 'CDD_PWM_ISR_CAT2'"!][!//
                  <INTERRUPT-CATEGORY>CAT-2</INTERRUPT-CATEGORY>
                [!ELSE!][!//
                  <INTERRUPT-CATEGORY>CAT-1</INTERRUPT-CATEGORY>
                [!ENDIF!][!//
                  <INTERRUPT-SOURCE>Hardware</INTERRUPT-SOURCE>
                </BSW-INTERRUPT-ENTITY>
              [!ENDIF!][!//
              [!IF "num:i($CddChannel) = '1'"!][!//
                <BSW-INTERRUPT-ENTITY UUID="fb82291e-7240-4340-8dbd-6a58059542f4">
                  <SHORT-NAME>Cdd_Pwm_G1_TzCh1Isr</SHORT-NAME>
                  <REENTRANCY-LEVEL>NON-REENTRANT</REENTRANCY-LEVEL>
                  <IMPLEMENTED-ENTRY-REF DEST="BSW-MODULE-ENTRY">/Cdd_Pwm_TI_AM261x/Cdd_Pwm_ModuleEntry/Cdd_Pwm_G1_TzCh1Isr</IMPLEMENTED-ENTRY-REF>
                [!IF "as:modconf('Cdd_Pwm')[1]/CddPwmGeneral/CddPwmTypeofInterruptFunction = 'CDD_PWM_ISR_CAT2'"!][!//
                  <INTERRUPT-CATEGORY>CAT-2</INTERRUPT-CATEGORY>
                [!ELSE!][!//
                  <INTERRUPT-CATEGORY>CAT-1</INTERRUPT-CATEGORY>
                [!ENDIF!][!//
                  <INTERRUPT-SOURCE>Hardware</INTERRUPT-SOURCE>
                </BSW-INTERRUPT-ENTITY>
              [!ENDIF!][!//
              [!IF "num:i($CddChannel) = '2'"!][!//
                <BSW-INTERRUPT-ENTITY UUID="7f54cdff-b524-4034-a70a-ece430fa74d4">
                  <SHORT-NAME>Cdd_Pwm_G1_TzCh2Isr</SHORT-NAME>
                  <REENTRANCY-LEVEL>NON-REENTRANT</REENTRANCY-LEVEL>
                  <IMPLEMENTED-ENTRY-REF DEST="BSW-MODULE-ENTRY">/Cdd_Pwm_TI_AM261x/Cdd_Pwm_ModuleEntry/Cdd_Pwm_G1_TzCh2Isr</IMPLEMENTED-ENTRY-REF>
                [!IF "as:modconf('Cdd_Pwm')[1]/CddPwmGeneral/CddPwmTypeofInterruptFunction = 'CDD_PWM_ISR_CAT2'"!][!//
                  <INTERRUPT-CATEGORY>CAT-2</INTERRUPT-CATEGORY>
                [!ELSE!][!//
                  <INTERRUPT-CATEGORY>CAT-1</INTERRUPT-CATEGORY>
                [!ENDIF!][!//
                  <INTERRUPT-SOURCE>Hardware</INTERRUPT-SOURCE>
                </BSW-INTERRUPT-ENTITY>
              [!ENDIF!][!//
              [!IF "num:i($CddChannel) = '3'"!][!//
                <BSW-INTERRUPT-ENTITY UUID="ab6133ad-462d-4f7c-8a00-cd27c31e7276">
                  <SHORT-NAME>Cdd_Pwm_G1_TzCh3Isr</SHORT-NAME>
                  <REENTRANCY-LEVEL>NON-REENTRANT</REENTRANCY-LEVEL>
                  <IMPLEMENTED-ENTRY-REF DEST="BSW-MODULE-ENTRY">/Cdd_Pwm_TI_AM261x/Cdd_Pwm_ModuleEntry/Cdd_Pwm_G1_TzCh3Isr</IMPLEMENTED-ENTRY-REF>
                [!IF "as:modconf('Cdd_Pwm')[1]/CddPwmGeneral/CddPwmTypeofInterruptFunction = 'CDD_PWM_ISR_CAT2'"!][!//
                  <INTERRUPT-CATEGORY>CAT-2</INTERRUPT-CATEGORY>
                [!ELSE!][!//
                  <INTERRUPT-CATEGORY>CAT-1</INTERRUPT-CATEGORY>
                [!ENDIF!][!//
                  <INTERRUPT-SOURCE>Hardware</INTERRUPT-SOURCE>
                </BSW-INTERRUPT-ENTITY>
              [!ENDIF!][!//
              [!IF "num:i($CddChannel) = '4'"!][!//
                <BSW-INTERRUPT-ENTITY UUID="bb30e6b4-b731-4787-bdf0-cbe06416da0b">
                  <SHORT-NAME>Cdd_Pwm_G1_TzCh4Isr</SHORT-NAME>
                  <REENTRANCY-LEVEL>NON-REENTRANT</REENTRANCY-LEVEL>
                  <IMPLEMENTED-ENTRY-REF DEST="BSW-MODULE-ENTRY">/Cdd_Pwm_TI_AM261x/Cdd_Pwm_ModuleEntry/Cdd_Pwm_G1_TzCh4Isr</IMPLEMENTED-ENTRY-REF>
                [!IF "as:modconf('Cdd_Pwm')[1]/CddPwmGeneral/CddPwmTypeofInterruptFunction = 'CDD_PWM_ISR_CAT2'"!][!//
                  <INTERRUPT-CATEGORY>CAT-2</INTERRUPT-CATEGORY>
                [!ELSE!][!//
                  <INTERRUPT-CATEGORY>CAT-1</INTERRUPT-CATEGORY>
                [!ENDIF!][!//
                  <INTERRUPT-SOURCE>Hardware</INTERRUPT-SOURCE>
                </BSW-INTERRUPT-ENTITY>
              [!ENDIF!][!//
              [!IF "num:i($CddChannel) = '5'"!][!//
                <BSW-INTERRUPT-ENTITY UUID="07116d04-6ddc-4bea-a34a-439f37fe9af8">
                  <SHORT-NAME>Cdd_Pwm_G1_TzCh5Isr</SHORT-NAME>
                  <REENTRANCY-LEVEL>NON-REENTRANT</REENTRANCY-LEVEL>
                  <IMPLEMENTED-ENTRY-REF DEST="BSW-MODULE-ENTRY">/Cdd_Pwm_TI_AM261x/Cdd_Pwm_ModuleEntry/Cdd_Pwm_G1_TzCh5Isr</IMPLEMENTED-ENTRY-REF>
                [!IF "as:modconf('Cdd_Pwm')[1]/CddPwmGeneral/CddPwmTypeofInterruptFunction = 'CDD_PWM_ISR_CAT2'"!][!//
                  <INTERRUPT-CATEGORY>CAT-2</INTERRUPT-CATEGORY>
                [!ELSE!][!//
                  <INTERRUPT-CATEGORY>CAT-1</INTERRUPT-CATEGORY>
                [!ENDIF!][!//
                  <INTERRUPT-SOURCE>Hardware</INTERRUPT-SOURCE>
                </BSW-INTERRUPT-ENTITY>
              [!ENDIF!][!//
              [!IF "num:i($CddChannel) = '6'"!][!//
                <BSW-INTERRUPT-ENTITY UUID="d556c00a-dbdb-4197-9b4f-d5311436f384">
                  <SHORT-NAME>Cdd_Pwm_G1_TzCh6Isr</SHORT-NAME>
                  <REENTRANCY-LEVEL>NON-REENTRANT</REENTRANCY-LEVEL>
                  <IMPLEMENTED-ENTRY-REF DEST="BSW-MODULE-ENTRY">/Cdd_Pwm_TI_AM261x/Cdd_Pwm_ModuleEntry/Cdd_Pwm_G1_TzCh6Isr</IMPLEMENTED-ENTRY-REF>
                [!IF "as:modconf('Cdd_Pwm')[1]/CddPwmGeneral/CddPwmTypeofInterruptFunction = 'CDD_PWM_ISR_CAT2'"!][!//
                  <INTERRUPT-CATEGORY>CAT-2</INTERRUPT-CATEGORY>
                [!ELSE!][!//
                  <INTERRUPT-CATEGORY>CAT-1</INTERRUPT-CATEGORY>
                [!ENDIF!][!//
                  <INTERRUPT-SOURCE>Hardware</INTERRUPT-SOURCE>
                </BSW-INTERRUPT-ENTITY>
              [!ENDIF!][!//
              [!IF "num:i($CddChannel) = '7'"!][!//
                <BSW-INTERRUPT-ENTITY UUID="93bb7e1f-d666-48af-9119-1341ecd31a51">
                  <SHORT-NAME>Cdd_Pwm_G1_TzCh7Isr</SHORT-NAME>
                  <REENTRANCY-LEVEL>NON-REENTRANT</REENTRANCY-LEVEL>
                  <IMPLEMENTED-ENTRY-REF DEST="BSW-MODULE-ENTRY">/Cdd_Pwm_TI_AM261x/Cdd_Pwm_ModuleEntry/Cdd_Pwm_G1_TzCh7Isr</IMPLEMENTED-ENTRY-REF>
                [!IF "as:modconf('Cdd_Pwm')[1]/CddPwmGeneral/CddPwmTypeofInterruptFunction = 'CDD_PWM_ISR_CAT2'"!][!//
                  <INTERRUPT-CATEGORY>CAT-2</INTERRUPT-CATEGORY>
                [!ELSE!][!//
                  <INTERRUPT-CATEGORY>CAT-1</INTERRUPT-CATEGORY>
                [!ENDIF!][!//
                  <INTERRUPT-SOURCE>Hardware</INTERRUPT-SOURCE>
                </BSW-INTERRUPT-ENTITY>
              [!ENDIF!][!//
              [!IF "num:i($CddChannel) = '8'"!][!//
                <BSW-INTERRUPT-ENTITY UUID="f52e17c8-c9df-4a6d-9714-0b3c7d9d6081">
                  <SHORT-NAME>Cdd_Pwm_G1_TzCh8Isr</SHORT-NAME>
                  <REENTRANCY-LEVEL>NON-REENTRANT</REENTRANCY-LEVEL>
                  <IMPLEMENTED-ENTRY-REF DEST="BSW-MODULE-ENTRY">/Cdd_Pwm_TI_AM261x/Cdd_Pwm_ModuleEntry/Cdd_Pwm_G1_TzCh8Isr</IMPLEMENTED-ENTRY-REF>
                [!IF "as:modconf('Cdd_Pwm')[1]/CddPwmGeneral/CddPwmTypeofInterruptFunction = 'CDD_PWM_ISR_CAT2'"!][!//
                  <INTERRUPT-CATEGORY>CAT-2</INTERRUPT-CATEGORY>
                [!ELSE!][!//
                  <INTERRUPT-CATEGORY>CAT-1</INTERRUPT-CATEGORY>
                [!ENDIF!][!//
                  <INTERRUPT-SOURCE>Hardware</INTERRUPT-SOURCE>
                </BSW-INTERRUPT-ENTITY>
              [!ENDIF!][!//
              [!IF "num:i($CddChannel) = '9'"!][!//
                <BSW-INTERRUPT-ENTITY UUID="12f8f097-4835-4dd9-8791-345bf641d84c">
                  <SHORT-NAME>Cdd_Pwm_G1_TzCh9Isr</SHORT-NAME>
                  <REENTRANCY-LEVEL>NON-REENTRANT</REENTRANCY-LEVEL>
                  <IMPLEMENTED-ENTRY-REF DEST="BSW-MODULE-ENTRY">/Cdd_Pwm_TI_AM261x/Cdd_Pwm_ModuleEntry/Cdd_Pwm_G1_TzCh9Isr</IMPLEMENTED-ENTRY-REF>
                [!IF "as:modconf('Cdd_Pwm')[1]/CddPwmGeneral/CddPwmTypeofInterruptFunction = 'CDD_PWM_ISR_CAT2'"!][!//
                  <INTERRUPT-CATEGORY>CAT-2</INTERRUPT-CATEGORY>
                [!ELSE!][!//
                  <INTERRUPT-CATEGORY>CAT-1</INTERRUPT-CATEGORY>
                [!ENDIF!][!//
                  <INTERRUPT-SOURCE>Hardware</INTERRUPT-SOURCE>
                </BSW-INTERRUPT-ENTITY>
              [!ENDIF!][!//
              [!ENDIF!][!//
              [!ENDLOOP!][!//
              [!IF "as:modconf('Cdd_Pwm')[1]/CddPwmConfigurationOfOptionalApis/CddPwmGetCounterApi"!][!//
                <BSW-CALLED-ENTITY UUID="7d85106d-5f44-4a41-9a0d-3cf7fd41cd52">
                  <SHORT-NAME>Cdd_Pwm_GetCounter</SHORT-NAME>
                  <CAN-ENTER-EXCLUSIVE-AREA-REFS>
                    <CAN-ENTER-EXCLUSIVE-AREA-REF DEST="EXCLUSIVE-AREA">/Cdd_Pwm_TI_AM261x/Cdd_Pwm/Cdd_Pwm_Behavior/PWM_EXCLUSIVE_AREA_0</CAN-ENTER-EXCLUSIVE-AREA-REF>
                  </CAN-ENTER-EXCLUSIVE-AREA-REFS>
                  <REENTRANCY-LEVEL>SINGLE-CORE-REENTRANT</REENTRANCY-LEVEL>
                [!IF "as:modconf('Cdd_Pwm')[1]/CddPwmGeneral/CddPwmDevErrorDetect"!][!//
                  <CALL-POINTS>
                    <BSW-DIRECT-CALL-POINT>
                      <SHORT-NAME>Det</SHORT-NAME>
                      <CALLED-ENTRY-REF DEST="BSW-MODULE-ENTRY">/AUTOSAR_Det/BSWModuleEntry/Det_ReportError</CALLED-ENTRY-REF>
                    </BSW-DIRECT-CALL-POINT>
                  </CALL-POINTS>
                [!ENDIF!][!//
                  <IMPLEMENTED-ENTRY-REF DEST="BSW-MODULE-ENTRY">/Cdd_Pwm_TI_AM261x/Cdd_Pwm_ModuleEntry/Cdd_Pwm_GetCounter</IMPLEMENTED-ENTRY-REF>
                </BSW-CALLED-ENTITY>
              [!ENDIF!][!//
              [!IF "as:modconf('Cdd_Pwm')[1]/CddPwmConfigurationOfOptionalApis/CddPwmGetCounterStatus"!][!//
                <BSW-CALLED-ENTITY UUID="f05f12c9-092a-4072-963e-4d4f62932f5e">
                  <SHORT-NAME>Cdd_Pwm_GetCounterStatus</SHORT-NAME>
                  <REENTRANCY-LEVEL>SINGLE-CORE-REENTRANT</REENTRANCY-LEVEL>
                  <IMPLEMENTED-ENTRY-REF DEST="BSW-MODULE-ENTRY">/Cdd_Pwm_TI_AM261x/Cdd_Pwm_ModuleEntry/Cdd_Pwm_GetCounterStatus</IMPLEMENTED-ENTRY-REF>
                </BSW-CALLED-ENTITY>
              [!ENDIF!][!//
              [!IF "as:modconf('Cdd_Pwm')[1]/CddPwmConfigurationOfOptionalApis/CddPwmVersionInfoApi"!][!//
                <BSW-CALLED-ENTITY UUID="7db2b452-9134-4012-a79f-7d8af50423fa">
                  <SHORT-NAME>Cdd_Pwm_GetVersionInfo</SHORT-NAME>
                  <REENTRANCY-LEVEL>SINGLE-CORE-REENTRANT</REENTRANCY-LEVEL>
                [!IF "as:modconf('Cdd_Pwm')[1]/CddPwmGeneral/CddPwmDevErrorDetect"!][!//
                  <CALL-POINTS>
                    <BSW-DIRECT-CALL-POINT>
                      <SHORT-NAME>Det</SHORT-NAME>
                      <CALLED-ENTRY-REF DEST="BSW-MODULE-ENTRY">/AUTOSAR_Det/BSWModuleEntry/Det_ReportError</CALLED-ENTRY-REF>
                    </BSW-DIRECT-CALL-POINT>
                  </CALL-POINTS>
                [!ENDIF!][!//
                  <IMPLEMENTED-ENTRY-REF DEST="BSW-MODULE-ENTRY">/Cdd_Pwm_TI_AM261x/Cdd_Pwm_ModuleEntry/Cdd_Pwm_GetVersionInfo</IMPLEMENTED-ENTRY-REF>
                </BSW-CALLED-ENTITY>
              [!ENDIF!][!//
              [!IF "as:modconf('Cdd_Pwm')[1]/CddPwmGeneral/CddPwmHrSetPeriodDutyEnable"!][!//
                <BSW-CALLED-ENTITY UUID="a7c22435-e947-4060-8544-7e111dddb4a3">
                  <SHORT-NAME>Cdd_Pwm_HrSetPeriodDutyPhase</SHORT-NAME>
                  <CAN-ENTER-EXCLUSIVE-AREA-REFS>
                    <CAN-ENTER-EXCLUSIVE-AREA-REF DEST="EXCLUSIVE-AREA">/Cdd_Pwm_TI_AM261x/Cdd_Pwm/Cdd_Pwm_Behavior/PWM_EXCLUSIVE_AREA_0</CAN-ENTER-EXCLUSIVE-AREA-REF>
                  </CAN-ENTER-EXCLUSIVE-AREA-REFS>
                  <REENTRANCY-LEVEL>NON-REENTRANT</REENTRANCY-LEVEL>
                [!IF "as:modconf('Cdd_Pwm')[1]/CddPwmGeneral/CddPwmDevErrorDetect"!][!//
                  <CALL-POINTS>
                    <BSW-DIRECT-CALL-POINT>
                      <SHORT-NAME>Det</SHORT-NAME>
                      <CALLED-ENTRY-REF DEST="BSW-MODULE-ENTRY">/AUTOSAR_Det/BSWModuleEntry/Det_ReportError</CALLED-ENTRY-REF>
                    </BSW-DIRECT-CALL-POINT>
                  </CALL-POINTS>
                [!ENDIF!][!//
                  <IMPLEMENTED-ENTRY-REF DEST="BSW-MODULE-ENTRY">/Cdd_Pwm_TI_AM261x/Cdd_Pwm_ModuleEntry/Cdd_Pwm_HrSetPeriodDutyPhase</IMPLEMENTED-ENTRY-REF>
                </BSW-CALLED-ENTITY>
				<BSW-CALLED-ENTITY UUID="77b338a9-06bd-45b5-9d56-23fb1f86fcb6">
				<SHORT-NAME>Cdd_Pwm_HrSetPhaseShift</SHORT-NAME>
                  <REENTRANCY-LEVEL>NON-REENTRANT</REENTRANCY-LEVEL>
                  <IMPLEMENTED-ENTRY-REF DEST="BSW-MODULE-ENTRY">/Cdd_Pwm_TI_AM261x/Cdd_Pwm_ModuleEntry/Cdd_Pwm_HrSetPhaseShift</IMPLEMENTED-ENTRY-REF>
                </BSW-CALLED-ENTITY>
				<BSW-CALLED-ENTITY UUID="3eb35bcf-5b9c-4f9a-81df-a1ea19396c5d">
                  <SHORT-NAME>Cdd_Pwm_HrSetTimeBasePeriod</SHORT-NAME>
                  <REENTRANCY-LEVEL>NON-REENTRANT</REENTRANCY-LEVEL>
                  <IMPLEMENTED-ENTRY-REF DEST="BSW-MODULE-ENTRY">/Cdd_Pwm_TI_AM261x/Cdd_Pwm_ModuleEntry/Cdd_Pwm_HrSetTimeBasePeriod</IMPLEMENTED-ENTRY-REF>
                </BSW-CALLED-ENTITY>
				<BSW-CALLED-ENTITY UUID="dba81430-e18f-4be3-acb2-c9c433a43faf">
                  <SHORT-NAME>Cdd_Pwm_HrSetCounterCompareValue</SHORT-NAME>
                  <REENTRANCY-LEVEL>NON-REENTRANT</REENTRANCY-LEVEL>
                  <IMPLEMENTED-ENTRY-REF DEST="BSW-MODULE-ENTRY">/Cdd_Pwm_TI_AM261x/Cdd_Pwm_ModuleEntry/Cdd_Pwm_HrSetCounterCompareValue</IMPLEMENTED-ENTRY-REF>
                </BSW-CALLED-ENTITY>
				<BSW-CALLED-ENTITY UUID="9daf891c-dadb-4c7c-b577-992eac9bd2c2">
                  <SHORT-NAME>Cdd_Pwm_HrSetXcmpRegValue</SHORT-NAME>
                  <REENTRANCY-LEVEL>NON-REENTRANT</REENTRANCY-LEVEL>
                  <IMPLEMENTED-ENTRY-REF DEST="BSW-MODULE-ENTRY">/Cdd_Pwm_TI_AM261x/Cdd_Pwm_ModuleEntry/Cdd_Pwm_HrSetXcmpRegValue</IMPLEMENTED-ENTRY-REF>
                </BSW-CALLED-ENTITY>
              [!ENDIF!][!//
              [!IF "as:modconf('Cdd_Pwm')[1]/CddPwmGeneral/CddPwmHrSfoCalibrationEnable"!][!//
                <BSW-CALLED-ENTITY UUID="b8417436-c994-4ae0-8478-c133581ca5d1">
                  <SHORT-NAME>Cdd_Pwm_HrSfoCalibration</SHORT-NAME>
                  <CAN-ENTER-EXCLUSIVE-AREA-REFS>
                    <CAN-ENTER-EXCLUSIVE-AREA-REF DEST="EXCLUSIVE-AREA">/Cdd_Pwm_TI_AM261x/Cdd_Pwm/Cdd_Pwm_Behavior/PWM_EXCLUSIVE_AREA_0</CAN-ENTER-EXCLUSIVE-AREA-REF>
                  </CAN-ENTER-EXCLUSIVE-AREA-REFS>
                  <REENTRANCY-LEVEL>NON-REENTRANT</REENTRANCY-LEVEL>
                [!IF "as:modconf('Cdd_Pwm')[1]/CddPwmGeneral/CddPwmDevErrorDetect"!][!//
                  <CALL-POINTS>
                    <BSW-DIRECT-CALL-POINT>
                      <SHORT-NAME>Det</SHORT-NAME>
                      <CALLED-ENTRY-REF DEST="BSW-MODULE-ENTRY">/AUTOSAR_Det/BSWModuleEntry/Det_ReportError</CALLED-ENTRY-REF>
                    </BSW-DIRECT-CALL-POINT>
                  </CALL-POINTS>
                [!ENDIF!][!//
                  <IMPLEMENTED-ENTRY-REF DEST="BSW-MODULE-ENTRY">/Cdd_Pwm_TI_AM261x/Cdd_Pwm_ModuleEntry/Cdd_Pwm_HrSfoCalibration</IMPLEMENTED-ENTRY-REF>
                </BSW-CALLED-ENTITY>
              [!ENDIF!][!//
              [!IF "as:modconf('Cdd_Pwm')[1]/CddPwmGeneral/CddPwmHrSfoStatusEnable"!][!//
                <BSW-CALLED-ENTITY UUID="3f1e05b2-2ee4-4f07-9fec-9184871e0fc9">
                  <SHORT-NAME>Cdd_Pwm_HrSfoStatus</SHORT-NAME>
                  <CAN-ENTER-EXCLUSIVE-AREA-REFS>
                    <CAN-ENTER-EXCLUSIVE-AREA-REF DEST="EXCLUSIVE-AREA">/Cdd_Pwm_TI_AM261x/Cdd_Pwm/Cdd_Pwm_Behavior/PWM_EXCLUSIVE_AREA_0</CAN-ENTER-EXCLUSIVE-AREA-REF>
                  </CAN-ENTER-EXCLUSIVE-AREA-REFS>
                  <REENTRANCY-LEVEL>SINGLE-CORE-REENTRANT</REENTRANCY-LEVEL>
                [!IF "as:modconf('Cdd_Pwm')[1]/CddPwmGeneral/CddPwmDevErrorDetect"!][!//
                  <CALL-POINTS>
                    <BSW-DIRECT-CALL-POINT>
                      <SHORT-NAME>Det</SHORT-NAME>
                      <CALLED-ENTRY-REF DEST="BSW-MODULE-ENTRY">/AUTOSAR_Det/BSWModuleEntry/Det_ReportError</CALLED-ENTRY-REF>
                    </BSW-DIRECT-CALL-POINT>
                  </CALL-POINTS>
                [!ENDIF!][!//
                  <IMPLEMENTED-ENTRY-REF DEST="BSW-MODULE-ENTRY">/Cdd_Pwm_TI_AM261x/Cdd_Pwm_ModuleEntry/Cdd_Pwm_HrSfoStatus</IMPLEMENTED-ENTRY-REF>
                </BSW-CALLED-ENTITY>
              [!ENDIF!][!//
                <BSW-CALLED-ENTITY UUID="809716a8-9a23-4fbb-89ea-b4c4c04aef34">
                  <SHORT-NAME>Cdd_Pwm_Init</SHORT-NAME>
                  <REENTRANCY-LEVEL>NON-REENTRANT</REENTRANCY-LEVEL>
                [!IF "as:modconf('Cdd_Pwm')[1]/CddPwmGeneral/CddPwmDevErrorDetect"!][!//
                  <CALL-POINTS>
                    <BSW-DIRECT-CALL-POINT>
                      <SHORT-NAME>Det</SHORT-NAME>
                      <CALLED-ENTRY-REF DEST="BSW-MODULE-ENTRY">/AUTOSAR_Det/BSWModuleEntry/Det_ReportError</CALLED-ENTRY-REF>
                    </BSW-DIRECT-CALL-POINT>
                  </CALL-POINTS>
                [!ENDIF!][!//
                  <IMPLEMENTED-ENTRY-REF DEST="BSW-MODULE-ENTRY">/Cdd_Pwm_TI_AM261x/Cdd_Pwm_ModuleEntry/Cdd_Pwm_Init</IMPLEMENTED-ENTRY-REF>
                </BSW-CALLED-ENTITY>
              [!IF "as:modconf('Cdd_Pwm')[1]/CddPwmConfigurationOfOptionalApis/CddPwmEnableRegisterReadbackApi"!][!//
                <BSW-CALLED-ENTITY UUID="3af20b70-0db9-4ba5-8820-7d4757febf5f">
                  <SHORT-NAME>Cdd_Pwm_RegisterReadback</SHORT-NAME>
                  <REENTRANCY-LEVEL>NON-REENTRANT</REENTRANCY-LEVEL>
                [!IF "as:modconf('Cdd_Pwm')[1]/CddPwmGeneral/CddPwmDevErrorDetect"!][!//
                  <CALL-POINTS>
                    <BSW-DIRECT-CALL-POINT>
                      <SHORT-NAME>Det</SHORT-NAME>
                      <CALLED-ENTRY-REF DEST="BSW-MODULE-ENTRY">/AUTOSAR_Det/BSWModuleEntry/Det_ReportError</CALLED-ENTRY-REF>
                    </BSW-DIRECT-CALL-POINT>
                  </CALL-POINTS>
                [!ENDIF!][!//
                  <IMPLEMENTED-ENTRY-REF DEST="BSW-MODULE-ENTRY">/Cdd_Pwm_TI_AM261x/Cdd_Pwm_ModuleEntry/Cdd_Pwm_RegisterReadback</IMPLEMENTED-ENTRY-REF>
                </BSW-CALLED-ENTITY>
              [!ENDIF!][!//
              [!IF "as:modconf('Cdd_Pwm')[1]/CddPwmConfigurationOfOptionalApis/CddPwmSetAbsoluteThreshold"!][!//
                <BSW-CALLED-ENTITY UUID="35236871-7084-4324-b749-5083db864102">
                  <SHORT-NAME>Cdd_Pwm_SetAbsoluteThreshold</SHORT-NAME>
                  <CAN-ENTER-EXCLUSIVE-AREA-REFS>
                    <CAN-ENTER-EXCLUSIVE-AREA-REF DEST="EXCLUSIVE-AREA">/Cdd_Pwm_TI_AM261x/Cdd_Pwm/Cdd_Pwm_Behavior/PWM_EXCLUSIVE_AREA_0</CAN-ENTER-EXCLUSIVE-AREA-REF>
                  </CAN-ENTER-EXCLUSIVE-AREA-REFS>
                  <REENTRANCY-LEVEL>NON-REENTRANT</REENTRANCY-LEVEL>
                [!IF "as:modconf('Cdd_Pwm')[1]/CddPwmGeneral/CddPwmDevErrorDetect"!][!//
                  <CALL-POINTS>
                    <BSW-DIRECT-CALL-POINT>
                      <SHORT-NAME>Det</SHORT-NAME>
                      <CALLED-ENTRY-REF DEST="BSW-MODULE-ENTRY">/AUTOSAR_Det/BSWModuleEntry/Det_ReportError</CALLED-ENTRY-REF>
                    </BSW-DIRECT-CALL-POINT>
                  </CALL-POINTS>
                [!ENDIF!][!//
                  <IMPLEMENTED-ENTRY-REF DEST="BSW-MODULE-ENTRY">/Cdd_Pwm_TI_AM261x/Cdd_Pwm_ModuleEntry/Cdd_Pwm_SetAbsoluteThreshold</IMPLEMENTED-ENTRY-REF>
                </BSW-CALLED-ENTITY>
              [!ENDIF!][!//
              [!IF "as:modconf('Cdd_Pwm')[1]/CddPwmConfigurationOfOptionalApis/CddPwmSetAdcTriggerApi"!][!//
                <BSW-CALLED-ENTITY UUID="739d0d15-6a93-4811-8957-40c275400b58">
                  <SHORT-NAME>Cdd_Pwm_SetAdcTrigger</SHORT-NAME>
                  <CAN-ENTER-EXCLUSIVE-AREA-REFS>
                    <CAN-ENTER-EXCLUSIVE-AREA-REF DEST="EXCLUSIVE-AREA">/Cdd_Pwm_TI_AM261x/Cdd_Pwm/Cdd_Pwm_Behavior/PWM_EXCLUSIVE_AREA_0</CAN-ENTER-EXCLUSIVE-AREA-REF>
                  </CAN-ENTER-EXCLUSIVE-AREA-REFS>
                  <REENTRANCY-LEVEL>NON-REENTRANT</REENTRANCY-LEVEL>
                  <IMPLEMENTED-ENTRY-REF DEST="BSW-MODULE-ENTRY">/Cdd_Pwm_TI_AM261x/Cdd_Pwm_ModuleEntry/Cdd_Pwm_SetAdcTrigger</IMPLEMENTED-ENTRY-REF>
                </BSW-CALLED-ENTITY>
              [!ENDIF!][!//
              [!IF "as:modconf('Cdd_Pwm')[1]/CddPwmConfigurationOfOptionalApis/CddPwmSetOutputToIdle"!][!//
                <BSW-CALLED-ENTITY UUID="55826993-91fa-4952-90aa-cff867b3ee34">
                  <SHORT-NAME>Cdd_Pwm_SetOutputToIdle</SHORT-NAME>
                  <CAN-ENTER-EXCLUSIVE-AREA-REFS>
                    <CAN-ENTER-EXCLUSIVE-AREA-REF DEST="EXCLUSIVE-AREA">/Cdd_Pwm_TI_AM261x/Cdd_Pwm/Cdd_Pwm_Behavior/PWM_EXCLUSIVE_AREA_0</CAN-ENTER-EXCLUSIVE-AREA-REF>
                  </CAN-ENTER-EXCLUSIVE-AREA-REFS>
                  <REENTRANCY-LEVEL>NON-REENTRANT</REENTRANCY-LEVEL>
                  <IMPLEMENTED-ENTRY-REF DEST="BSW-MODULE-ENTRY">/Cdd_Pwm_TI_AM261x/Cdd_Pwm_ModuleEntry/Cdd_Pwm_SetOutputToIdle</IMPLEMENTED-ENTRY-REF>
                </BSW-CALLED-ENTITY>
              [!ENDIF!][!//
              [!IF "as:modconf('Cdd_Pwm')[1]/CddPwmConfigurationOfOptionalApis/CddPwmSetPeriodDutyPhase"!][!//
                <BSW-CALLED-ENTITY UUID="506a2c70-208c-4d94-9af4-9e99fdda1da8">
                  <SHORT-NAME>Cdd_Pwm_SetPeriodDutyPhase</SHORT-NAME>
                  <CAN-ENTER-EXCLUSIVE-AREA-REFS>
                    <CAN-ENTER-EXCLUSIVE-AREA-REF DEST="EXCLUSIVE-AREA">/Cdd_Pwm_TI_AM261x/Cdd_Pwm/Cdd_Pwm_Behavior/PWM_EXCLUSIVE_AREA_0</CAN-ENTER-EXCLUSIVE-AREA-REF>
                  </CAN-ENTER-EXCLUSIVE-AREA-REFS>
                  <REENTRANCY-LEVEL>NON-REENTRANT</REENTRANCY-LEVEL>
                  <IMPLEMENTED-ENTRY-REF DEST="BSW-MODULE-ENTRY">/Cdd_Pwm_TI_AM261x/Cdd_Pwm_ModuleEntry/Cdd_Pwm_SetPeriodDutyPhase</IMPLEMENTED-ENTRY-REF>
                </BSW-CALLED-ENTITY>
				<BSW-CALLED-ENTITY UUID="01658c65-ed93-4570-96dd-1c0e0af0e10a">
                  <SHORT-NAME>Cdd_Pwm_SetTimeBaseCounterMode</SHORT-NAME>
                  <CAN-ENTER-EXCLUSIVE-AREA-REFS>
                    <CAN-ENTER-EXCLUSIVE-AREA-REF DEST="EXCLUSIVE-AREA">/Cdd_Pwm_TI_AM261x/Cdd_Pwm/Cdd_Pwm_Behavior/PWM_EXCLUSIVE_AREA_0</CAN-ENTER-EXCLUSIVE-AREA-REF>
                  </CAN-ENTER-EXCLUSIVE-AREA-REFS>
                  <REENTRANCY-LEVEL>NON-REENTRANT</REENTRANCY-LEVEL>
                  <IMPLEMENTED-ENTRY-REF DEST="BSW-MODULE-ENTRY">/Cdd_Pwm_TI_AM261x/Cdd_Pwm_ModuleEntry/Cdd_Pwm_SetTimeBaseCounterMode</IMPLEMENTED-ENTRY-REF>
                </BSW-CALLED-ENTITY>
				<BSW-CALLED-ENTITY UUID="b4ea269e-dad2-45d8-b7ce-5bde7ce2ed9f">
                  <SHORT-NAME>Cdd_Pwm_SetPhaseShift</SHORT-NAME>
                  <REENTRANCY-LEVEL>NON-REENTRANT</REENTRANCY-LEVEL>
                  <IMPLEMENTED-ENTRY-REF DEST="BSW-MODULE-ENTRY">/Cdd_Pwm_TI_AM261x/Cdd_Pwm_ModuleEntry/Cdd_Pwm_SetPhaseShift</IMPLEMENTED-ENTRY-REF>
                </BSW-CALLED-ENTITY>
				<BSW-CALLED-ENTITY UUID="3415d7c9-781b-43e5-b0a9-88bdecfa0da3">
                  <SHORT-NAME>Cdd_Pwm_SetTimeBasePeriod</SHORT-NAME>
                  <REENTRANCY-LEVEL>NON-REENTRANT</REENTRANCY-LEVEL>
                  <IMPLEMENTED-ENTRY-REF DEST="BSW-MODULE-ENTRY">/Cdd_Pwm_TI_AM261x/Cdd_Pwm_ModuleEntry/Cdd_Pwm_SetTimeBasePeriod</IMPLEMENTED-ENTRY-REF>
                </BSW-CALLED-ENTITY>
				<BSW-CALLED-ENTITY UUID="37b46720-300b-467c-8943-d27aa95bbdbe">
                  <SHORT-NAME>Cdd_Pwm_SetCounterCompareValue</SHORT-NAME>
                  <REENTRANCY-LEVEL>NON-REENTRANT</REENTRANCY-LEVEL>
                  <IMPLEMENTED-ENTRY-REF DEST="BSW-MODULE-ENTRY">/Cdd_Pwm_TI_AM261x/Cdd_Pwm_ModuleEntry/Cdd_Pwm_SetCounterCompareValue</IMPLEMENTED-ENTRY-REF>
                </BSW-CALLED-ENTITY>
				<BSW-CALLED-ENTITY UUID="33bfc7bd-e63d-4aec-9ba4-6ecd6dd54439">
                  <SHORT-NAME>Cdd_Pwm_SetXcmpRegValue</SHORT-NAME>
                  <REENTRANCY-LEVEL>NON-REENTRANT</REENTRANCY-LEVEL>
                  <IMPLEMENTED-ENTRY-REF DEST="BSW-MODULE-ENTRY">/Cdd_Pwm_TI_AM261x/Cdd_Pwm_ModuleEntry/Cdd_Pwm_SetXcmpRegValue</IMPLEMENTED-ENTRY-REF>
                </BSW-CALLED-ENTITY>
				<BSW-CALLED-ENTITY UUID="1ba4a870-9b0a-4769-a691-b9e169540577">
                  <SHORT-NAME>Cdd_Pwm_SetXMinMaxRegValue</SHORT-NAME>
                  <REENTRANCY-LEVEL>NON-REENTRANT</REENTRANCY-LEVEL>
                  <IMPLEMENTED-ENTRY-REF DEST="BSW-MODULE-ENTRY">/Cdd_Pwm_TI_AM261x/Cdd_Pwm_ModuleEntry/Cdd_Pwm_SetXMinMaxRegValue</IMPLEMENTED-ENTRY-REF>
                </BSW-CALLED-ENTITY>
				<BSW-CALLED-ENTITY UUID="c4aa031a-57c5-4d03-927f-def2d85e8996">
                  <SHORT-NAME>Cdd_Pwm_SetCmpShadowRegValue</SHORT-NAME>
                  <REENTRANCY-LEVEL>NON-REENTRANT</REENTRANCY-LEVEL>
                  <IMPLEMENTED-ENTRY-REF DEST="BSW-MODULE-ENTRY">/Cdd_Pwm_TI_AM261x/Cdd_Pwm_ModuleEntry/Cdd_Pwm_SetCmpShadowRegValue</IMPLEMENTED-ENTRY-REF>
                </BSW-CALLED-ENTITY>
              [!ENDIF!][!//
              [!IF "as:modconf('Cdd_Pwm')[1]/CddPwmConfigurationOfOptionalApis/CddPwmSetPinAction"!][!//
                <BSW-CALLED-ENTITY UUID="792c7039-0740-4297-9132-b4400dd88a2c">
                  <SHORT-NAME>Cdd_Pwm_SetPinAction</SHORT-NAME>
                  <CAN-ENTER-EXCLUSIVE-AREA-REFS>
                    <CAN-ENTER-EXCLUSIVE-AREA-REF DEST="EXCLUSIVE-AREA">/Cdd_Pwm_TI_AM261x/Cdd_Pwm/Cdd_Pwm_Behavior/PWM_EXCLUSIVE_AREA_0</CAN-ENTER-EXCLUSIVE-AREA-REF>
                  </CAN-ENTER-EXCLUSIVE-AREA-REFS>
                  <REENTRANCY-LEVEL>NON-REENTRANT</REENTRANCY-LEVEL>
                [!IF "as:modconf('Cdd_Pwm')[1]/CddPwmGeneral/CddPwmDevErrorDetect"!][!//
                  <CALL-POINTS>
                    <BSW-DIRECT-CALL-POINT>
                      <SHORT-NAME>Det</SHORT-NAME>
                      <CALLED-ENTRY-REF DEST="BSW-MODULE-ENTRY">/AUTOSAR_Det/BSWModuleEntry/Det_ReportError</CALLED-ENTRY-REF>
                    </BSW-DIRECT-CALL-POINT>
                  </CALL-POINTS>
                [!ENDIF!][!//
                  <IMPLEMENTED-ENTRY-REF DEST="BSW-MODULE-ENTRY">/Cdd_Pwm_TI_AM261x/Cdd_Pwm_ModuleEntry/Cdd_Pwm_SetPinAction</IMPLEMENTED-ENTRY-REF>
                </BSW-CALLED-ENTITY>
              [!ENDIF!][!//
              [!IF "as:modconf('Cdd_Pwm')[1]/CddPwmConfigurationOfOptionalApis/CddPwmSetRelativeThreshold"!][!//
                <BSW-CALLED-ENTITY UUID="212c9471-6a17-46b3-a449-530254f85741">
                  <SHORT-NAME>Cdd_Pwm_SetRelativeThreshold</SHORT-NAME>
                  <CAN-ENTER-EXCLUSIVE-AREA-REFS>
                    <CAN-ENTER-EXCLUSIVE-AREA-REF DEST="EXCLUSIVE-AREA">/Cdd_Pwm_TI_AM261x/Cdd_Pwm/Cdd_Pwm_Behavior/PWM_EXCLUSIVE_AREA_0</CAN-ENTER-EXCLUSIVE-AREA-REF>
                  </CAN-ENTER-EXCLUSIVE-AREA-REFS>
                  <REENTRANCY-LEVEL>NON-REENTRANT</REENTRANCY-LEVEL>
                [!IF "as:modconf('Cdd_Pwm')[1]/CddPwmGeneral/CddPwmDevErrorDetect"!][!//
                  <CALL-POINTS>
                    <BSW-DIRECT-CALL-POINT>
                      <SHORT-NAME>Det</SHORT-NAME>
                      <CALLED-ENTRY-REF DEST="BSW-MODULE-ENTRY">/AUTOSAR_Det/BSWModuleEntry/Det_ReportError</CALLED-ENTRY-REF>
                    </BSW-DIRECT-CALL-POINT>
                  </CALL-POINTS>
                [!ENDIF!][!//
                  <IMPLEMENTED-ENTRY-REF DEST="BSW-MODULE-ENTRY">/Cdd_Pwm_TI_AM261x/Cdd_Pwm_ModuleEntry/Cdd_Pwm_SetRelativeThreshold</IMPLEMENTED-ENTRY-REF>
                </BSW-CALLED-ENTITY>
              [!ENDIF!][!//
                <BSW-CALLED-ENTITY UUID="4ba382f7-e26f-4451-92f0-6c96410956ea">
                  <SHORT-NAME>Cdd_Pwm_StartChannelCounter</SHORT-NAME>
                  <CAN-ENTER-EXCLUSIVE-AREA-REFS>
                    <CAN-ENTER-EXCLUSIVE-AREA-REF DEST="EXCLUSIVE-AREA">/Cdd_Pwm_TI_AM261x/Cdd_Pwm/Cdd_Pwm_Behavior/PWM_EXCLUSIVE_AREA_0</CAN-ENTER-EXCLUSIVE-AREA-REF>
                  </CAN-ENTER-EXCLUSIVE-AREA-REFS>
                  <REENTRANCY-LEVEL>NON-REENTRANT</REENTRANCY-LEVEL>
                [!IF "as:modconf('Cdd_Pwm')[1]/CddPwmGeneral/CddPwmDevErrorDetect"!][!//
                  <CALL-POINTS>
                    <BSW-DIRECT-CALL-POINT>
                      <SHORT-NAME>Det</SHORT-NAME>
                      <CALLED-ENTRY-REF DEST="BSW-MODULE-ENTRY">/AUTOSAR_Det/BSWModuleEntry/Det_ReportError</CALLED-ENTRY-REF>
                    </BSW-DIRECT-CALL-POINT>
                  </CALL-POINTS>
                [!ENDIF!][!//
                  <IMPLEMENTED-ENTRY-REF DEST="BSW-MODULE-ENTRY">/Cdd_Pwm_TI_AM261x/Cdd_Pwm_ModuleEntry/Cdd_Pwm_StartChannelCounter</IMPLEMENTED-ENTRY-REF>
                </BSW-CALLED-ENTITY>
                <BSW-CALLED-ENTITY UUID="beb60699-0b40-4e72-b541-f70fc244512a">
                  <SHORT-NAME>Cdd_Pwm_StopChannelCounter</SHORT-NAME>
                  <CAN-ENTER-EXCLUSIVE-AREA-REFS>
                    <CAN-ENTER-EXCLUSIVE-AREA-REF DEST="EXCLUSIVE-AREA">/Cdd_Pwm_TI_AM261x/Cdd_Pwm/Cdd_Pwm_Behavior/PWM_EXCLUSIVE_AREA_0</CAN-ENTER-EXCLUSIVE-AREA-REF>
                  </CAN-ENTER-EXCLUSIVE-AREA-REFS>
                  <REENTRANCY-LEVEL>NON-REENTRANT</REENTRANCY-LEVEL>
                [!IF "as:modconf('Cdd_Pwm')[1]/CddPwmGeneral/CddPwmDevErrorDetect"!][!//
                  <CALL-POINTS>
                    <BSW-DIRECT-CALL-POINT>
                      <SHORT-NAME>Det</SHORT-NAME>
                      <CALLED-ENTRY-REF DEST="BSW-MODULE-ENTRY">/AUTOSAR_Det/BSWModuleEntry/Det_ReportError</CALLED-ENTRY-REF>
                    </BSW-DIRECT-CALL-POINT>
                  </CALL-POINTS>
                [!ENDIF!][!//
                  <IMPLEMENTED-ENTRY-REF DEST="BSW-MODULE-ENTRY">/Cdd_Pwm_TI_AM261x/Cdd_Pwm_ModuleEntry/Cdd_Pwm_StopChannelCounter</IMPLEMENTED-ENTRY-REF>
                </BSW-CALLED-ENTITY>
              [!IF "as:modconf('Cdd_Pwm')[1]/CddPwmGeneral/CddPwmChannelTimerBaseSyncEnable"!][!//
                <BSW-CALLED-ENTITY UUID="f2f60761-a3fc-4267-bbdc-a9579c1c9ff2">
                  <SHORT-NAME>Cdd_Pwm_SyncDisable</SHORT-NAME>
                  <CAN-ENTER-EXCLUSIVE-AREA-REFS>
                    <CAN-ENTER-EXCLUSIVE-AREA-REF DEST="EXCLUSIVE-AREA">/Cdd_Pwm_TI_AM261x/Cdd_Pwm/Cdd_Pwm_Behavior/PWM_EXCLUSIVE_AREA_0</CAN-ENTER-EXCLUSIVE-AREA-REF>
                  </CAN-ENTER-EXCLUSIVE-AREA-REFS>
                  <REENTRANCY-LEVEL>NON-REENTRANT</REENTRANCY-LEVEL>
                  <IMPLEMENTED-ENTRY-REF DEST="BSW-MODULE-ENTRY">/Cdd_Pwm_TI_AM261x/Cdd_Pwm_ModuleEntry/Cdd_Pwm_SyncDisable</IMPLEMENTED-ENTRY-REF>
                </BSW-CALLED-ENTITY>
                <BSW-CALLED-ENTITY UUID="618473d3-3a8d-4b4d-a331-c89657fa6288">
                  <SHORT-NAME>Cdd_Pwm_SyncEnable</SHORT-NAME>
                  <CAN-ENTER-EXCLUSIVE-AREA-REFS>
                    <CAN-ENTER-EXCLUSIVE-AREA-REF DEST="EXCLUSIVE-AREA">/Cdd_Pwm_TI_AM261x/Cdd_Pwm/Cdd_Pwm_Behavior/PWM_EXCLUSIVE_AREA_0</CAN-ENTER-EXCLUSIVE-AREA-REF>
                  </CAN-ENTER-EXCLUSIVE-AREA-REFS>
                  <REENTRANCY-LEVEL>NON-REENTRANT</REENTRANCY-LEVEL>
                  <IMPLEMENTED-ENTRY-REF DEST="BSW-MODULE-ENTRY">/Cdd_Pwm_TI_AM261x/Cdd_Pwm_ModuleEntry/Cdd_Pwm_SyncEnable</IMPLEMENTED-ENTRY-REF>
                </BSW-CALLED-ENTITY>
              [!ENDIF!][!//
              [!IF "as:modconf('Cdd_Pwm')[1]/CddPwmGeneral/CddPwmTripZoneEnable"!][!//
                <BSW-CALLED-ENTITY UUID="a4ea2add-7efe-4629-a3bf-0c99f6db2e6b">
                  <SHORT-NAME>Cdd_Pwm_TzEventStatusClear</SHORT-NAME>
                  <CAN-ENTER-EXCLUSIVE-AREA-REFS>
                    <CAN-ENTER-EXCLUSIVE-AREA-REF DEST="EXCLUSIVE-AREA">/Cdd_Pwm_TI_AM261x/Cdd_Pwm/Cdd_Pwm_Behavior/PWM_EXCLUSIVE_AREA_0</CAN-ENTER-EXCLUSIVE-AREA-REF>
                  </CAN-ENTER-EXCLUSIVE-AREA-REFS>
                  <REENTRANCY-LEVEL>NON-REENTRANT</REENTRANCY-LEVEL>
                  <IMPLEMENTED-ENTRY-REF DEST="BSW-MODULE-ENTRY">/Cdd_Pwm_TI_AM261x/Cdd_Pwm_ModuleEntry/Cdd_Pwm_TzEventStatusClear</IMPLEMENTED-ENTRY-REF>
                </BSW-CALLED-ENTITY>
                <BSW-CALLED-ENTITY UUID="193dc7ff-072f-4047-a2f7-7402b9ba55bd">
                  <SHORT-NAME>Cdd_Pwm_TzGetEventStatus</SHORT-NAME>
                  <CAN-ENTER-EXCLUSIVE-AREA-REFS>
                    <CAN-ENTER-EXCLUSIVE-AREA-REF DEST="EXCLUSIVE-AREA">/Cdd_Pwm_TI_AM261x/Cdd_Pwm/Cdd_Pwm_Behavior/PWM_EXCLUSIVE_AREA_0</CAN-ENTER-EXCLUSIVE-AREA-REF>
                  </CAN-ENTER-EXCLUSIVE-AREA-REFS>
                  <REENTRANCY-LEVEL>NON-REENTRANT</REENTRANCY-LEVEL>
                  <IMPLEMENTED-ENTRY-REF DEST="BSW-MODULE-ENTRY">/Cdd_Pwm_TI_AM261x/Cdd_Pwm_ModuleEntry/Cdd_Pwm_TzGetEventStatus</IMPLEMENTED-ENTRY-REF>
                </BSW-CALLED-ENTITY>
                <BSW-CALLED-ENTITY UUID="60f1ec03-84f8-419c-a43c-d31b8cacc1fc">
                  <SHORT-NAME>Cdd_Pwm_TzIntrDisable</SHORT-NAME>
                  <CAN-ENTER-EXCLUSIVE-AREA-REFS>
                    <CAN-ENTER-EXCLUSIVE-AREA-REF DEST="EXCLUSIVE-AREA">/Cdd_Pwm_TI_AM261x/Cdd_Pwm/Cdd_Pwm_Behavior/PWM_EXCLUSIVE_AREA_0</CAN-ENTER-EXCLUSIVE-AREA-REF>
                  </CAN-ENTER-EXCLUSIVE-AREA-REFS>
                  <REENTRANCY-LEVEL>NON-REENTRANT</REENTRANCY-LEVEL>
                  <IMPLEMENTED-ENTRY-REF DEST="BSW-MODULE-ENTRY">/Cdd_Pwm_TI_AM261x/Cdd_Pwm_ModuleEntry/Cdd_Pwm_TzIntrDisable</IMPLEMENTED-ENTRY-REF>
                </BSW-CALLED-ENTITY>
                <BSW-CALLED-ENTITY UUID="8695d50e-ffb0-4d57-b5b2-cda7bfc28bb6">
                  <SHORT-NAME>Cdd_Pwm_TzIntrEnable</SHORT-NAME>
                  <CAN-ENTER-EXCLUSIVE-AREA-REFS>
                    <CAN-ENTER-EXCLUSIVE-AREA-REF DEST="EXCLUSIVE-AREA">/Cdd_Pwm_TI_AM261x/Cdd_Pwm/Cdd_Pwm_Behavior/PWM_EXCLUSIVE_AREA_0</CAN-ENTER-EXCLUSIVE-AREA-REF>
                  </CAN-ENTER-EXCLUSIVE-AREA-REFS>
                  <REENTRANCY-LEVEL>NON-REENTRANT</REENTRANCY-LEVEL>
                  <IMPLEMENTED-ENTRY-REF DEST="BSW-MODULE-ENTRY">/Cdd_Pwm_TI_AM261x/Cdd_Pwm_ModuleEntry/Cdd_Pwm_TzIntrEnable</IMPLEMENTED-ENTRY-REF>
                </BSW-CALLED-ENTITY>
                <BSW-CALLED-ENTITY UUID="9f252a0c-93c8-4972-a68d-37bebbd89c00">
                  <SHORT-NAME>Cdd_Pwm_TzTripEventDisable</SHORT-NAME>
                  <CAN-ENTER-EXCLUSIVE-AREA-REFS>
                    <CAN-ENTER-EXCLUSIVE-AREA-REF DEST="EXCLUSIVE-AREA">/Cdd_Pwm_TI_AM261x/Cdd_Pwm/Cdd_Pwm_Behavior/PWM_EXCLUSIVE_AREA_0</CAN-ENTER-EXCLUSIVE-AREA-REF>
                  </CAN-ENTER-EXCLUSIVE-AREA-REFS>
                  <REENTRANCY-LEVEL>NON-REENTRANT</REENTRANCY-LEVEL>
                  <IMPLEMENTED-ENTRY-REF DEST="BSW-MODULE-ENTRY">/Cdd_Pwm_TI_AM261x/Cdd_Pwm_ModuleEntry/Cdd_Pwm_TzTripEventDisable</IMPLEMENTED-ENTRY-REF>
                </BSW-CALLED-ENTITY>
                <BSW-CALLED-ENTITY UUID="9d0e48e4-e5f2-437f-b4d2-b83a5f23832f">
                  <SHORT-NAME>Cdd_Pwm_TzTripEventEnable</SHORT-NAME>
                  <CAN-ENTER-EXCLUSIVE-AREA-REFS>
                    <CAN-ENTER-EXCLUSIVE-AREA-REF DEST="EXCLUSIVE-AREA">/Cdd_Pwm_TI_AM261x/Cdd_Pwm/Cdd_Pwm_Behavior/PWM_EXCLUSIVE_AREA_0</CAN-ENTER-EXCLUSIVE-AREA-REF>
                  </CAN-ENTER-EXCLUSIVE-AREA-REFS>
                  <REENTRANCY-LEVEL>NON-REENTRANT</REENTRANCY-LEVEL>
                  <IMPLEMENTED-ENTRY-REF DEST="BSW-MODULE-ENTRY">/Cdd_Pwm_TI_AM261x/Cdd_Pwm_ModuleEntry/Cdd_Pwm_TzTripEventEnable</IMPLEMENTED-ENTRY-REF>
                </BSW-CALLED-ENTITY>
              [!ENDIF!][!//
              </ENTITYS>
            </BSW-INTERNAL-BEHAVIOR>
          </INTERNAL-BEHAVIORS>
        </BSW-MODULE-DESCRIPTION>
        <BSW-IMPLEMENTATION UUID="203aa281-f38e-4240-b90a-b5233d1998e3">
          <SHORT-NAME>Cdd_Pwm_Impl</SHORT-NAME>
          <CODE-DESCRIPTORS>
            <CODE UUID="b842bba5-0166-436e-9ee2-4907e03b7285">
              <SHORT-NAME>Files</SHORT-NAME>
              <ARTIFACT-DESCRIPTORS>
                <AUTOSAR-ENGINEERING-OBJECT>
                  <SHORT-LABEL>V0::Cdd_Pwm_Priv.c</SHORT-LABEL>
                  <CATEGORY>SWSRC</CATEGORY>
                </AUTOSAR-ENGINEERING-OBJECT>
                <AUTOSAR-ENGINEERING-OBJECT>
                  <SHORT-LABEL>V0::Cdd_Pwm_Priv.h</SHORT-LABEL>
                  <CATEGORY>SWHDR</CATEGORY>
                </AUTOSAR-ENGINEERING-OBJECT>
                <AUTOSAR-ENGINEERING-OBJECT>
                  <SHORT-LABEL>V0::Cdd_Pwm_Sfo.c</SHORT-LABEL>
                  <CATEGORY>SWSRC</CATEGORY>
                </AUTOSAR-ENGINEERING-OBJECT>
                <AUTOSAR-ENGINEERING-OBJECT>
                  <SHORT-LABEL>V0::Cdd_Pwm_Sfo.h</SHORT-LABEL>
                  <CATEGORY>SWHDR</CATEGORY>
                </AUTOSAR-ENGINEERING-OBJECT>
                <AUTOSAR-ENGINEERING-OBJECT>
                  <SHORT-LABEL>V0::Cdd_Pwm_Types.h</SHORT-LABEL>
                  <CATEGORY>SWHDR</CATEGORY>
                </AUTOSAR-ENGINEERING-OBJECT>
                <AUTOSAR-ENGINEERING-OBJECT>
                  <SHORT-LABEL>generate::include::Cdd_Pwm_Cfg.h</SHORT-LABEL>
                  <CATEGORY>SWHDR</CATEGORY>
                </AUTOSAR-ENGINEERING-OBJECT>
                <AUTOSAR-ENGINEERING-OBJECT>
                  <SHORT-LABEL>generate::src::Cdd_Pwm_Cfg.c</SHORT-LABEL>
                  <CATEGORY>SWSRC</CATEGORY>
                </AUTOSAR-ENGINEERING-OBJECT>
                <AUTOSAR-ENGINEERING-OBJECT>
                  <SHORT-LABEL>generate::src::Cdd_Pwm_PBcfg.c</SHORT-LABEL>
                  <CATEGORY>SWSRC</CATEGORY>
                </AUTOSAR-ENGINEERING-OBJECT>
                <AUTOSAR-ENGINEERING-OBJECT >
                  <SHORT-LABEL>include::Cdd_Pwm.h</SHORT-LABEL>
                  <CATEGORY>SWHDR</CATEGORY>
                </AUTOSAR-ENGINEERING-OBJECT>
                <AUTOSAR-ENGINEERING-OBJECT >
                  <SHORT-LABEL>include::Cdd_Pwm_Irq.h</SHORT-LABEL>
                  <CATEGORY>SWHDR</CATEGORY>
                </AUTOSAR-ENGINEERING-OBJECT>
                <AUTOSAR-ENGINEERING-OBJECT >
                  <SHORT-LABEL>src::Cdd_Pwm.c</SHORT-LABEL>
                  <CATEGORY>SWSRC</CATEGORY>
                </AUTOSAR-ENGINEERING-OBJECT>
                <AUTOSAR-ENGINEERING-OBJECT >
                  <SHORT-LABEL>src::Cdd_Pwm_Irq.c</SHORT-LABEL>
                  <CATEGORY>SWSRC</CATEGORY>
                </AUTOSAR-ENGINEERING-OBJECT>
              </ARTIFACT-DESCRIPTORS>
            </CODE>
          </CODE-DESCRIPTORS>
          <COMPILERS>
            <COMPILER UUID="5aed6633-766d-41c4-a600-34981785dc25">
              <SHORT-NAME>tiarmclang</SHORT-NAME>
              <NAME>TI ARM Clang Compiler</NAME>
              <VENDOR>Texas Instruments</VENDOR>
              <VERSION>4.0.0</VERSION>
            </COMPILER>
          </COMPILERS>
          <LINKERS>
            <LINKER UUID="cec4f59a-534d-42af-8d67-1ffec6193d7f">
              <SHORT-NAME>tiarmlnk</SHORT-NAME>
              <NAME>TI ARM Linker</NAME>
              <VENDOR>Texas Instruments</VENDOR>
              <VERSION>4.0.0</VERSION>
            </LINKER>
          </LINKERS>
          <PROGRAMMING-LANGUAGE>C</PROGRAMMING-LANGUAGE>
          <RESOURCE-CONSUMPTION UUID="2b66f55a-e19c-41a1-b2ef-54847c59eb46">
            <SHORT-NAME>ResourceConsumption</SHORT-NAME>
            <MEMORY-SECTIONS>
              <MEMORY-SECTION UUID="828769e1-4df9-41d2-8984-5ff47c257878">
                <SHORT-NAME>CDD_PWM_CODE</SHORT-NAME>
                <ALIGNMENT>UNSPECIFIED</ALIGNMENT>
                <SW-ADDRMETHOD-REF DEST="SW-ADDR-METHOD">/AUTOSAR_MemMap/SwAddrMethods/CODE</SW-ADDRMETHOD-REF>
                <SYMBOL>CODE</SYMBOL>
              </MEMORY-SECTION>
              <MEMORY-SECTION UUID="d88a1a21-ae5c-4a3b-ae2f-6db64f722727">
                <SHORT-NAME>CDD_PWM_CONFIG_DATA</SHORT-NAME>
                <ALIGNMENT>UNSPECIFIED</ALIGNMENT>
                <SW-ADDRMETHOD-REF DEST="SW-ADDR-METHOD">/AUTOSAR_MemMap/SwAddrMethods/CONFIG_DATA</SW-ADDRMETHOD-REF>
                <SYMBOL>CONFIG_DATA</SYMBOL>
              </MEMORY-SECTION>
              <MEMORY-SECTION UUID="4f3b9f19-05f7-4abe-986c-ea6fe587471c">
                <SHORT-NAME>CDD_PWM_ISR_CODE</SHORT-NAME>
                <ALIGNMENT>UNSPECIFIED</ALIGNMENT>
                <SW-ADDRMETHOD-REF DEST="SW-ADDR-METHOD">/AUTOSAR_MemMap/SwAddrMethods/CODE</SW-ADDRMETHOD-REF>
                <SYMBOL>ISR_CODE</SYMBOL>
              </MEMORY-SECTION>
              <MEMORY-SECTION UUID="29f2b01f-7e2e-46ba-9c6c-0a3fd5f44702">
                <SHORT-NAME>CDD_PWM_VAR_INIT_8</SHORT-NAME>
                <ALIGNMENT>8</ALIGNMENT>
                <SW-ADDRMETHOD-REF DEST="SW-ADDR-METHOD">/AUTOSAR_MemMap/SwAddrMethods/VAR_INIT</SW-ADDRMETHOD-REF>
                <SYMBOL>VAR_INIT_8</SYMBOL>
              </MEMORY-SECTION>
              <MEMORY-SECTION UUID="7237286c-fcb7-4e06-bc83-00ab59a55b8e">
                <SHORT-NAME>CDD_PWM_VAR_NO_INIT_16</SHORT-NAME>
                <ALIGNMENT>16</ALIGNMENT>
                <SW-ADDRMETHOD-REF DEST="SW-ADDR-METHOD">/AUTOSAR_MemMap/SwAddrMethods/VAR_NO_INIT</SW-ADDRMETHOD-REF>
                <SYMBOL>VAR_NO_INIT_16</SYMBOL>
              </MEMORY-SECTION>
              <MEMORY-SECTION UUID="e4b004c0-9224-4ea2-96fc-6dfc40fc9e23">
                <SHORT-NAME>CDD_PWM_VAR_NO_INIT_32</SHORT-NAME>
                <ALIGNMENT>32</ALIGNMENT>
                <SW-ADDRMETHOD-REF DEST="SW-ADDR-METHOD">/AUTOSAR_MemMap/SwAddrMethods/VAR_NO_INIT</SW-ADDRMETHOD-REF>
                <SYMBOL>VAR_NO_INIT_32</SYMBOL>
              </MEMORY-SECTION>
              <MEMORY-SECTION UUID="ef8ac5db-2062-4f2e-bb31-57949944d55a">
                <SHORT-NAME>CDD_PWM_VAR_NO_INIT_UNSPECIFIED</SHORT-NAME>
                <ALIGNMENT>UNSPECIFIED</ALIGNMENT>
                <SW-ADDRMETHOD-REF DEST="SW-ADDR-METHOD">/AUTOSAR_MemMap/SwAddrMethods/VAR_NO_INIT</SW-ADDRMETHOD-REF>
                <SYMBOL>VAR_NO_INIT_UNSPECIFIED</SYMBOL>
              </MEMORY-SECTION>
            </MEMORY-SECTIONS>
          </RESOURCE-CONSUMPTION>
          <SW-VERSION>10.01.00</SW-VERSION>
          <VENDOR-ID>44</VENDOR-ID>
          <AR-RELEASE-VERSION>4.3.1</AR-RELEASE-VERSION>
          <BEHAVIOR-REF DEST="BSW-INTERNAL-BEHAVIOR">/Cdd_Pwm_TI_AM261x/Cdd_Pwm/Cdd_Pwm_Behavior</BEHAVIOR-REF>
          <VENDOR-SPECIFIC-MODULE-DEF-REFS>
            <VENDOR-SPECIFIC-MODULE-DEF-REF DEST="ECUC-MODULE-DEF">/TI_AM261x/Cdd_Pwm</VENDOR-SPECIFIC-MODULE-DEF-REF>
          </VENDOR-SPECIFIC-MODULE-DEF-REFS>
        </BSW-IMPLEMENTATION>
      </ELEMENTS>
      <AR-PACKAGES>
        <AR-PACKAGE UUID="de28179a-ea49-4527-aca9-13f91f828566">
          <SHORT-NAME>Cdd_Pwm_ModuleEntry</SHORT-NAME>
          <ELEMENTS>
            <BSW-MODULE-ENTRY UUID="b0e10ec3-cd95-4db2-9558-d9d4ef49dfa2">
              <SHORT-NAME>Cdd_Pwm_ChopperCfg</SHORT-NAME>
              <SERVICE-ID>18</SERVICE-ID>
              <IS-REENTRANT>false</IS-REENTRANT>
              <IS-SYNCHRONOUS>true</IS-SYNCHRONOUS>
              <CALL-TYPE>REGULAR</CALL-TYPE>
              <EXECUTION-CONTEXT>UNSPECIFIED</EXECUTION-CONTEXT>
              <SW-SERVICE-IMPL-POLICY>STANDARD</SW-SERVICE-IMPL-POLICY>
              <BSW-ENTRY-KIND>CONCRETE</BSW-ENTRY-KIND>
            </BSW-MODULE-ENTRY>
            <BSW-MODULE-ENTRY UUID="26614722-e78c-4060-9fd2-60972f419bb3">
              <SHORT-NAME>Cdd_Pwm_ChopperEnable</SHORT-NAME>
              <SERVICE-ID>19</SERVICE-ID>
              <IS-REENTRANT>false</IS-REENTRANT>
              <IS-SYNCHRONOUS>true</IS-SYNCHRONOUS>
              <CALL-TYPE>REGULAR</CALL-TYPE>
              <EXECUTION-CONTEXT>UNSPECIFIED</EXECUTION-CONTEXT>
              <SW-SERVICE-IMPL-POLICY>STANDARD</SW-SERVICE-IMPL-POLICY>
              <BSW-ENTRY-KIND>CONCRETE</BSW-ENTRY-KIND>
            </BSW-MODULE-ENTRY>
            <BSW-MODULE-ENTRY UUID="ce2b2484-c56d-463c-ba88-b3a77bc07295">
              <SHORT-NAME>Cdd_Pwm_ClearCounterStatus</SHORT-NAME>
              <SERVICE-ID>21</SERVICE-ID>
              <IS-REENTRANT>false</IS-REENTRANT>
              <IS-SYNCHRONOUS>true</IS-SYNCHRONOUS>
              <CALL-TYPE>REGULAR</CALL-TYPE>
              <EXECUTION-CONTEXT>UNSPECIFIED</EXECUTION-CONTEXT>
              <SW-SERVICE-IMPL-POLICY>STANDARD</SW-SERVICE-IMPL-POLICY>
              <BSW-ENTRY-KIND>CONCRETE</BSW-ENTRY-KIND>
            </BSW-MODULE-ENTRY>
            <BSW-MODULE-ENTRY UUID="f2f3b826-1bef-4388-9efe-cadfe6f07831">
              <SHORT-NAME>Cdd_Pwm_CounterComparatorCfg</SHORT-NAME>
              <SERVICE-ID>44</SERVICE-ID>
              <IS-REENTRANT>false</IS-REENTRANT>
              <IS-SYNCHRONOUS>true</IS-SYNCHRONOUS>
              <CALL-TYPE>REGULAR</CALL-TYPE>
              <EXECUTION-CONTEXT>UNSPECIFIED</EXECUTION-CONTEXT>
              <SW-SERVICE-IMPL-POLICY>STANDARD</SW-SERVICE-IMPL-POLICY>
              <BSW-ENTRY-KIND>CONCRETE</BSW-ENTRY-KIND>
            </BSW-MODULE-ENTRY>
            <BSW-MODULE-ENTRY UUID="60e51627-3c9c-480e-bdab-414625c77f63">
              <SHORT-NAME>Cdd_Pwm_DeInit</SHORT-NAME>
              <SERVICE-ID>1</SERVICE-ID>
              <IS-REENTRANT>false</IS-REENTRANT>
              <IS-SYNCHRONOUS>true</IS-SYNCHRONOUS>
              <CALL-TYPE>REGULAR</CALL-TYPE>
              <EXECUTION-CONTEXT>UNSPECIFIED</EXECUTION-CONTEXT>
              <SW-SERVICE-IMPL-POLICY>STANDARD</SW-SERVICE-IMPL-POLICY>
              <BSW-ENTRY-KIND>CONCRETE</BSW-ENTRY-KIND>
            </BSW-MODULE-ENTRY>
            <BSW-MODULE-ENTRY UUID="cffb8c0d-7129-41db-9792-67cde1e778b8">
              <SHORT-NAME>Cdd_Pwm_DeadbandBypass</SHORT-NAME>
              <SERVICE-ID>17</SERVICE-ID>
              <IS-REENTRANT>false</IS-REENTRANT>
              <IS-SYNCHRONOUS>true</IS-SYNCHRONOUS>
              <CALL-TYPE>REGULAR</CALL-TYPE>
              <EXECUTION-CONTEXT>UNSPECIFIED</EXECUTION-CONTEXT>
              <SW-SERVICE-IMPL-POLICY>STANDARD</SW-SERVICE-IMPL-POLICY>
              <BSW-ENTRY-KIND>CONCRETE</BSW-ENTRY-KIND>
            </BSW-MODULE-ENTRY>
			<BSW-MODULE-ENTRY UUID="7b6e3ad4-b9dd-4a50-bed7-57857b7a50ee">
              <SHORT-NAME>Cdd_Pwm_SetRisingEdgeDelay</SHORT-NAME>
              <SERVICE-ID>40</SERVICE-ID>
              <IS-REENTRANT>false</IS-REENTRANT>
              <IS-SYNCHRONOUS>true</IS-SYNCHRONOUS>
              <CALL-TYPE>REGULAR</CALL-TYPE>
              <EXECUTION-CONTEXT>UNSPECIFIED</EXECUTION-CONTEXT>
              <SW-SERVICE-IMPL-POLICY>STANDARD</SW-SERVICE-IMPL-POLICY>
              <BSW-ENTRY-KIND>CONCRETE</BSW-ENTRY-KIND>
            </BSW-MODULE-ENTRY>
			<BSW-MODULE-ENTRY UUID="c84491b8-848f-4b3d-862f-f75591a31244">
              <SHORT-NAME>Cdd_Pwm_SetFallingEdgeDelay</SHORT-NAME>
              <SERVICE-ID>41</SERVICE-ID>
              <IS-REENTRANT>false</IS-REENTRANT>
              <IS-SYNCHRONOUS>true</IS-SYNCHRONOUS>
              <CALL-TYPE>REGULAR</CALL-TYPE>
              <EXECUTION-CONTEXT>UNSPECIFIED</EXECUTION-CONTEXT>
              <SW-SERVICE-IMPL-POLICY>STANDARD</SW-SERVICE-IMPL-POLICY>
              <BSW-ENTRY-KIND>CONCRETE</BSW-ENTRY-KIND>
            </BSW-MODULE-ENTRY>
	    <BSW-MODULE-ENTRY UUID="750e4f90-e659-46d3-b863-7b2493213975">
              <SHORT-NAME>Cdd_Pwm_SetMinDeadbandDelay</SHORT-NAME>
              <SERVICE-ID>47</SERVICE-ID>
              <IS-REENTRANT>false</IS-REENTRANT>
              <IS-SYNCHRONOUS>true</IS-SYNCHRONOUS>
              <CALL-TYPE>REGULAR</CALL-TYPE>
              <EXECUTION-CONTEXT>UNSPECIFIED</EXECUTION-CONTEXT>
              <SW-SERVICE-IMPL-POLICY>STANDARD</SW-SERVICE-IMPL-POLICY>
              <BSW-ENTRY-KIND>CONCRETE</BSW-ENTRY-KIND>
            </BSW-MODULE-ENTRY>
			<BSW-MODULE-ENTRY UUID="23d69cdc-8280-45e3-82c1-c20cc1e6a62c">
              <SHORT-NAME>Cdd_Pwm_HrSetRisingEdgeDelay</SHORT-NAME>
              <SERVICE-ID>45</SERVICE-ID>
              <IS-REENTRANT>false</IS-REENTRANT>
              <IS-SYNCHRONOUS>true</IS-SYNCHRONOUS>
              <CALL-TYPE>REGULAR</CALL-TYPE>
              <EXECUTION-CONTEXT>UNSPECIFIED</EXECUTION-CONTEXT>
              <SW-SERVICE-IMPL-POLICY>STANDARD</SW-SERVICE-IMPL-POLICY>
              <BSW-ENTRY-KIND>CONCRETE</BSW-ENTRY-KIND>
            </BSW-MODULE-ENTRY>
			<BSW-MODULE-ENTRY UUID="cc885e09-9a2f-4bb3-97cc-893fa89b0a2e">
              <SHORT-NAME>Cdd_Pwm_HrSetFallingEdgeDelay</SHORT-NAME>
              <SERVICE-ID>46</SERVICE-ID>
              <IS-REENTRANT>false</IS-REENTRANT>
              <IS-SYNCHRONOUS>true</IS-SYNCHRONOUS>
              <CALL-TYPE>REGULAR</CALL-TYPE>
              <EXECUTION-CONTEXT>UNSPECIFIED</EXECUTION-CONTEXT>
              <SW-SERVICE-IMPL-POLICY>STANDARD</SW-SERVICE-IMPL-POLICY>
              <BSW-ENTRY-KIND>CONCRETE</BSW-ENTRY-KIND>
            </BSW-MODULE-ENTRY>
            <BSW-MODULE-ENTRY UUID="7671ec5a-de2d-4242-95a5-b5652f9236a2">
              <SHORT-NAME>Cdd_Pwm_DeadbandCfg</SHORT-NAME>
              <SERVICE-ID>16</SERVICE-ID>
              <IS-REENTRANT>false</IS-REENTRANT>
              <IS-SYNCHRONOUS>true</IS-SYNCHRONOUS>
              <CALL-TYPE>REGULAR</CALL-TYPE>
              <EXECUTION-CONTEXT>UNSPECIFIED</EXECUTION-CONTEXT>
              <SW-SERVICE-IMPL-POLICY>STANDARD</SW-SERVICE-IMPL-POLICY>
              <BSW-ENTRY-KIND>CONCRETE</BSW-ENTRY-KIND>
            </BSW-MODULE-ENTRY>
            <BSW-MODULE-ENTRY UUID="dc10ee75-5e57-4c0d-bab7-ecc61243abee">
              <SHORT-NAME>Cdd_Pwm_DisableNotification</SHORT-NAME>
              <SERVICE-ID>9</SERVICE-ID>
              <IS-REENTRANT>false</IS-REENTRANT>
              <IS-SYNCHRONOUS>true</IS-SYNCHRONOUS>
              <CALL-TYPE>REGULAR</CALL-TYPE>
              <EXECUTION-CONTEXT>UNSPECIFIED</EXECUTION-CONTEXT>
              <SW-SERVICE-IMPL-POLICY>STANDARD</SW-SERVICE-IMPL-POLICY>
              <BSW-ENTRY-KIND>CONCRETE</BSW-ENTRY-KIND>
            </BSW-MODULE-ENTRY>
            <BSW-MODULE-ENTRY UUID="1d6f1295-c142-495e-9461-7b4d18a52f66">
              <SHORT-NAME>Cdd_Pwm_EnableNotification</SHORT-NAME>
              <SERVICE-ID>10</SERVICE-ID>
              <IS-REENTRANT>false</IS-REENTRANT>
              <IS-SYNCHRONOUS>true</IS-SYNCHRONOUS>
              <CALL-TYPE>REGULAR</CALL-TYPE>
              <EXECUTION-CONTEXT>UNSPECIFIED</EXECUTION-CONTEXT>
              <SW-SERVICE-IMPL-POLICY>STANDARD</SW-SERVICE-IMPL-POLICY>
              <BSW-ENTRY-KIND>CONCRETE</BSW-ENTRY-KIND>
            </BSW-MODULE-ENTRY>
            <BSW-MODULE-ENTRY UUID="ceca68d4-535f-4389-8a77-1b497159cdd1">
              <SHORT-NAME>Cdd_Pwm_EtGetEventCount</SHORT-NAME>
              <SERVICE-ID>24</SERVICE-ID>
              <IS-REENTRANT>true</IS-REENTRANT>
              <IS-SYNCHRONOUS>true</IS-SYNCHRONOUS>
              <CALL-TYPE>REGULAR</CALL-TYPE>
              <EXECUTION-CONTEXT>UNSPECIFIED</EXECUTION-CONTEXT>
              <SW-SERVICE-IMPL-POLICY>STANDARD</SW-SERVICE-IMPL-POLICY>
              <BSW-ENTRY-KIND>CONCRETE</BSW-ENTRY-KIND>
            </BSW-MODULE-ENTRY>
            <BSW-MODULE-ENTRY UUID="3cbdc884-a449-42e8-97b3-0edae01aee24">
              <SHORT-NAME>Cdd_Pwm_EtIntrClear</SHORT-NAME>
              <SERVICE-ID>23</SERVICE-ID>
              <IS-REENTRANT>false</IS-REENTRANT>
              <IS-SYNCHRONOUS>true</IS-SYNCHRONOUS>
              <CALL-TYPE>REGULAR</CALL-TYPE>
              <EXECUTION-CONTEXT>UNSPECIFIED</EXECUTION-CONTEXT>
              <SW-SERVICE-IMPL-POLICY>STANDARD</SW-SERVICE-IMPL-POLICY>
              <BSW-ENTRY-KIND>CONCRETE</BSW-ENTRY-KIND>
            </BSW-MODULE-ENTRY>
            <BSW-MODULE-ENTRY UUID="f53d9396-85fb-4b8e-8855-7949710b9a56">
              <SHORT-NAME>Cdd_Pwm_EtIntrStatus</SHORT-NAME>
              <SERVICE-ID>22</SERVICE-ID>
              <IS-REENTRANT>true</IS-REENTRANT>
              <IS-SYNCHRONOUS>true</IS-SYNCHRONOUS>
              <CALL-TYPE>REGULAR</CALL-TYPE>
              <EXECUTION-CONTEXT>UNSPECIFIED</EXECUTION-CONTEXT>
              <SW-SERVICE-IMPL-POLICY>STANDARD</SW-SERVICE-IMPL-POLICY>
              <BSW-ENTRY-KIND>CONCRETE</BSW-ENTRY-KIND>
            </BSW-MODULE-ENTRY>
            <BSW-MODULE-ENTRY UUID="5ce9319a-f0eb-41a7-bd05-3b0545c7b527">
              <SHORT-NAME>Cdd_Pwm_G0_Ch0Isr</SHORT-NAME>
              <IS-REENTRANT>false</IS-REENTRANT>
              <IS-SYNCHRONOUS>true</IS-SYNCHRONOUS>
              <CALL-TYPE>INTERRUPT</CALL-TYPE>
            [!IF "as:modconf('Cdd_Pwm')[1]/CddPwmGeneral/CddPwmTypeofInterruptFunction = 'CDD_PWM_ISR_CAT2'"!][!//
              <EXECUTION-CONTEXT>INTERRUPT-CAT-2</EXECUTION-CONTEXT>
            [!ELSE!][!//
              <EXECUTION-CONTEXT>INTERRUPT-CAT-1</EXECUTION-CONTEXT>
            [!ENDIF!][!//
              <SW-SERVICE-IMPL-POLICY>STANDARD</SW-SERVICE-IMPL-POLICY>
              <BSW-ENTRY-KIND>CONCRETE</BSW-ENTRY-KIND>
            </BSW-MODULE-ENTRY>
            <BSW-MODULE-ENTRY UUID="8a1b2390-ef9c-4e6d-9603-de84122b4e92">
              <SHORT-NAME>Cdd_Pwm_G0_Ch1Isr</SHORT-NAME>
              <IS-REENTRANT>false</IS-REENTRANT>
              <IS-SYNCHRONOUS>true</IS-SYNCHRONOUS>
              <CALL-TYPE>INTERRUPT</CALL-TYPE>
            [!IF "as:modconf('Cdd_Pwm')[1]/CddPwmGeneral/CddPwmTypeofInterruptFunction = 'CDD_PWM_ISR_CAT2'"!][!//
              <EXECUTION-CONTEXT>INTERRUPT-CAT-2</EXECUTION-CONTEXT>
            [!ELSE!][!//
              <EXECUTION-CONTEXT>INTERRUPT-CAT-1</EXECUTION-CONTEXT>
            [!ENDIF!][!//
              <SW-SERVICE-IMPL-POLICY>STANDARD</SW-SERVICE-IMPL-POLICY>
              <BSW-ENTRY-KIND>CONCRETE</BSW-ENTRY-KIND>
            </BSW-MODULE-ENTRY>
            <BSW-MODULE-ENTRY UUID="02b254be-e807-4922-992f-4c9f663a52de">
              <SHORT-NAME>Cdd_Pwm_G0_Ch2Isr</SHORT-NAME>
              <IS-REENTRANT>false</IS-REENTRANT>
              <IS-SYNCHRONOUS>true</IS-SYNCHRONOUS>
              <CALL-TYPE>INTERRUPT</CALL-TYPE>
            [!IF "as:modconf('Cdd_Pwm')[1]/CddPwmGeneral/CddPwmTypeofInterruptFunction = 'CDD_PWM_ISR_CAT2'"!][!//
              <EXECUTION-CONTEXT>INTERRUPT-CAT-2</EXECUTION-CONTEXT>
            [!ELSE!][!//
              <EXECUTION-CONTEXT>INTERRUPT-CAT-1</EXECUTION-CONTEXT>
            [!ENDIF!][!//
              <SW-SERVICE-IMPL-POLICY>STANDARD</SW-SERVICE-IMPL-POLICY>
              <BSW-ENTRY-KIND>CONCRETE</BSW-ENTRY-KIND>
            </BSW-MODULE-ENTRY>
            <BSW-MODULE-ENTRY UUID="a694f4da-a61e-42fe-8897-d41be59cf2aa">
              <SHORT-NAME>Cdd_Pwm_G0_Ch3Isr</SHORT-NAME>
              <IS-REENTRANT>false</IS-REENTRANT>
              <IS-SYNCHRONOUS>true</IS-SYNCHRONOUS>
              <CALL-TYPE>INTERRUPT</CALL-TYPE>
            [!IF "as:modconf('Cdd_Pwm')[1]/CddPwmGeneral/CddPwmTypeofInterruptFunction = 'CDD_PWM_ISR_CAT2'"!][!//
              <EXECUTION-CONTEXT>INTERRUPT-CAT-2</EXECUTION-CONTEXT>
            [!ELSE!][!//
              <EXECUTION-CONTEXT>INTERRUPT-CAT-1</EXECUTION-CONTEXT>
            [!ENDIF!][!//
              <SW-SERVICE-IMPL-POLICY>STANDARD</SW-SERVICE-IMPL-POLICY>
              <BSW-ENTRY-KIND>CONCRETE</BSW-ENTRY-KIND>
            </BSW-MODULE-ENTRY>
            <BSW-MODULE-ENTRY UUID="e4f51359-a2b0-4864-9cf7-1408ad355112">
              <SHORT-NAME>Cdd_Pwm_G0_Ch4Isr</SHORT-NAME>
              <IS-REENTRANT>false</IS-REENTRANT>
              <IS-SYNCHRONOUS>true</IS-SYNCHRONOUS>
              <CALL-TYPE>INTERRUPT</CALL-TYPE>
            [!IF "as:modconf('Cdd_Pwm')[1]/CddPwmGeneral/CddPwmTypeofInterruptFunction = 'CDD_PWM_ISR_CAT2'"!][!//
              <EXECUTION-CONTEXT>INTERRUPT-CAT-2</EXECUTION-CONTEXT>
            [!ELSE!][!//
              <EXECUTION-CONTEXT>INTERRUPT-CAT-1</EXECUTION-CONTEXT>
            [!ENDIF!][!//
              <SW-SERVICE-IMPL-POLICY>STANDARD</SW-SERVICE-IMPL-POLICY>
              <BSW-ENTRY-KIND>CONCRETE</BSW-ENTRY-KIND>
            </BSW-MODULE-ENTRY>
            <BSW-MODULE-ENTRY UUID="a8b1f662-b8d8-4507-8899-1d1836241207">
              <SHORT-NAME>Cdd_Pwm_G0_Ch5Isr</SHORT-NAME>
              <IS-REENTRANT>false</IS-REENTRANT>
              <IS-SYNCHRONOUS>true</IS-SYNCHRONOUS>
              <CALL-TYPE>INTERRUPT</CALL-TYPE>
            [!IF "as:modconf('Cdd_Pwm')[1]/CddPwmGeneral/CddPwmTypeofInterruptFunction = 'CDD_PWM_ISR_CAT2'"!][!//
              <EXECUTION-CONTEXT>INTERRUPT-CAT-2</EXECUTION-CONTEXT>
            [!ELSE!][!//
              <EXECUTION-CONTEXT>INTERRUPT-CAT-1</EXECUTION-CONTEXT>
            [!ENDIF!][!//
              <SW-SERVICE-IMPL-POLICY>STANDARD</SW-SERVICE-IMPL-POLICY>
              <BSW-ENTRY-KIND>CONCRETE</BSW-ENTRY-KIND>
            </BSW-MODULE-ENTRY>
            <BSW-MODULE-ENTRY UUID="0799df33-3e70-44e6-952d-6ba8e4dddd66">
              <SHORT-NAME>Cdd_Pwm_G0_Ch6Isr</SHORT-NAME>
              <IS-REENTRANT>false</IS-REENTRANT>
              <IS-SYNCHRONOUS>true</IS-SYNCHRONOUS>
              <CALL-TYPE>INTERRUPT</CALL-TYPE>
            [!IF "as:modconf('Cdd_Pwm')[1]/CddPwmGeneral/CddPwmTypeofInterruptFunction = 'CDD_PWM_ISR_CAT2'"!][!//
              <EXECUTION-CONTEXT>INTERRUPT-CAT-2</EXECUTION-CONTEXT>
            [!ELSE!][!//
              <EXECUTION-CONTEXT>INTERRUPT-CAT-1</EXECUTION-CONTEXT>
            [!ENDIF!][!//
              <SW-SERVICE-IMPL-POLICY>STANDARD</SW-SERVICE-IMPL-POLICY>
              <BSW-ENTRY-KIND>CONCRETE</BSW-ENTRY-KIND>
            </BSW-MODULE-ENTRY>
            <BSW-MODULE-ENTRY UUID="be4e29d3-7363-428b-8339-9543b79027d7">
              <SHORT-NAME>Cdd_Pwm_G0_Ch7Isr</SHORT-NAME>
              <IS-REENTRANT>false</IS-REENTRANT>
              <IS-SYNCHRONOUS>true</IS-SYNCHRONOUS>
              <CALL-TYPE>INTERRUPT</CALL-TYPE>
            [!IF "as:modconf('Cdd_Pwm')[1]/CddPwmGeneral/CddPwmTypeofInterruptFunction = 'CDD_PWM_ISR_CAT2'"!][!//
              <EXECUTION-CONTEXT>INTERRUPT-CAT-2</EXECUTION-CONTEXT>
            [!ELSE!][!//
              <EXECUTION-CONTEXT>INTERRUPT-CAT-1</EXECUTION-CONTEXT>
            [!ENDIF!][!//
              <SW-SERVICE-IMPL-POLICY>STANDARD</SW-SERVICE-IMPL-POLICY>
              <BSW-ENTRY-KIND>CONCRETE</BSW-ENTRY-KIND>
            </BSW-MODULE-ENTRY>
            <BSW-MODULE-ENTRY UUID="4c4ee1f6-7165-44d5-a7dc-b2b361f53195">
              <SHORT-NAME>Cdd_Pwm_G0_Ch8Isr</SHORT-NAME>
              <IS-REENTRANT>false</IS-REENTRANT>
              <IS-SYNCHRONOUS>true</IS-SYNCHRONOUS>
              <CALL-TYPE>INTERRUPT</CALL-TYPE>
            [!IF "as:modconf('Cdd_Pwm')[1]/CddPwmGeneral/CddPwmTypeofInterruptFunction = 'CDD_PWM_ISR_CAT2'"!][!//
              <EXECUTION-CONTEXT>INTERRUPT-CAT-2</EXECUTION-CONTEXT>
            [!ELSE!][!//
              <EXECUTION-CONTEXT>INTERRUPT-CAT-1</EXECUTION-CONTEXT>
            [!ENDIF!][!//
              <SW-SERVICE-IMPL-POLICY>STANDARD</SW-SERVICE-IMPL-POLICY>
              <BSW-ENTRY-KIND>CONCRETE</BSW-ENTRY-KIND>
            </BSW-MODULE-ENTRY>
            <BSW-MODULE-ENTRY UUID="83931f87-8c15-4f2c-a7c5-9b6f0178bce6">
              <SHORT-NAME>Cdd_Pwm_G0_Ch9Isr</SHORT-NAME>
              <IS-REENTRANT>false</IS-REENTRANT>
              <IS-SYNCHRONOUS>true</IS-SYNCHRONOUS>
              <CALL-TYPE>INTERRUPT</CALL-TYPE>
            [!IF "as:modconf('Cdd_Pwm')[1]/CddPwmGeneral/CddPwmTypeofInterruptFunction = 'CDD_PWM_ISR_CAT2'"!][!//
              <EXECUTION-CONTEXT>INTERRUPT-CAT-2</EXECUTION-CONTEXT>
            [!ELSE!][!//
              <EXECUTION-CONTEXT>INTERRUPT-CAT-1</EXECUTION-CONTEXT>
            [!ENDIF!][!//
              <SW-SERVICE-IMPL-POLICY>STANDARD</SW-SERVICE-IMPL-POLICY>
              <BSW-ENTRY-KIND>CONCRETE</BSW-ENTRY-KIND>
            </BSW-MODULE-ENTRY>
            <BSW-MODULE-ENTRY UUID="a29289b0-f80f-44eb-a9c6-917a91f330fb">
              <SHORT-NAME>Cdd_Pwm_G0_TzCh0Isr</SHORT-NAME>
              <IS-REENTRANT>false</IS-REENTRANT>
              <IS-SYNCHRONOUS>true</IS-SYNCHRONOUS>
              <CALL-TYPE>INTERRUPT</CALL-TYPE>
            [!IF "as:modconf('Cdd_Pwm')[1]/CddPwmGeneral/CddPwmTypeofInterruptFunction = 'CDD_PWM_ISR_CAT2'"!][!//
              <EXECUTION-CONTEXT>INTERRUPT-CAT-2</EXECUTION-CONTEXT>
            [!ELSE!][!//
              <EXECUTION-CONTEXT>INTERRUPT-CAT-1</EXECUTION-CONTEXT>
            [!ENDIF!][!//
              <SW-SERVICE-IMPL-POLICY>STANDARD</SW-SERVICE-IMPL-POLICY>
              <BSW-ENTRY-KIND>CONCRETE</BSW-ENTRY-KIND>
            </BSW-MODULE-ENTRY>
            <BSW-MODULE-ENTRY UUID="2263837f-f85f-410f-94d0-d9c99a4a8f5a">
              <SHORT-NAME>Cdd_Pwm_G0_TzCh1Isr</SHORT-NAME>
              <IS-REENTRANT>false</IS-REENTRANT>
              <IS-SYNCHRONOUS>true</IS-SYNCHRONOUS>
              <CALL-TYPE>INTERRUPT</CALL-TYPE>
            [!IF "as:modconf('Cdd_Pwm')[1]/CddPwmGeneral/CddPwmTypeofInterruptFunction = 'CDD_PWM_ISR_CAT2'"!][!//
              <EXECUTION-CONTEXT>INTERRUPT-CAT-2</EXECUTION-CONTEXT>
            [!ELSE!][!//
              <EXECUTION-CONTEXT>INTERRUPT-CAT-1</EXECUTION-CONTEXT>
            [!ENDIF!][!//
              <SW-SERVICE-IMPL-POLICY>STANDARD</SW-SERVICE-IMPL-POLICY>
              <BSW-ENTRY-KIND>CONCRETE</BSW-ENTRY-KIND>
            </BSW-MODULE-ENTRY>
            <BSW-MODULE-ENTRY UUID="45d49f9c-a0ab-4ced-9ecb-ec44434612b4">
              <SHORT-NAME>Cdd_Pwm_G0_TzCh2Isr</SHORT-NAME>
              <IS-REENTRANT>false</IS-REENTRANT>
              <IS-SYNCHRONOUS>true</IS-SYNCHRONOUS>
              <CALL-TYPE>INTERRUPT</CALL-TYPE>
            [!IF "as:modconf('Cdd_Pwm')[1]/CddPwmGeneral/CddPwmTypeofInterruptFunction = 'CDD_PWM_ISR_CAT2'"!][!//
              <EXECUTION-CONTEXT>INTERRUPT-CAT-2</EXECUTION-CONTEXT>
            [!ELSE!][!//
              <EXECUTION-CONTEXT>INTERRUPT-CAT-1</EXECUTION-CONTEXT>
            [!ENDIF!][!//
              <SW-SERVICE-IMPL-POLICY>STANDARD</SW-SERVICE-IMPL-POLICY>
              <BSW-ENTRY-KIND>CONCRETE</BSW-ENTRY-KIND>
            </BSW-MODULE-ENTRY>
            <BSW-MODULE-ENTRY UUID="c1b77e86-2bfc-488f-a876-183f4e27e817">
              <SHORT-NAME>Cdd_Pwm_G0_TzCh3Isr</SHORT-NAME>
              <IS-REENTRANT>false</IS-REENTRANT>
              <IS-SYNCHRONOUS>true</IS-SYNCHRONOUS>
              <CALL-TYPE>INTERRUPT</CALL-TYPE>
            [!IF "as:modconf('Cdd_Pwm')[1]/CddPwmGeneral/CddPwmTypeofInterruptFunction = 'CDD_PWM_ISR_CAT2'"!][!//
              <EXECUTION-CONTEXT>INTERRUPT-CAT-2</EXECUTION-CONTEXT>
            [!ELSE!][!//
              <EXECUTION-CONTEXT>INTERRUPT-CAT-1</EXECUTION-CONTEXT>
            [!ENDIF!][!//
              <SW-SERVICE-IMPL-POLICY>STANDARD</SW-SERVICE-IMPL-POLICY>
              <BSW-ENTRY-KIND>CONCRETE</BSW-ENTRY-KIND>
            </BSW-MODULE-ENTRY>
            <BSW-MODULE-ENTRY UUID="a9730230-da98-44fe-bec7-f40abfcab0fa">
              <SHORT-NAME>Cdd_Pwm_G0_TzCh4Isr</SHORT-NAME>
              <IS-REENTRANT>false</IS-REENTRANT>
              <IS-SYNCHRONOUS>true</IS-SYNCHRONOUS>
              <CALL-TYPE>INTERRUPT</CALL-TYPE>
            [!IF "as:modconf('Cdd_Pwm')[1]/CddPwmGeneral/CddPwmTypeofInterruptFunction = 'CDD_PWM_ISR_CAT2'"!][!//
              <EXECUTION-CONTEXT>INTERRUPT-CAT-2</EXECUTION-CONTEXT>
            [!ELSE!][!//
              <EXECUTION-CONTEXT>INTERRUPT-CAT-1</EXECUTION-CONTEXT>
            [!ENDIF!][!//
              <SW-SERVICE-IMPL-POLICY>STANDARD</SW-SERVICE-IMPL-POLICY>
              <BSW-ENTRY-KIND>CONCRETE</BSW-ENTRY-KIND>
            </BSW-MODULE-ENTRY>
            <BSW-MODULE-ENTRY UUID="4a46ddc2-6524-42db-948c-814bbc0e479e">
              <SHORT-NAME>Cdd_Pwm_G0_TzCh5Isr</SHORT-NAME>
              <IS-REENTRANT>false</IS-REENTRANT>
              <IS-SYNCHRONOUS>true</IS-SYNCHRONOUS>
              <CALL-TYPE>INTERRUPT</CALL-TYPE>
            [!IF "as:modconf('Cdd_Pwm')[1]/CddPwmGeneral/CddPwmTypeofInterruptFunction = 'CDD_PWM_ISR_CAT2'"!][!//
              <EXECUTION-CONTEXT>INTERRUPT-CAT-2</EXECUTION-CONTEXT>
            [!ELSE!][!//
              <EXECUTION-CONTEXT>INTERRUPT-CAT-1</EXECUTION-CONTEXT>
            [!ENDIF!][!//
              <SW-SERVICE-IMPL-POLICY>STANDARD</SW-SERVICE-IMPL-POLICY>
              <BSW-ENTRY-KIND>CONCRETE</BSW-ENTRY-KIND>
            </BSW-MODULE-ENTRY>
            <BSW-MODULE-ENTRY UUID="aade0af0-f61a-47b6-8593-596a22806b5b">
              <SHORT-NAME>Cdd_Pwm_G0_TzCh6Isr</SHORT-NAME>
              <IS-REENTRANT>false</IS-REENTRANT>
              <IS-SYNCHRONOUS>true</IS-SYNCHRONOUS>
              <CALL-TYPE>INTERRUPT</CALL-TYPE>
            [!IF "as:modconf('Cdd_Pwm')[1]/CddPwmGeneral/CddPwmTypeofInterruptFunction = 'CDD_PWM_ISR_CAT2'"!][!//
              <EXECUTION-CONTEXT>INTERRUPT-CAT-2</EXECUTION-CONTEXT>
            [!ELSE!][!//
              <EXECUTION-CONTEXT>INTERRUPT-CAT-1</EXECUTION-CONTEXT>
            [!ENDIF!][!//
              <SW-SERVICE-IMPL-POLICY>STANDARD</SW-SERVICE-IMPL-POLICY>
              <BSW-ENTRY-KIND>CONCRETE</BSW-ENTRY-KIND>
            </BSW-MODULE-ENTRY>
            <BSW-MODULE-ENTRY UUID="c8f43874-f478-4bcb-a2f9-b0d34a124e5f">
              <SHORT-NAME>Cdd_Pwm_G0_TzCh7Isr</SHORT-NAME>
              <IS-REENTRANT>false</IS-REENTRANT>
              <IS-SYNCHRONOUS>true</IS-SYNCHRONOUS>
              <CALL-TYPE>INTERRUPT</CALL-TYPE>
            [!IF "as:modconf('Cdd_Pwm')[1]/CddPwmGeneral/CddPwmTypeofInterruptFunction = 'CDD_PWM_ISR_CAT2'"!][!//
              <EXECUTION-CONTEXT>INTERRUPT-CAT-2</EXECUTION-CONTEXT>
            [!ELSE!][!//
              <EXECUTION-CONTEXT>INTERRUPT-CAT-1</EXECUTION-CONTEXT>
            [!ENDIF!][!//
              <SW-SERVICE-IMPL-POLICY>STANDARD</SW-SERVICE-IMPL-POLICY>
              <BSW-ENTRY-KIND>CONCRETE</BSW-ENTRY-KIND>
            </BSW-MODULE-ENTRY>
            <BSW-MODULE-ENTRY UUID="350decac-0f43-47dc-b937-0eaae048669b">
              <SHORT-NAME>Cdd_Pwm_G0_TzCh8Isr</SHORT-NAME>
              <IS-REENTRANT>false</IS-REENTRANT>
              <IS-SYNCHRONOUS>true</IS-SYNCHRONOUS>
              <CALL-TYPE>INTERRUPT</CALL-TYPE>
            [!IF "as:modconf('Cdd_Pwm')[1]/CddPwmGeneral/CddPwmTypeofInterruptFunction = 'CDD_PWM_ISR_CAT2'"!][!//
              <EXECUTION-CONTEXT>INTERRUPT-CAT-2</EXECUTION-CONTEXT>
            [!ELSE!][!//
              <EXECUTION-CONTEXT>INTERRUPT-CAT-1</EXECUTION-CONTEXT>
            [!ENDIF!][!//
              <SW-SERVICE-IMPL-POLICY>STANDARD</SW-SERVICE-IMPL-POLICY>
              <BSW-ENTRY-KIND>CONCRETE</BSW-ENTRY-KIND>
            </BSW-MODULE-ENTRY>
            <BSW-MODULE-ENTRY UUID="c6bec0a7-77a0-491a-82e7-aab289393ced">
              <SHORT-NAME>Cdd_Pwm_G0_TzCh9Isr</SHORT-NAME>
              <IS-REENTRANT>false</IS-REENTRANT>
              <IS-SYNCHRONOUS>true</IS-SYNCHRONOUS>
              <CALL-TYPE>INTERRUPT</CALL-TYPE>
            [!IF "as:modconf('Cdd_Pwm')[1]/CddPwmGeneral/CddPwmTypeofInterruptFunction = 'CDD_PWM_ISR_CAT2'"!][!//
              <EXECUTION-CONTEXT>INTERRUPT-CAT-2</EXECUTION-CONTEXT>
            [!ELSE!][!//
              <EXECUTION-CONTEXT>INTERRUPT-CAT-1</EXECUTION-CONTEXT>
            [!ENDIF!][!//
              <SW-SERVICE-IMPL-POLICY>STANDARD</SW-SERVICE-IMPL-POLICY>
              <BSW-ENTRY-KIND>CONCRETE</BSW-ENTRY-KIND>
            </BSW-MODULE-ENTRY>
            <BSW-MODULE-ENTRY UUID="64a54bc1-53af-46b8-9300-8825473e80b6">
              <SHORT-NAME>Cdd_Pwm_G1_Ch0Isr</SHORT-NAME>
              <IS-REENTRANT>false</IS-REENTRANT>
              <IS-SYNCHRONOUS>true</IS-SYNCHRONOUS>
              <CALL-TYPE>INTERRUPT</CALL-TYPE>
            [!IF "as:modconf('Cdd_Pwm')[1]/CddPwmGeneral/CddPwmTypeofInterruptFunction = 'CDD_PWM_ISR_CAT2'"!][!//
              <EXECUTION-CONTEXT>INTERRUPT-CAT-2</EXECUTION-CONTEXT>
            [!ELSE!][!//
              <EXECUTION-CONTEXT>INTERRUPT-CAT-1</EXECUTION-CONTEXT>
            [!ENDIF!][!//
              <SW-SERVICE-IMPL-POLICY>STANDARD</SW-SERVICE-IMPL-POLICY>
              <BSW-ENTRY-KIND>CONCRETE</BSW-ENTRY-KIND>
            </BSW-MODULE-ENTRY>
            <BSW-MODULE-ENTRY UUID="430b127b-e2b8-404d-802f-d7819ec752d0">
              <SHORT-NAME>Cdd_Pwm_G1_Ch1Isr</SHORT-NAME>
              <IS-REENTRANT>false</IS-REENTRANT>
              <IS-SYNCHRONOUS>true</IS-SYNCHRONOUS>
              <CALL-TYPE>INTERRUPT</CALL-TYPE>
            [!IF "as:modconf('Cdd_Pwm')[1]/CddPwmGeneral/CddPwmTypeofInterruptFunction = 'CDD_PWM_ISR_CAT2'"!][!//
              <EXECUTION-CONTEXT>INTERRUPT-CAT-2</EXECUTION-CONTEXT>
            [!ELSE!][!//
              <EXECUTION-CONTEXT>INTERRUPT-CAT-1</EXECUTION-CONTEXT>
            [!ENDIF!][!//
              <SW-SERVICE-IMPL-POLICY>STANDARD</SW-SERVICE-IMPL-POLICY>
              <BSW-ENTRY-KIND>CONCRETE</BSW-ENTRY-KIND>
            </BSW-MODULE-ENTRY>
            <BSW-MODULE-ENTRY UUID="69bb18af-7d4e-460c-b47b-debc8492e5aa">
              <SHORT-NAME>Cdd_Pwm_G1_Ch2Isr</SHORT-NAME>
              <IS-REENTRANT>false</IS-REENTRANT>
              <IS-SYNCHRONOUS>true</IS-SYNCHRONOUS>
              <CALL-TYPE>INTERRUPT</CALL-TYPE>
            [!IF "as:modconf('Cdd_Pwm')[1]/CddPwmGeneral/CddPwmTypeofInterruptFunction = 'CDD_PWM_ISR_CAT2'"!][!//
              <EXECUTION-CONTEXT>INTERRUPT-CAT-2</EXECUTION-CONTEXT>
            [!ELSE!][!//
              <EXECUTION-CONTEXT>INTERRUPT-CAT-1</EXECUTION-CONTEXT>
            [!ENDIF!][!//
              <SW-SERVICE-IMPL-POLICY>STANDARD</SW-SERVICE-IMPL-POLICY>
              <BSW-ENTRY-KIND>CONCRETE</BSW-ENTRY-KIND>
            </BSW-MODULE-ENTRY>
            <BSW-MODULE-ENTRY UUID="651a2e79-0840-424d-a69a-bd345e4ae1a2">
              <SHORT-NAME>Cdd_Pwm_G1_Ch3Isr</SHORT-NAME>
              <IS-REENTRANT>false</IS-REENTRANT>
              <IS-SYNCHRONOUS>true</IS-SYNCHRONOUS>
              <CALL-TYPE>INTERRUPT</CALL-TYPE>
            [!IF "as:modconf('Cdd_Pwm')[1]/CddPwmGeneral/CddPwmTypeofInterruptFunction = 'CDD_PWM_ISR_CAT2'"!][!//
              <EXECUTION-CONTEXT>INTERRUPT-CAT-2</EXECUTION-CONTEXT>
            [!ELSE!][!//
              <EXECUTION-CONTEXT>INTERRUPT-CAT-1</EXECUTION-CONTEXT>
            [!ENDIF!][!//
              <SW-SERVICE-IMPL-POLICY>STANDARD</SW-SERVICE-IMPL-POLICY>
              <BSW-ENTRY-KIND>CONCRETE</BSW-ENTRY-KIND>
            </BSW-MODULE-ENTRY>
            <BSW-MODULE-ENTRY UUID="f3af3c32-a1f5-48cd-ad2c-11a45007b06a">
              <SHORT-NAME>Cdd_Pwm_G1_Ch4Isr</SHORT-NAME>
              <IS-REENTRANT>false</IS-REENTRANT>
              <IS-SYNCHRONOUS>true</IS-SYNCHRONOUS>
              <CALL-TYPE>INTERRUPT</CALL-TYPE>
            [!IF "as:modconf('Cdd_Pwm')[1]/CddPwmGeneral/CddPwmTypeofInterruptFunction = 'CDD_PWM_ISR_CAT2'"!][!//
              <EXECUTION-CONTEXT>INTERRUPT-CAT-2</EXECUTION-CONTEXT>
            [!ELSE!][!//
              <EXECUTION-CONTEXT>INTERRUPT-CAT-1</EXECUTION-CONTEXT>
            [!ENDIF!][!//
              <SW-SERVICE-IMPL-POLICY>STANDARD</SW-SERVICE-IMPL-POLICY>
              <BSW-ENTRY-KIND>CONCRETE</BSW-ENTRY-KIND>
            </BSW-MODULE-ENTRY>
            <BSW-MODULE-ENTRY UUID="93395da9-673f-4f30-9646-5409008676dd">
              <SHORT-NAME>Cdd_Pwm_G1_Ch5Isr</SHORT-NAME>
              <IS-REENTRANT>false</IS-REENTRANT>
              <IS-SYNCHRONOUS>true</IS-SYNCHRONOUS>
              <CALL-TYPE>INTERRUPT</CALL-TYPE>
            [!IF "as:modconf('Cdd_Pwm')[1]/CddPwmGeneral/CddPwmTypeofInterruptFunction = 'CDD_PWM_ISR_CAT2'"!][!//
              <EXECUTION-CONTEXT>INTERRUPT-CAT-2</EXECUTION-CONTEXT>
            [!ELSE!][!//
              <EXECUTION-CONTEXT>INTERRUPT-CAT-1</EXECUTION-CONTEXT>
            [!ENDIF!][!//
              <SW-SERVICE-IMPL-POLICY>STANDARD</SW-SERVICE-IMPL-POLICY>
              <BSW-ENTRY-KIND>CONCRETE</BSW-ENTRY-KIND>
            </BSW-MODULE-ENTRY>
            <BSW-MODULE-ENTRY UUID="4880dcde-31f0-41d0-ad9e-e6157e6c92f0">
              <SHORT-NAME>Cdd_Pwm_G1_Ch6Isr</SHORT-NAME>
              <IS-REENTRANT>false</IS-REENTRANT>
              <IS-SYNCHRONOUS>true</IS-SYNCHRONOUS>
              <CALL-TYPE>INTERRUPT</CALL-TYPE>
            [!IF "as:modconf('Cdd_Pwm')[1]/CddPwmGeneral/CddPwmTypeofInterruptFunction = 'CDD_PWM_ISR_CAT2'"!][!//
              <EXECUTION-CONTEXT>INTERRUPT-CAT-2</EXECUTION-CONTEXT>
            [!ELSE!][!//
              <EXECUTION-CONTEXT>INTERRUPT-CAT-1</EXECUTION-CONTEXT>
            [!ENDIF!][!//
              <SW-SERVICE-IMPL-POLICY>STANDARD</SW-SERVICE-IMPL-POLICY>
              <BSW-ENTRY-KIND>CONCRETE</BSW-ENTRY-KIND>
            </BSW-MODULE-ENTRY>
            <BSW-MODULE-ENTRY UUID="25b73abf-8520-41e0-9871-50bcfdb4df40">
              <SHORT-NAME>Cdd_Pwm_G1_Ch7Isr</SHORT-NAME>
              <IS-REENTRANT>false</IS-REENTRANT>
              <IS-SYNCHRONOUS>true</IS-SYNCHRONOUS>
              <CALL-TYPE>INTERRUPT</CALL-TYPE>
            [!IF "as:modconf('Cdd_Pwm')[1]/CddPwmGeneral/CddPwmTypeofInterruptFunction = 'CDD_PWM_ISR_CAT2'"!][!//
              <EXECUTION-CONTEXT>INTERRUPT-CAT-2</EXECUTION-CONTEXT>
            [!ELSE!][!//
              <EXECUTION-CONTEXT>INTERRUPT-CAT-1</EXECUTION-CONTEXT>
            [!ENDIF!][!//
              <SW-SERVICE-IMPL-POLICY>STANDARD</SW-SERVICE-IMPL-POLICY>
              <BSW-ENTRY-KIND>CONCRETE</BSW-ENTRY-KIND>
            </BSW-MODULE-ENTRY>
            <BSW-MODULE-ENTRY UUID="d6f4dae9-7629-41d2-9055-c4fb13cf58d2">
              <SHORT-NAME>Cdd_Pwm_G1_Ch8Isr</SHORT-NAME>
              <IS-REENTRANT>false</IS-REENTRANT>
              <IS-SYNCHRONOUS>true</IS-SYNCHRONOUS>
              <CALL-TYPE>INTERRUPT</CALL-TYPE>
            [!IF "as:modconf('Cdd_Pwm')[1]/CddPwmGeneral/CddPwmTypeofInterruptFunction = 'CDD_PWM_ISR_CAT2'"!][!//
              <EXECUTION-CONTEXT>INTERRUPT-CAT-2</EXECUTION-CONTEXT>
            [!ELSE!][!//
              <EXECUTION-CONTEXT>INTERRUPT-CAT-1</EXECUTION-CONTEXT>
            [!ENDIF!][!//
              <SW-SERVICE-IMPL-POLICY>STANDARD</SW-SERVICE-IMPL-POLICY>
              <BSW-ENTRY-KIND>CONCRETE</BSW-ENTRY-KIND>
            </BSW-MODULE-ENTRY>
            <BSW-MODULE-ENTRY UUID="1a1a937c-dee1-4067-bd7f-fb55f4df163b">
              <SHORT-NAME>Cdd_Pwm_G1_Ch9Isr</SHORT-NAME>
              <IS-REENTRANT>false</IS-REENTRANT>
              <IS-SYNCHRONOUS>true</IS-SYNCHRONOUS>
              <CALL-TYPE>INTERRUPT</CALL-TYPE>
            [!IF "as:modconf('Cdd_Pwm')[1]/CddPwmGeneral/CddPwmTypeofInterruptFunction = 'CDD_PWM_ISR_CAT2'"!][!//
              <EXECUTION-CONTEXT>INTERRUPT-CAT-2</EXECUTION-CONTEXT>
            [!ELSE!][!//
              <EXECUTION-CONTEXT>INTERRUPT-CAT-1</EXECUTION-CONTEXT>
            [!ENDIF!][!//
              <SW-SERVICE-IMPL-POLICY>STANDARD</SW-SERVICE-IMPL-POLICY>
              <BSW-ENTRY-KIND>CONCRETE</BSW-ENTRY-KIND>
            </BSW-MODULE-ENTRY>
            <BSW-MODULE-ENTRY UUID="af7670e4-522b-4ec5-a04a-6eecb33e0a95">
              <SHORT-NAME>Cdd_Pwm_G1_TzCh0Isr</SHORT-NAME>
              <IS-REENTRANT>false</IS-REENTRANT>
              <IS-SYNCHRONOUS>true</IS-SYNCHRONOUS>
              <CALL-TYPE>INTERRUPT</CALL-TYPE>
            [!IF "as:modconf('Cdd_Pwm')[1]/CddPwmGeneral/CddPwmTypeofInterruptFunction = 'CDD_PWM_ISR_CAT2'"!][!//
              <EXECUTION-CONTEXT>INTERRUPT-CAT-2</EXECUTION-CONTEXT>
            [!ELSE!][!//
              <EXECUTION-CONTEXT>INTERRUPT-CAT-1</EXECUTION-CONTEXT>
            [!ENDIF!][!//
              <SW-SERVICE-IMPL-POLICY>STANDARD</SW-SERVICE-IMPL-POLICY>
              <BSW-ENTRY-KIND>CONCRETE</BSW-ENTRY-KIND>
            </BSW-MODULE-ENTRY>
            <BSW-MODULE-ENTRY UUID="8ebf8be3-af31-42f6-b3ca-d76591242d91">
              <SHORT-NAME>Cdd_Pwm_G1_TzCh1Isr</SHORT-NAME>
              <IS-REENTRANT>false</IS-REENTRANT>
              <IS-SYNCHRONOUS>true</IS-SYNCHRONOUS>
              <CALL-TYPE>INTERRUPT</CALL-TYPE>
            [!IF "as:modconf('Cdd_Pwm')[1]/CddPwmGeneral/CddPwmTypeofInterruptFunction = 'CDD_PWM_ISR_CAT2'"!][!//
              <EXECUTION-CONTEXT>INTERRUPT-CAT-2</EXECUTION-CONTEXT>
            [!ELSE!][!//
              <EXECUTION-CONTEXT>INTERRUPT-CAT-1</EXECUTION-CONTEXT>
            [!ENDIF!][!//
              <SW-SERVICE-IMPL-POLICY>STANDARD</SW-SERVICE-IMPL-POLICY>
              <BSW-ENTRY-KIND>CONCRETE</BSW-ENTRY-KIND>
            </BSW-MODULE-ENTRY>
            <BSW-MODULE-ENTRY UUID="d4b85f31-c814-49b9-984e-7de44ef959ef">
              <SHORT-NAME>Cdd_Pwm_G1_TzCh2Isr</SHORT-NAME>
              <IS-REENTRANT>false</IS-REENTRANT>
              <IS-SYNCHRONOUS>true</IS-SYNCHRONOUS>
              <CALL-TYPE>INTERRUPT</CALL-TYPE>
            [!IF "as:modconf('Cdd_Pwm')[1]/CddPwmGeneral/CddPwmTypeofInterruptFunction = 'CDD_PWM_ISR_CAT2'"!][!//
              <EXECUTION-CONTEXT>INTERRUPT-CAT-2</EXECUTION-CONTEXT>
            [!ELSE!][!//
              <EXECUTION-CONTEXT>INTERRUPT-CAT-1</EXECUTION-CONTEXT>
            [!ENDIF!][!//
              <SW-SERVICE-IMPL-POLICY>STANDARD</SW-SERVICE-IMPL-POLICY>
              <BSW-ENTRY-KIND>CONCRETE</BSW-ENTRY-KIND>
            </BSW-MODULE-ENTRY>
            <BSW-MODULE-ENTRY UUID="8ee06e80-3ab0-40db-b2ad-7a11b7aa26c7">
              <SHORT-NAME>Cdd_Pwm_G1_TzCh3Isr</SHORT-NAME>
              <IS-REENTRANT>false</IS-REENTRANT>
              <IS-SYNCHRONOUS>true</IS-SYNCHRONOUS>
              <CALL-TYPE>INTERRUPT</CALL-TYPE>
            [!IF "as:modconf('Cdd_Pwm')[1]/CddPwmGeneral/CddPwmTypeofInterruptFunction = 'CDD_PWM_ISR_CAT2'"!][!//
              <EXECUTION-CONTEXT>INTERRUPT-CAT-2</EXECUTION-CONTEXT>
            [!ELSE!][!//
              <EXECUTION-CONTEXT>INTERRUPT-CAT-1</EXECUTION-CONTEXT>
            [!ENDIF!][!//
              <SW-SERVICE-IMPL-POLICY>STANDARD</SW-SERVICE-IMPL-POLICY>
              <BSW-ENTRY-KIND>CONCRETE</BSW-ENTRY-KIND>
            </BSW-MODULE-ENTRY>
            <BSW-MODULE-ENTRY UUID="6dfc95c9-1845-4cde-8691-8a53edf2297a">
              <SHORT-NAME>Cdd_Pwm_G1_TzCh4Isr</SHORT-NAME>
              <IS-REENTRANT>false</IS-REENTRANT>
              <IS-SYNCHRONOUS>true</IS-SYNCHRONOUS>
              <CALL-TYPE>INTERRUPT</CALL-TYPE>
            [!IF "as:modconf('Cdd_Pwm')[1]/CddPwmGeneral/CddPwmTypeofInterruptFunction = 'CDD_PWM_ISR_CAT2'"!][!//
              <EXECUTION-CONTEXT>INTERRUPT-CAT-2</EXECUTION-CONTEXT>
            [!ELSE!][!//
              <EXECUTION-CONTEXT>INTERRUPT-CAT-1</EXECUTION-CONTEXT>
            [!ENDIF!][!//
              <SW-SERVICE-IMPL-POLICY>STANDARD</SW-SERVICE-IMPL-POLICY>
              <BSW-ENTRY-KIND>CONCRETE</BSW-ENTRY-KIND>
            </BSW-MODULE-ENTRY>
            <BSW-MODULE-ENTRY UUID="1565db05-660b-460d-8c39-b8a874088963">
              <SHORT-NAME>Cdd_Pwm_G1_TzCh5Isr</SHORT-NAME>
              <IS-REENTRANT>false</IS-REENTRANT>
              <IS-SYNCHRONOUS>true</IS-SYNCHRONOUS>
              <CALL-TYPE>INTERRUPT</CALL-TYPE>
            [!IF "as:modconf('Cdd_Pwm')[1]/CddPwmGeneral/CddPwmTypeofInterruptFunction = 'CDD_PWM_ISR_CAT2'"!][!//
              <EXECUTION-CONTEXT>INTERRUPT-CAT-2</EXECUTION-CONTEXT>
            [!ELSE!][!//
              <EXECUTION-CONTEXT>INTERRUPT-CAT-1</EXECUTION-CONTEXT>
            [!ENDIF!][!//
              <SW-SERVICE-IMPL-POLICY>STANDARD</SW-SERVICE-IMPL-POLICY>
              <BSW-ENTRY-KIND>CONCRETE</BSW-ENTRY-KIND>
            </BSW-MODULE-ENTRY>
            <BSW-MODULE-ENTRY UUID="5a3ae9d0-17b0-46e0-b4b0-966e33d8e080">
              <SHORT-NAME>Cdd_Pwm_G1_TzCh6Isr</SHORT-NAME>
              <IS-REENTRANT>false</IS-REENTRANT>
              <IS-SYNCHRONOUS>true</IS-SYNCHRONOUS>
              <CALL-TYPE>INTERRUPT</CALL-TYPE>
            [!IF "as:modconf('Cdd_Pwm')[1]/CddPwmGeneral/CddPwmTypeofInterruptFunction = 'CDD_PWM_ISR_CAT2'"!][!//
              <EXECUTION-CONTEXT>INTERRUPT-CAT-2</EXECUTION-CONTEXT>
            [!ELSE!][!//
              <EXECUTION-CONTEXT>INTERRUPT-CAT-1</EXECUTION-CONTEXT>
            [!ENDIF!][!//
              <SW-SERVICE-IMPL-POLICY>STANDARD</SW-SERVICE-IMPL-POLICY>
              <BSW-ENTRY-KIND>CONCRETE</BSW-ENTRY-KIND>
            </BSW-MODULE-ENTRY>
            <BSW-MODULE-ENTRY UUID="9e022653-5744-4556-b6a9-4c3273ca4b88">
              <SHORT-NAME>Cdd_Pwm_G1_TzCh7Isr</SHORT-NAME>
              <IS-REENTRANT>false</IS-REENTRANT>
              <IS-SYNCHRONOUS>true</IS-SYNCHRONOUS>
              <CALL-TYPE>INTERRUPT</CALL-TYPE>
            [!IF "as:modconf('Cdd_Pwm')[1]/CddPwmGeneral/CddPwmTypeofInterruptFunction = 'CDD_PWM_ISR_CAT2'"!][!//
              <EXECUTION-CONTEXT>INTERRUPT-CAT-2</EXECUTION-CONTEXT>
            [!ELSE!][!//
              <EXECUTION-CONTEXT>INTERRUPT-CAT-1</EXECUTION-CONTEXT>
            [!ENDIF!][!//
              <SW-SERVICE-IMPL-POLICY>STANDARD</SW-SERVICE-IMPL-POLICY>
              <BSW-ENTRY-KIND>CONCRETE</BSW-ENTRY-KIND>
            </BSW-MODULE-ENTRY>
            <BSW-MODULE-ENTRY UUID="fd38b0d7-900a-4dff-91a6-7c37057c72aa">
              <SHORT-NAME>Cdd_Pwm_G1_TzCh8Isr</SHORT-NAME>
              <IS-REENTRANT>false</IS-REENTRANT>
              <IS-SYNCHRONOUS>true</IS-SYNCHRONOUS>
              <CALL-TYPE>INTERRUPT</CALL-TYPE>
            [!IF "as:modconf('Cdd_Pwm')[1]/CddPwmGeneral/CddPwmTypeofInterruptFunction = 'CDD_PWM_ISR_CAT2'"!][!//
              <EXECUTION-CONTEXT>INTERRUPT-CAT-2</EXECUTION-CONTEXT>
            [!ELSE!][!//
              <EXECUTION-CONTEXT>INTERRUPT-CAT-1</EXECUTION-CONTEXT>
            [!ENDIF!][!//
              <SW-SERVICE-IMPL-POLICY>STANDARD</SW-SERVICE-IMPL-POLICY>
              <BSW-ENTRY-KIND>CONCRETE</BSW-ENTRY-KIND>
            </BSW-MODULE-ENTRY>
            <BSW-MODULE-ENTRY UUID="8f7bf6d8-5da7-4b35-aa7d-eef260de4d3e">
              <SHORT-NAME>Cdd_Pwm_G1_TzCh9Isr</SHORT-NAME>
              <IS-REENTRANT>false</IS-REENTRANT>
              <IS-SYNCHRONOUS>true</IS-SYNCHRONOUS>
              <CALL-TYPE>INTERRUPT</CALL-TYPE>
            [!IF "as:modconf('Cdd_Pwm')[1]/CddPwmGeneral/CddPwmTypeofInterruptFunction = 'CDD_PWM_ISR_CAT2'"!][!//
              <EXECUTION-CONTEXT>INTERRUPT-CAT-2</EXECUTION-CONTEXT>
            [!ELSE!][!//
              <EXECUTION-CONTEXT>INTERRUPT-CAT-1</EXECUTION-CONTEXT>
            [!ENDIF!][!//
              <SW-SERVICE-IMPL-POLICY>STANDARD</SW-SERVICE-IMPL-POLICY>
              <BSW-ENTRY-KIND>CONCRETE</BSW-ENTRY-KIND>
            </BSW-MODULE-ENTRY>
            <BSW-MODULE-ENTRY UUID="e5d4c7bb-cd64-4c77-92e1-c3e3d013f5b5">
              <SHORT-NAME>Cdd_Pwm_G2_Ch0Isr</SHORT-NAME>
              <IS-REENTRANT>false</IS-REENTRANT>
              <IS-SYNCHRONOUS>true</IS-SYNCHRONOUS>
              <CALL-TYPE>INTERRUPT</CALL-TYPE>
            [!IF "as:modconf('Cdd_Pwm')[1]/CddPwmGeneral/CddPwmTypeofInterruptFunction = 'CDD_PWM_ISR_CAT2'"!][!//
              <EXECUTION-CONTEXT>INTERRUPT-CAT-2</EXECUTION-CONTEXT>
            [!ELSE!][!//
              <EXECUTION-CONTEXT>INTERRUPT-CAT-1</EXECUTION-CONTEXT>
            [!ENDIF!][!//
              <SW-SERVICE-IMPL-POLICY>STANDARD</SW-SERVICE-IMPL-POLICY>
              <BSW-ENTRY-KIND>CONCRETE</BSW-ENTRY-KIND>
            </BSW-MODULE-ENTRY>
            <BSW-MODULE-ENTRY UUID="dd556956-5293-4212-8490-805f633aaa22">
              <SHORT-NAME>Cdd_Pwm_G2_Ch1Isr</SHORT-NAME>
              <IS-REENTRANT>false</IS-REENTRANT>
              <IS-SYNCHRONOUS>true</IS-SYNCHRONOUS>
              <CALL-TYPE>INTERRUPT</CALL-TYPE>
            [!IF "as:modconf('Cdd_Pwm')[1]/CddPwmGeneral/CddPwmTypeofInterruptFunction = 'CDD_PWM_ISR_CAT2'"!][!//
              <EXECUTION-CONTEXT>INTERRUPT-CAT-2</EXECUTION-CONTEXT>
            [!ELSE!][!//
              <EXECUTION-CONTEXT>INTERRUPT-CAT-1</EXECUTION-CONTEXT>
            [!ENDIF!][!//
              <SW-SERVICE-IMPL-POLICY>STANDARD</SW-SERVICE-IMPL-POLICY>
              <BSW-ENTRY-KIND>CONCRETE</BSW-ENTRY-KIND>
            </BSW-MODULE-ENTRY>
            <BSW-MODULE-ENTRY UUID="8918b8ce-1199-41da-897c-659abab4d0b0">
              <SHORT-NAME>Cdd_Pwm_G2_Ch2Isr</SHORT-NAME>
              <IS-REENTRANT>false</IS-REENTRANT>
              <IS-SYNCHRONOUS>true</IS-SYNCHRONOUS>
              <CALL-TYPE>INTERRUPT</CALL-TYPE>
            [!IF "as:modconf('Cdd_Pwm')[1]/CddPwmGeneral/CddPwmTypeofInterruptFunction = 'CDD_PWM_ISR_CAT2'"!][!//
              <EXECUTION-CONTEXT>INTERRUPT-CAT-2</EXECUTION-CONTEXT>
            [!ELSE!][!//
              <EXECUTION-CONTEXT>INTERRUPT-CAT-1</EXECUTION-CONTEXT>
            [!ENDIF!][!//
              <SW-SERVICE-IMPL-POLICY>STANDARD</SW-SERVICE-IMPL-POLICY>
              <BSW-ENTRY-KIND>CONCRETE</BSW-ENTRY-KIND>
            </BSW-MODULE-ENTRY>
            <BSW-MODULE-ENTRY UUID="8a415d52-fe50-4c44-8fdb-433029d062bb">
              <SHORT-NAME>Cdd_Pwm_G2_Ch3Isr</SHORT-NAME>
              <IS-REENTRANT>false</IS-REENTRANT>
              <IS-SYNCHRONOUS>true</IS-SYNCHRONOUS>
              <CALL-TYPE>INTERRUPT</CALL-TYPE>
            [!IF "as:modconf('Cdd_Pwm')[1]/CddPwmGeneral/CddPwmTypeofInterruptFunction = 'CDD_PWM_ISR_CAT2'"!][!//
              <EXECUTION-CONTEXT>INTERRUPT-CAT-2</EXECUTION-CONTEXT>
            [!ELSE!][!//
              <EXECUTION-CONTEXT>INTERRUPT-CAT-1</EXECUTION-CONTEXT>
            [!ENDIF!][!//
              <SW-SERVICE-IMPL-POLICY>STANDARD</SW-SERVICE-IMPL-POLICY>
              <BSW-ENTRY-KIND>CONCRETE</BSW-ENTRY-KIND>
            </BSW-MODULE-ENTRY>
            <BSW-MODULE-ENTRY UUID="9754d0cd-b27a-4095-90ec-bb7595d5a3b6">
              <SHORT-NAME>Cdd_Pwm_G2_Ch4Isr</SHORT-NAME>
              <IS-REENTRANT>false</IS-REENTRANT>
              <IS-SYNCHRONOUS>true</IS-SYNCHRONOUS>
              <CALL-TYPE>INTERRUPT</CALL-TYPE>
            [!IF "as:modconf('Cdd_Pwm')[1]/CddPwmGeneral/CddPwmTypeofInterruptFunction = 'CDD_PWM_ISR_CAT2'"!][!//
              <EXECUTION-CONTEXT>INTERRUPT-CAT-2</EXECUTION-CONTEXT>
            [!ELSE!][!//
              <EXECUTION-CONTEXT>INTERRUPT-CAT-1</EXECUTION-CONTEXT>
            [!ENDIF!][!//
              <SW-SERVICE-IMPL-POLICY>STANDARD</SW-SERVICE-IMPL-POLICY>
              <BSW-ENTRY-KIND>CONCRETE</BSW-ENTRY-KIND>
            </BSW-MODULE-ENTRY>
            <BSW-MODULE-ENTRY UUID="94019e17-6930-40e4-823d-01b0ed5fe392">
              <SHORT-NAME>Cdd_Pwm_G2_Ch5Isr</SHORT-NAME>
              <IS-REENTRANT>false</IS-REENTRANT>
              <IS-SYNCHRONOUS>true</IS-SYNCHRONOUS>
              <CALL-TYPE>INTERRUPT</CALL-TYPE>
            [!IF "as:modconf('Cdd_Pwm')[1]/CddPwmGeneral/CddPwmTypeofInterruptFunction = 'CDD_PWM_ISR_CAT2'"!][!//
              <EXECUTION-CONTEXT>INTERRUPT-CAT-2</EXECUTION-CONTEXT>
            [!ELSE!][!//
              <EXECUTION-CONTEXT>INTERRUPT-CAT-1</EXECUTION-CONTEXT>
            [!ENDIF!][!//
              <SW-SERVICE-IMPL-POLICY>STANDARD</SW-SERVICE-IMPL-POLICY>
              <BSW-ENTRY-KIND>CONCRETE</BSW-ENTRY-KIND>
            </BSW-MODULE-ENTRY>
            <BSW-MODULE-ENTRY UUID="e7601b27-c969-4ad0-85f7-08664028a845">
              <SHORT-NAME>Cdd_Pwm_G2_Ch6Isr</SHORT-NAME>
              <IS-REENTRANT>false</IS-REENTRANT>
              <IS-SYNCHRONOUS>true</IS-SYNCHRONOUS>
              <CALL-TYPE>INTERRUPT</CALL-TYPE>
            [!IF "as:modconf('Cdd_Pwm')[1]/CddPwmGeneral/CddPwmTypeofInterruptFunction = 'CDD_PWM_ISR_CAT2'"!][!//
              <EXECUTION-CONTEXT>INTERRUPT-CAT-2</EXECUTION-CONTEXT>
            [!ELSE!][!//
              <EXECUTION-CONTEXT>INTERRUPT-CAT-1</EXECUTION-CONTEXT>
            [!ENDIF!][!//
              <SW-SERVICE-IMPL-POLICY>STANDARD</SW-SERVICE-IMPL-POLICY>
              <BSW-ENTRY-KIND>CONCRETE</BSW-ENTRY-KIND>
            </BSW-MODULE-ENTRY>
            <BSW-MODULE-ENTRY UUID="7755310c-4376-428e-89c4-a6e9bc3a2c17">
              <SHORT-NAME>Cdd_Pwm_G2_Ch7Isr</SHORT-NAME>
              <IS-REENTRANT>false</IS-REENTRANT>
              <IS-SYNCHRONOUS>true</IS-SYNCHRONOUS>
              <CALL-TYPE>INTERRUPT</CALL-TYPE>
            [!IF "as:modconf('Cdd_Pwm')[1]/CddPwmGeneral/CddPwmTypeofInterruptFunction = 'CDD_PWM_ISR_CAT2'"!][!//
              <EXECUTION-CONTEXT>INTERRUPT-CAT-2</EXECUTION-CONTEXT>
            [!ELSE!][!//
              <EXECUTION-CONTEXT>INTERRUPT-CAT-1</EXECUTION-CONTEXT>
            [!ENDIF!][!//
              <SW-SERVICE-IMPL-POLICY>STANDARD</SW-SERVICE-IMPL-POLICY>
              <BSW-ENTRY-KIND>CONCRETE</BSW-ENTRY-KIND>
            </BSW-MODULE-ENTRY>
            <BSW-MODULE-ENTRY UUID="7460e205-2213-4e44-bbb3-fb9718c13c74">
              <SHORT-NAME>Cdd_Pwm_G2_Ch8Isr</SHORT-NAME>
              <IS-REENTRANT>false</IS-REENTRANT>
              <IS-SYNCHRONOUS>true</IS-SYNCHRONOUS>
              <CALL-TYPE>INTERRUPT</CALL-TYPE>
            [!IF "as:modconf('Cdd_Pwm')[1]/CddPwmGeneral/CddPwmTypeofInterruptFunction = 'CDD_PWM_ISR_CAT2'"!][!//
              <EXECUTION-CONTEXT>INTERRUPT-CAT-2</EXECUTION-CONTEXT>
            [!ELSE!][!//
              <EXECUTION-CONTEXT>INTERRUPT-CAT-1</EXECUTION-CONTEXT>
            [!ENDIF!][!//
              <SW-SERVICE-IMPL-POLICY>STANDARD</SW-SERVICE-IMPL-POLICY>
              <BSW-ENTRY-KIND>CONCRETE</BSW-ENTRY-KIND>
            </BSW-MODULE-ENTRY>
            <BSW-MODULE-ENTRY UUID="ed094e8f-80fa-41a8-ba2a-1517b0a1e01a">
              <SHORT-NAME>Cdd_Pwm_G2_Ch9Isr</SHORT-NAME>
              <IS-REENTRANT>false</IS-REENTRANT>
              <IS-SYNCHRONOUS>true</IS-SYNCHRONOUS>
              <CALL-TYPE>INTERRUPT</CALL-TYPE>
            [!IF "as:modconf('Cdd_Pwm')[1]/CddPwmGeneral/CddPwmTypeofInterruptFunction = 'CDD_PWM_ISR_CAT2'"!][!//
              <EXECUTION-CONTEXT>INTERRUPT-CAT-2</EXECUTION-CONTEXT>
            [!ELSE!][!//
              <EXECUTION-CONTEXT>INTERRUPT-CAT-1</EXECUTION-CONTEXT>
            [!ENDIF!][!//
              <SW-SERVICE-IMPL-POLICY>STANDARD</SW-SERVICE-IMPL-POLICY>
              <BSW-ENTRY-KIND>CONCRETE</BSW-ENTRY-KIND>
            </BSW-MODULE-ENTRY>
            <BSW-MODULE-ENTRY UUID="a90ca5e2-7c01-459c-8292-6be1ed6c8fda">
              <SHORT-NAME>Cdd_Pwm_G2_TzCh0Isr</SHORT-NAME>
              <IS-REENTRANT>false</IS-REENTRANT>
              <IS-SYNCHRONOUS>true</IS-SYNCHRONOUS>
              <CALL-TYPE>INTERRUPT</CALL-TYPE>
            [!IF "as:modconf('Cdd_Pwm')[1]/CddPwmGeneral/CddPwmTypeofInterruptFunction = 'CDD_PWM_ISR_CAT2'"!][!//
              <EXECUTION-CONTEXT>INTERRUPT-CAT-2</EXECUTION-CONTEXT>
            [!ELSE!][!//
              <EXECUTION-CONTEXT>INTERRUPT-CAT-1</EXECUTION-CONTEXT>
            [!ENDIF!][!//
              <SW-SERVICE-IMPL-POLICY>STANDARD</SW-SERVICE-IMPL-POLICY>
              <BSW-ENTRY-KIND>CONCRETE</BSW-ENTRY-KIND>
            </BSW-MODULE-ENTRY>
            <BSW-MODULE-ENTRY UUID="e163dd60-bcb5-4d7b-94de-d81ce976b62d">
              <SHORT-NAME>Cdd_Pwm_G2_TzCh1Isr</SHORT-NAME>
              <IS-REENTRANT>false</IS-REENTRANT>
              <IS-SYNCHRONOUS>true</IS-SYNCHRONOUS>
              <CALL-TYPE>INTERRUPT</CALL-TYPE>
            [!IF "as:modconf('Cdd_Pwm')[1]/CddPwmGeneral/CddPwmTypeofInterruptFunction = 'CDD_PWM_ISR_CAT2'"!][!//
              <EXECUTION-CONTEXT>INTERRUPT-CAT-2</EXECUTION-CONTEXT>
            [!ELSE!][!//
              <EXECUTION-CONTEXT>INTERRUPT-CAT-1</EXECUTION-CONTEXT>
            [!ENDIF!][!//
              <SW-SERVICE-IMPL-POLICY>STANDARD</SW-SERVICE-IMPL-POLICY>
              <BSW-ENTRY-KIND>CONCRETE</BSW-ENTRY-KIND>
            </BSW-MODULE-ENTRY>
            <BSW-MODULE-ENTRY UUID="94badff3-9f04-48e0-8e1e-352b1f6c6230">
              <SHORT-NAME>Cdd_Pwm_G2_TzCh2Isr</SHORT-NAME>
              <IS-REENTRANT>false</IS-REENTRANT>
              <IS-SYNCHRONOUS>true</IS-SYNCHRONOUS>
              <CALL-TYPE>INTERRUPT</CALL-TYPE>
            [!IF "as:modconf('Cdd_Pwm')[1]/CddPwmGeneral/CddPwmTypeofInterruptFunction = 'CDD_PWM_ISR_CAT2'"!][!//
              <EXECUTION-CONTEXT>INTERRUPT-CAT-2</EXECUTION-CONTEXT>
            [!ELSE!][!//
              <EXECUTION-CONTEXT>INTERRUPT-CAT-1</EXECUTION-CONTEXT>
            [!ENDIF!][!//
              <SW-SERVICE-IMPL-POLICY>STANDARD</SW-SERVICE-IMPL-POLICY>
              <BSW-ENTRY-KIND>CONCRETE</BSW-ENTRY-KIND>
            </BSW-MODULE-ENTRY>
            <BSW-MODULE-ENTRY UUID="ba390563-0080-44e5-9e9a-5c5960e122ca">
              <SHORT-NAME>Cdd_Pwm_G2_TzCh3Isr</SHORT-NAME>
              <IS-REENTRANT>false</IS-REENTRANT>
              <IS-SYNCHRONOUS>true</IS-SYNCHRONOUS>
              <CALL-TYPE>INTERRUPT</CALL-TYPE>
            [!IF "as:modconf('Cdd_Pwm')[1]/CddPwmGeneral/CddPwmTypeofInterruptFunction = 'CDD_PWM_ISR_CAT2'"!][!//
              <EXECUTION-CONTEXT>INTERRUPT-CAT-2</EXECUTION-CONTEXT>
            [!ELSE!][!//
              <EXECUTION-CONTEXT>INTERRUPT-CAT-1</EXECUTION-CONTEXT>
            [!ENDIF!][!//
              <SW-SERVICE-IMPL-POLICY>STANDARD</SW-SERVICE-IMPL-POLICY>
              <BSW-ENTRY-KIND>CONCRETE</BSW-ENTRY-KIND>
            </BSW-MODULE-ENTRY>
            <BSW-MODULE-ENTRY UUID="546e4b5c-ece4-493a-9995-88a4ae7633ff">
              <SHORT-NAME>Cdd_Pwm_G2_TzCh4Isr</SHORT-NAME>
              <IS-REENTRANT>false</IS-REENTRANT>
              <IS-SYNCHRONOUS>true</IS-SYNCHRONOUS>
              <CALL-TYPE>INTERRUPT</CALL-TYPE>
            [!IF "as:modconf('Cdd_Pwm')[1]/CddPwmGeneral/CddPwmTypeofInterruptFunction = 'CDD_PWM_ISR_CAT2'"!][!//
              <EXECUTION-CONTEXT>INTERRUPT-CAT-2</EXECUTION-CONTEXT>
            [!ELSE!][!//
              <EXECUTION-CONTEXT>INTERRUPT-CAT-1</EXECUTION-CONTEXT>
            [!ENDIF!][!//
              <SW-SERVICE-IMPL-POLICY>STANDARD</SW-SERVICE-IMPL-POLICY>
              <BSW-ENTRY-KIND>CONCRETE</BSW-ENTRY-KIND>
            </BSW-MODULE-ENTRY>
            <BSW-MODULE-ENTRY UUID="0a1cf421-3e76-4ae3-836f-5c13f1d053f4">
              <SHORT-NAME>Cdd_Pwm_G2_TzCh5Isr</SHORT-NAME>
              <IS-REENTRANT>false</IS-REENTRANT>
              <IS-SYNCHRONOUS>true</IS-SYNCHRONOUS>
              <CALL-TYPE>INTERRUPT</CALL-TYPE>
            [!IF "as:modconf('Cdd_Pwm')[1]/CddPwmGeneral/CddPwmTypeofInterruptFunction = 'CDD_PWM_ISR_CAT2'"!][!//
              <EXECUTION-CONTEXT>INTERRUPT-CAT-2</EXECUTION-CONTEXT>
            [!ELSE!][!//
              <EXECUTION-CONTEXT>INTERRUPT-CAT-1</EXECUTION-CONTEXT>
            [!ENDIF!][!//
              <SW-SERVICE-IMPL-POLICY>STANDARD</SW-SERVICE-IMPL-POLICY>
              <BSW-ENTRY-KIND>CONCRETE</BSW-ENTRY-KIND>
            </BSW-MODULE-ENTRY>
            <BSW-MODULE-ENTRY UUID="a61ba307-2540-496f-bddc-6cc603bd097f">
              <SHORT-NAME>Cdd_Pwm_G2_TzCh6Isr</SHORT-NAME>
              <IS-REENTRANT>false</IS-REENTRANT>
              <IS-SYNCHRONOUS>true</IS-SYNCHRONOUS>
              <CALL-TYPE>INTERRUPT</CALL-TYPE>
            [!IF "as:modconf('Cdd_Pwm')[1]/CddPwmGeneral/CddPwmTypeofInterruptFunction = 'CDD_PWM_ISR_CAT2'"!][!//
              <EXECUTION-CONTEXT>INTERRUPT-CAT-2</EXECUTION-CONTEXT>
            [!ELSE!][!//
              <EXECUTION-CONTEXT>INTERRUPT-CAT-1</EXECUTION-CONTEXT>
            [!ENDIF!][!//
              <SW-SERVICE-IMPL-POLICY>STANDARD</SW-SERVICE-IMPL-POLICY>
              <BSW-ENTRY-KIND>CONCRETE</BSW-ENTRY-KIND>
            </BSW-MODULE-ENTRY>
            <BSW-MODULE-ENTRY UUID="504ebfac-daab-4bff-980b-5377496250b8">
              <SHORT-NAME>Cdd_Pwm_G2_TzCh7Isr</SHORT-NAME>
              <IS-REENTRANT>false</IS-REENTRANT>
              <IS-SYNCHRONOUS>true</IS-SYNCHRONOUS>
              <CALL-TYPE>INTERRUPT</CALL-TYPE>
            [!IF "as:modconf('Cdd_Pwm')[1]/CddPwmGeneral/CddPwmTypeofInterruptFunction = 'CDD_PWM_ISR_CAT2'"!][!//
              <EXECUTION-CONTEXT>INTERRUPT-CAT-2</EXECUTION-CONTEXT>
            [!ELSE!][!//
              <EXECUTION-CONTEXT>INTERRUPT-CAT-1</EXECUTION-CONTEXT>
            [!ENDIF!][!//
              <SW-SERVICE-IMPL-POLICY>STANDARD</SW-SERVICE-IMPL-POLICY>
              <BSW-ENTRY-KIND>CONCRETE</BSW-ENTRY-KIND>
            </BSW-MODULE-ENTRY>
            <BSW-MODULE-ENTRY UUID="e531e37c-cfa2-4afc-8b0e-e8c8425c4fea">
              <SHORT-NAME>Cdd_Pwm_G2_TzCh8Isr</SHORT-NAME>
              <IS-REENTRANT>false</IS-REENTRANT>
              <IS-SYNCHRONOUS>true</IS-SYNCHRONOUS>
              <CALL-TYPE>INTERRUPT</CALL-TYPE>
            [!IF "as:modconf('Cdd_Pwm')[1]/CddPwmGeneral/CddPwmTypeofInterruptFunction = 'CDD_PWM_ISR_CAT2'"!][!//
              <EXECUTION-CONTEXT>INTERRUPT-CAT-2</EXECUTION-CONTEXT>
            [!ELSE!][!//
              <EXECUTION-CONTEXT>INTERRUPT-CAT-1</EXECUTION-CONTEXT>
            [!ENDIF!][!//
              <SW-SERVICE-IMPL-POLICY>STANDARD</SW-SERVICE-IMPL-POLICY>
              <BSW-ENTRY-KIND>CONCRETE</BSW-ENTRY-KIND>
            </BSW-MODULE-ENTRY>
            <BSW-MODULE-ENTRY UUID="a2472f48-44e3-4ba9-88e8-23e8196e5858">
              <SHORT-NAME>Cdd_Pwm_G2_TzCh9Isr</SHORT-NAME>
              <IS-REENTRANT>false</IS-REENTRANT>
              <IS-SYNCHRONOUS>true</IS-SYNCHRONOUS>
              <CALL-TYPE>INTERRUPT</CALL-TYPE>
            [!IF "as:modconf('Cdd_Pwm')[1]/CddPwmGeneral/CddPwmTypeofInterruptFunction = 'CDD_PWM_ISR_CAT2'"!][!//
              <EXECUTION-CONTEXT>INTERRUPT-CAT-2</EXECUTION-CONTEXT>
            [!ELSE!][!//
              <EXECUTION-CONTEXT>INTERRUPT-CAT-1</EXECUTION-CONTEXT>
            [!ENDIF!][!//
              <SW-SERVICE-IMPL-POLICY>STANDARD</SW-SERVICE-IMPL-POLICY>
              <BSW-ENTRY-KIND>CONCRETE</BSW-ENTRY-KIND>
            </BSW-MODULE-ENTRY>
            <BSW-MODULE-ENTRY UUID="72e91c0e-4cd3-44d3-9e03-0e85dc3c05ff">
              <SHORT-NAME>Cdd_Pwm_G3_Ch0Isr</SHORT-NAME>
              <IS-REENTRANT>false</IS-REENTRANT>
              <IS-SYNCHRONOUS>true</IS-SYNCHRONOUS>
              <CALL-TYPE>INTERRUPT</CALL-TYPE>
            [!IF "as:modconf('Cdd_Pwm')[1]/CddPwmGeneral/CddPwmTypeofInterruptFunction = 'CDD_PWM_ISR_CAT2'"!][!//
              <EXECUTION-CONTEXT>INTERRUPT-CAT-2</EXECUTION-CONTEXT>
            [!ELSE!][!//
              <EXECUTION-CONTEXT>INTERRUPT-CAT-1</EXECUTION-CONTEXT>
            [!ENDIF!][!//
              <SW-SERVICE-IMPL-POLICY>STANDARD</SW-SERVICE-IMPL-POLICY>
              <BSW-ENTRY-KIND>CONCRETE</BSW-ENTRY-KIND>
            </BSW-MODULE-ENTRY>
            <BSW-MODULE-ENTRY UUID="f518524a-1d30-422a-a1c3-a991212fd627">
              <SHORT-NAME>Cdd_Pwm_G3_Ch1Isr</SHORT-NAME>
              <IS-REENTRANT>false</IS-REENTRANT>
              <IS-SYNCHRONOUS>true</IS-SYNCHRONOUS>
              <CALL-TYPE>INTERRUPT</CALL-TYPE>
            [!IF "as:modconf('Cdd_Pwm')[1]/CddPwmGeneral/CddPwmTypeofInterruptFunction = 'CDD_PWM_ISR_CAT2'"!][!//
              <EXECUTION-CONTEXT>INTERRUPT-CAT-2</EXECUTION-CONTEXT>
            [!ELSE!][!//
              <EXECUTION-CONTEXT>INTERRUPT-CAT-1</EXECUTION-CONTEXT>
            [!ENDIF!][!//
              <SW-SERVICE-IMPL-POLICY>STANDARD</SW-SERVICE-IMPL-POLICY>
              <BSW-ENTRY-KIND>CONCRETE</BSW-ENTRY-KIND>
            </BSW-MODULE-ENTRY>
            <BSW-MODULE-ENTRY UUID="5c16964a-be1f-415f-b210-2fc05b05c25e">
              <SHORT-NAME>Cdd_Pwm_G3_Ch2Isr</SHORT-NAME>
              <IS-REENTRANT>false</IS-REENTRANT>
              <IS-SYNCHRONOUS>true</IS-SYNCHRONOUS>
              <CALL-TYPE>INTERRUPT</CALL-TYPE>
            [!IF "as:modconf('Cdd_Pwm')[1]/CddPwmGeneral/CddPwmTypeofInterruptFunction = 'CDD_PWM_ISR_CAT2'"!][!//
              <EXECUTION-CONTEXT>INTERRUPT-CAT-2</EXECUTION-CONTEXT>
            [!ELSE!][!//
              <EXECUTION-CONTEXT>INTERRUPT-CAT-1</EXECUTION-CONTEXT>
            [!ENDIF!][!//
              <SW-SERVICE-IMPL-POLICY>STANDARD</SW-SERVICE-IMPL-POLICY>
              <BSW-ENTRY-KIND>CONCRETE</BSW-ENTRY-KIND>
            </BSW-MODULE-ENTRY>
            <BSW-MODULE-ENTRY UUID="50071155-e0f7-4a95-8514-98f171089202">
              <SHORT-NAME>Cdd_Pwm_G3_Ch3Isr</SHORT-NAME>
              <IS-REENTRANT>false</IS-REENTRANT>
              <IS-SYNCHRONOUS>true</IS-SYNCHRONOUS>
              <CALL-TYPE>INTERRUPT</CALL-TYPE>
            [!IF "as:modconf('Cdd_Pwm')[1]/CddPwmGeneral/CddPwmTypeofInterruptFunction = 'CDD_PWM_ISR_CAT2'"!][!//
              <EXECUTION-CONTEXT>INTERRUPT-CAT-2</EXECUTION-CONTEXT>
            [!ELSE!][!//
              <EXECUTION-CONTEXT>INTERRUPT-CAT-1</EXECUTION-CONTEXT>
            [!ENDIF!][!//
              <SW-SERVICE-IMPL-POLICY>STANDARD</SW-SERVICE-IMPL-POLICY>
              <BSW-ENTRY-KIND>CONCRETE</BSW-ENTRY-KIND>
            </BSW-MODULE-ENTRY>
            <BSW-MODULE-ENTRY UUID="2ac76dc2-28ce-4676-ae2d-57f993f73f17">
              <SHORT-NAME>Cdd_Pwm_G3_Ch4Isr</SHORT-NAME>
              <IS-REENTRANT>false</IS-REENTRANT>
              <IS-SYNCHRONOUS>true</IS-SYNCHRONOUS>
              <CALL-TYPE>INTERRUPT</CALL-TYPE>
            [!IF "as:modconf('Cdd_Pwm')[1]/CddPwmGeneral/CddPwmTypeofInterruptFunction = 'CDD_PWM_ISR_CAT2'"!][!//
              <EXECUTION-CONTEXT>INTERRUPT-CAT-2</EXECUTION-CONTEXT>
            [!ELSE!][!//
              <EXECUTION-CONTEXT>INTERRUPT-CAT-1</EXECUTION-CONTEXT>
            [!ENDIF!][!//
              <SW-SERVICE-IMPL-POLICY>STANDARD</SW-SERVICE-IMPL-POLICY>
              <BSW-ENTRY-KIND>CONCRETE</BSW-ENTRY-KIND>
            </BSW-MODULE-ENTRY>
            <BSW-MODULE-ENTRY UUID="b6257a61-1124-41cc-9841-19f9bd227c77">
              <SHORT-NAME>Cdd_Pwm_G3_Ch5Isr</SHORT-NAME>
              <IS-REENTRANT>false</IS-REENTRANT>
              <IS-SYNCHRONOUS>true</IS-SYNCHRONOUS>
              <CALL-TYPE>INTERRUPT</CALL-TYPE>
            [!IF "as:modconf('Cdd_Pwm')[1]/CddPwmGeneral/CddPwmTypeofInterruptFunction = 'CDD_PWM_ISR_CAT2'"!][!//
              <EXECUTION-CONTEXT>INTERRUPT-CAT-2</EXECUTION-CONTEXT>
            [!ELSE!][!//
              <EXECUTION-CONTEXT>INTERRUPT-CAT-1</EXECUTION-CONTEXT>
            [!ENDIF!][!//
              <SW-SERVICE-IMPL-POLICY>STANDARD</SW-SERVICE-IMPL-POLICY>
              <BSW-ENTRY-KIND>CONCRETE</BSW-ENTRY-KIND>
            </BSW-MODULE-ENTRY>
            <BSW-MODULE-ENTRY UUID="132d9382-32f9-4b24-96f7-bce894d231bb">
              <SHORT-NAME>Cdd_Pwm_G3_Ch6Isr</SHORT-NAME>
              <IS-REENTRANT>false</IS-REENTRANT>
              <IS-SYNCHRONOUS>true</IS-SYNCHRONOUS>
              <CALL-TYPE>INTERRUPT</CALL-TYPE>
            [!IF "as:modconf('Cdd_Pwm')[1]/CddPwmGeneral/CddPwmTypeofInterruptFunction = 'CDD_PWM_ISR_CAT2'"!][!//
              <EXECUTION-CONTEXT>INTERRUPT-CAT-2</EXECUTION-CONTEXT>
            [!ELSE!][!//
              <EXECUTION-CONTEXT>INTERRUPT-CAT-1</EXECUTION-CONTEXT>
            [!ENDIF!][!//
              <SW-SERVICE-IMPL-POLICY>STANDARD</SW-SERVICE-IMPL-POLICY>
              <BSW-ENTRY-KIND>CONCRETE</BSW-ENTRY-KIND>
            </BSW-MODULE-ENTRY>
            <BSW-MODULE-ENTRY UUID="1848fe83-862d-47ad-97c9-abede024585c">
              <SHORT-NAME>Cdd_Pwm_G3_Ch7Isr</SHORT-NAME>
              <IS-REENTRANT>false</IS-REENTRANT>
              <IS-SYNCHRONOUS>true</IS-SYNCHRONOUS>
              <CALL-TYPE>INTERRUPT</CALL-TYPE>
            [!IF "as:modconf('Cdd_Pwm')[1]/CddPwmGeneral/CddPwmTypeofInterruptFunction = 'CDD_PWM_ISR_CAT2'"!][!//
              <EXECUTION-CONTEXT>INTERRUPT-CAT-2</EXECUTION-CONTEXT>
            [!ELSE!][!//
              <EXECUTION-CONTEXT>INTERRUPT-CAT-1</EXECUTION-CONTEXT>
            [!ENDIF!][!//
              <SW-SERVICE-IMPL-POLICY>STANDARD</SW-SERVICE-IMPL-POLICY>
              <BSW-ENTRY-KIND>CONCRETE</BSW-ENTRY-KIND>
            </BSW-MODULE-ENTRY>
            <BSW-MODULE-ENTRY UUID="b1a42b01-52b8-44a7-ab1e-8a22fdc2a646">
              <SHORT-NAME>Cdd_Pwm_G3_Ch8Isr</SHORT-NAME>
              <IS-REENTRANT>false</IS-REENTRANT>
              <IS-SYNCHRONOUS>true</IS-SYNCHRONOUS>
              <CALL-TYPE>INTERRUPT</CALL-TYPE>
            [!IF "as:modconf('Cdd_Pwm')[1]/CddPwmGeneral/CddPwmTypeofInterruptFunction = 'CDD_PWM_ISR_CAT2'"!][!//
              <EXECUTION-CONTEXT>INTERRUPT-CAT-2</EXECUTION-CONTEXT>
            [!ELSE!][!//
              <EXECUTION-CONTEXT>INTERRUPT-CAT-1</EXECUTION-CONTEXT>
            [!ENDIF!][!//
              <SW-SERVICE-IMPL-POLICY>STANDARD</SW-SERVICE-IMPL-POLICY>
              <BSW-ENTRY-KIND>CONCRETE</BSW-ENTRY-KIND>
            </BSW-MODULE-ENTRY>
            <BSW-MODULE-ENTRY UUID="bdfcf054-c76d-4234-b51a-d166afd1d2f1">
              <SHORT-NAME>Cdd_Pwm_G3_Ch9Isr</SHORT-NAME>
              <IS-REENTRANT>false</IS-REENTRANT>
              <IS-SYNCHRONOUS>true</IS-SYNCHRONOUS>
              <CALL-TYPE>INTERRUPT</CALL-TYPE>
            [!IF "as:modconf('Cdd_Pwm')[1]/CddPwmGeneral/CddPwmTypeofInterruptFunction = 'CDD_PWM_ISR_CAT2'"!][!//
              <EXECUTION-CONTEXT>INTERRUPT-CAT-2</EXECUTION-CONTEXT>
            [!ELSE!][!//
              <EXECUTION-CONTEXT>INTERRUPT-CAT-1</EXECUTION-CONTEXT>
            [!ENDIF!][!//
              <SW-SERVICE-IMPL-POLICY>STANDARD</SW-SERVICE-IMPL-POLICY>
              <BSW-ENTRY-KIND>CONCRETE</BSW-ENTRY-KIND>
            </BSW-MODULE-ENTRY>
            <BSW-MODULE-ENTRY UUID="4fb2ceda-3f29-4608-935f-7470cf92b480">
              <SHORT-NAME>Cdd_Pwm_G3_TzCh0Isr</SHORT-NAME>
              <IS-REENTRANT>false</IS-REENTRANT>
              <IS-SYNCHRONOUS>true</IS-SYNCHRONOUS>
              <CALL-TYPE>INTERRUPT</CALL-TYPE>
            [!IF "as:modconf('Cdd_Pwm')[1]/CddPwmGeneral/CddPwmTypeofInterruptFunction = 'CDD_PWM_ISR_CAT2'"!][!//
              <EXECUTION-CONTEXT>INTERRUPT-CAT-2</EXECUTION-CONTEXT>
            [!ELSE!][!//
              <EXECUTION-CONTEXT>INTERRUPT-CAT-1</EXECUTION-CONTEXT>
            [!ENDIF!][!//
              <SW-SERVICE-IMPL-POLICY>STANDARD</SW-SERVICE-IMPL-POLICY>
              <BSW-ENTRY-KIND>CONCRETE</BSW-ENTRY-KIND>
            </BSW-MODULE-ENTRY>
            <BSW-MODULE-ENTRY UUID="33b0e71d-3a91-41f8-a3b4-dc26b384225e">
              <SHORT-NAME>Cdd_Pwm_G3_TzCh1Isr</SHORT-NAME>
              <IS-REENTRANT>false</IS-REENTRANT>
              <IS-SYNCHRONOUS>true</IS-SYNCHRONOUS>
              <CALL-TYPE>INTERRUPT</CALL-TYPE>
            [!IF "as:modconf('Cdd_Pwm')[1]/CddPwmGeneral/CddPwmTypeofInterruptFunction = 'CDD_PWM_ISR_CAT2'"!][!//
              <EXECUTION-CONTEXT>INTERRUPT-CAT-2</EXECUTION-CONTEXT>
            [!ELSE!][!//
              <EXECUTION-CONTEXT>INTERRUPT-CAT-1</EXECUTION-CONTEXT>
            [!ENDIF!][!//
              <SW-SERVICE-IMPL-POLICY>STANDARD</SW-SERVICE-IMPL-POLICY>
              <BSW-ENTRY-KIND>CONCRETE</BSW-ENTRY-KIND>
            </BSW-MODULE-ENTRY>
            <BSW-MODULE-ENTRY UUID="298c675a-717b-4961-ac92-d16781cb2300">
              <SHORT-NAME>Cdd_Pwm_G3_TzCh2Isr</SHORT-NAME>
              <IS-REENTRANT>false</IS-REENTRANT>
              <IS-SYNCHRONOUS>true</IS-SYNCHRONOUS>
              <CALL-TYPE>INTERRUPT</CALL-TYPE>
            [!IF "as:modconf('Cdd_Pwm')[1]/CddPwmGeneral/CddPwmTypeofInterruptFunction = 'CDD_PWM_ISR_CAT2'"!][!//
              <EXECUTION-CONTEXT>INTERRUPT-CAT-2</EXECUTION-CONTEXT>
            [!ELSE!][!//
              <EXECUTION-CONTEXT>INTERRUPT-CAT-1</EXECUTION-CONTEXT>
            [!ENDIF!][!//
              <SW-SERVICE-IMPL-POLICY>STANDARD</SW-SERVICE-IMPL-POLICY>
              <BSW-ENTRY-KIND>CONCRETE</BSW-ENTRY-KIND>
            </BSW-MODULE-ENTRY>
            <BSW-MODULE-ENTRY UUID="c5ebd4fa-221f-484a-8032-b832534c2024">
              <SHORT-NAME>Cdd_Pwm_G3_TzCh3Isr</SHORT-NAME>
              <IS-REENTRANT>false</IS-REENTRANT>
              <IS-SYNCHRONOUS>true</IS-SYNCHRONOUS>
              <CALL-TYPE>INTERRUPT</CALL-TYPE>
            [!IF "as:modconf('Cdd_Pwm')[1]/CddPwmGeneral/CddPwmTypeofInterruptFunction = 'CDD_PWM_ISR_CAT2'"!][!//
              <EXECUTION-CONTEXT>INTERRUPT-CAT-2</EXECUTION-CONTEXT>
            [!ELSE!][!//
              <EXECUTION-CONTEXT>INTERRUPT-CAT-1</EXECUTION-CONTEXT>
            [!ENDIF!][!//
              <SW-SERVICE-IMPL-POLICY>STANDARD</SW-SERVICE-IMPL-POLICY>
              <BSW-ENTRY-KIND>CONCRETE</BSW-ENTRY-KIND>
            </BSW-MODULE-ENTRY>
            <BSW-MODULE-ENTRY UUID="ad3e8442-4c26-497a-8280-fa643b7cf779">
              <SHORT-NAME>Cdd_Pwm_G3_TzCh4Isr</SHORT-NAME>
              <IS-REENTRANT>false</IS-REENTRANT>
              <IS-SYNCHRONOUS>true</IS-SYNCHRONOUS>
              <CALL-TYPE>INTERRUPT</CALL-TYPE>
            [!IF "as:modconf('Cdd_Pwm')[1]/CddPwmGeneral/CddPwmTypeofInterruptFunction = 'CDD_PWM_ISR_CAT2'"!][!//
              <EXECUTION-CONTEXT>INTERRUPT-CAT-2</EXECUTION-CONTEXT>
            [!ELSE!][!//
              <EXECUTION-CONTEXT>INTERRUPT-CAT-1</EXECUTION-CONTEXT>
            [!ENDIF!][!//
              <SW-SERVICE-IMPL-POLICY>STANDARD</SW-SERVICE-IMPL-POLICY>
              <BSW-ENTRY-KIND>CONCRETE</BSW-ENTRY-KIND>
            </BSW-MODULE-ENTRY>
            <BSW-MODULE-ENTRY UUID="e4796695-6057-4cba-90c2-609afa466eb5">
              <SHORT-NAME>Cdd_Pwm_G3_TzCh5Isr</SHORT-NAME>
              <IS-REENTRANT>false</IS-REENTRANT>
              <IS-SYNCHRONOUS>true</IS-SYNCHRONOUS>
              <CALL-TYPE>INTERRUPT</CALL-TYPE>
            [!IF "as:modconf('Cdd_Pwm')[1]/CddPwmGeneral/CddPwmTypeofInterruptFunction = 'CDD_PWM_ISR_CAT2'"!][!//
              <EXECUTION-CONTEXT>INTERRUPT-CAT-2</EXECUTION-CONTEXT>
            [!ELSE!][!//
              <EXECUTION-CONTEXT>INTERRUPT-CAT-1</EXECUTION-CONTEXT>
            [!ENDIF!][!//
              <SW-SERVICE-IMPL-POLICY>STANDARD</SW-SERVICE-IMPL-POLICY>
              <BSW-ENTRY-KIND>CONCRETE</BSW-ENTRY-KIND>
            </BSW-MODULE-ENTRY>
            <BSW-MODULE-ENTRY UUID="b5677ecd-6777-4682-b2d7-ef15c2e1b391">
              <SHORT-NAME>Cdd_Pwm_G3_TzCh6Isr</SHORT-NAME>
              <IS-REENTRANT>false</IS-REENTRANT>
              <IS-SYNCHRONOUS>true</IS-SYNCHRONOUS>
              <CALL-TYPE>INTERRUPT</CALL-TYPE>
            [!IF "as:modconf('Cdd_Pwm')[1]/CddPwmGeneral/CddPwmTypeofInterruptFunction = 'CDD_PWM_ISR_CAT2'"!][!//
              <EXECUTION-CONTEXT>INTERRUPT-CAT-2</EXECUTION-CONTEXT>
            [!ELSE!][!//
              <EXECUTION-CONTEXT>INTERRUPT-CAT-1</EXECUTION-CONTEXT>
            [!ENDIF!][!//
              <SW-SERVICE-IMPL-POLICY>STANDARD</SW-SERVICE-IMPL-POLICY>
              <BSW-ENTRY-KIND>CONCRETE</BSW-ENTRY-KIND>
            </BSW-MODULE-ENTRY>
            <BSW-MODULE-ENTRY UUID="9d978a0c-330f-4840-b9d0-5ecce8ea6b06">
              <SHORT-NAME>Cdd_Pwm_G3_TzCh7Isr</SHORT-NAME>
              <IS-REENTRANT>false</IS-REENTRANT>
              <IS-SYNCHRONOUS>true</IS-SYNCHRONOUS>
              <CALL-TYPE>INTERRUPT</CALL-TYPE>
            [!IF "as:modconf('Cdd_Pwm')[1]/CddPwmGeneral/CddPwmTypeofInterruptFunction = 'CDD_PWM_ISR_CAT2'"!][!//
              <EXECUTION-CONTEXT>INTERRUPT-CAT-2</EXECUTION-CONTEXT>
            [!ELSE!][!//
              <EXECUTION-CONTEXT>INTERRUPT-CAT-1</EXECUTION-CONTEXT>
            [!ENDIF!][!//
              <SW-SERVICE-IMPL-POLICY>STANDARD</SW-SERVICE-IMPL-POLICY>
              <BSW-ENTRY-KIND>CONCRETE</BSW-ENTRY-KIND>
            </BSW-MODULE-ENTRY>
            <BSW-MODULE-ENTRY UUID="c9d54b44-8626-4339-9b43-52681215f5e3">
              <SHORT-NAME>Cdd_Pwm_G3_TzCh8Isr</SHORT-NAME>
              <IS-REENTRANT>false</IS-REENTRANT>
              <IS-SYNCHRONOUS>true</IS-SYNCHRONOUS>
              <CALL-TYPE>INTERRUPT</CALL-TYPE>
            [!IF "as:modconf('Cdd_Pwm')[1]/CddPwmGeneral/CddPwmTypeofInterruptFunction = 'CDD_PWM_ISR_CAT2'"!][!//
              <EXECUTION-CONTEXT>INTERRUPT-CAT-2</EXECUTION-CONTEXT>
            [!ELSE!][!//
              <EXECUTION-CONTEXT>INTERRUPT-CAT-1</EXECUTION-CONTEXT>
            [!ENDIF!][!//
              <SW-SERVICE-IMPL-POLICY>STANDARD</SW-SERVICE-IMPL-POLICY>
              <BSW-ENTRY-KIND>CONCRETE</BSW-ENTRY-KIND>
            </BSW-MODULE-ENTRY>
            <BSW-MODULE-ENTRY UUID="bf43aeda-cb3c-4374-9a97-5e12bce9fa03">
              <SHORT-NAME>Cdd_Pwm_G3_TzCh9Isr</SHORT-NAME>
              <IS-REENTRANT>false</IS-REENTRANT>
              <IS-SYNCHRONOUS>true</IS-SYNCHRONOUS>
              <CALL-TYPE>INTERRUPT</CALL-TYPE>
            [!IF "as:modconf('Cdd_Pwm')[1]/CddPwmGeneral/CddPwmTypeofInterruptFunction = 'CDD_PWM_ISR_CAT2'"!][!//
              <EXECUTION-CONTEXT>INTERRUPT-CAT-2</EXECUTION-CONTEXT>
            [!ELSE!][!//
              <EXECUTION-CONTEXT>INTERRUPT-CAT-1</EXECUTION-CONTEXT>
            [!ENDIF!][!//
              <SW-SERVICE-IMPL-POLICY>STANDARD</SW-SERVICE-IMPL-POLICY>
              <BSW-ENTRY-KIND>CONCRETE</BSW-ENTRY-KIND>
            </BSW-MODULE-ENTRY>
            <BSW-MODULE-ENTRY UUID="3ea9f270-0e9e-490c-b589-57550d16c431">
              <SHORT-NAME>Cdd_Pwm_GetCounter</SHORT-NAME>
              <SERVICE-ID>6</SERVICE-ID>
              <IS-REENTRANT>true</IS-REENTRANT>
              <IS-SYNCHRONOUS>true</IS-SYNCHRONOUS>
              <CALL-TYPE>REGULAR</CALL-TYPE>
              <EXECUTION-CONTEXT>UNSPECIFIED</EXECUTION-CONTEXT>
              <SW-SERVICE-IMPL-POLICY>STANDARD</SW-SERVICE-IMPL-POLICY>
              <BSW-ENTRY-KIND>CONCRETE</BSW-ENTRY-KIND>
            </BSW-MODULE-ENTRY>
            <BSW-MODULE-ENTRY UUID="e98a9b16-6292-4e18-b809-875227411334">
              <SHORT-NAME>Cdd_Pwm_GetCounterStatus</SHORT-NAME>
              <SERVICE-ID>4</SERVICE-ID>
              <IS-REENTRANT>true</IS-REENTRANT>
              <IS-SYNCHRONOUS>true</IS-SYNCHRONOUS>
              <CALL-TYPE>REGULAR</CALL-TYPE>
              <EXECUTION-CONTEXT>UNSPECIFIED</EXECUTION-CONTEXT>
              <SW-SERVICE-IMPL-POLICY>STANDARD</SW-SERVICE-IMPL-POLICY>
              <BSW-ENTRY-KIND>CONCRETE</BSW-ENTRY-KIND>
            </BSW-MODULE-ENTRY>
            <BSW-MODULE-ENTRY UUID="ad99520b-1930-43c6-883a-20a53697b9dc">
              <SHORT-NAME>Cdd_Pwm_GetVersionInfo</SHORT-NAME>
              <SERVICE-ID>11</SERVICE-ID>
              <IS-REENTRANT>true</IS-REENTRANT>
              <IS-SYNCHRONOUS>true</IS-SYNCHRONOUS>
              <CALL-TYPE>REGULAR</CALL-TYPE>
              <EXECUTION-CONTEXT>UNSPECIFIED</EXECUTION-CONTEXT>
              <SW-SERVICE-IMPL-POLICY>STANDARD</SW-SERVICE-IMPL-POLICY>
              <BSW-ENTRY-KIND>CONCRETE</BSW-ENTRY-KIND>
            </BSW-MODULE-ENTRY>
            <BSW-MODULE-ENTRY UUID="daef4c7e-7abf-477c-846f-925ce3ca4618">
              <SHORT-NAME>Cdd_Pwm_HrSetPeriodDutyPhase</SHORT-NAME>
              <SERVICE-ID>33</SERVICE-ID>
              <IS-REENTRANT>false</IS-REENTRANT>
              <IS-SYNCHRONOUS>true</IS-SYNCHRONOUS>
              <CALL-TYPE>REGULAR</CALL-TYPE>
              <EXECUTION-CONTEXT>UNSPECIFIED</EXECUTION-CONTEXT>
              <SW-SERVICE-IMPL-POLICY>STANDARD</SW-SERVICE-IMPL-POLICY>
              <BSW-ENTRY-KIND>CONCRETE</BSW-ENTRY-KIND>
            </BSW-MODULE-ENTRY>
<BSW-MODULE-ENTRY UUID="af395356-f2b3-46c6-b337-9060a7d204d5">
              <SHORT-NAME>Cdd_Pwm_HrSetPhaseShift</SHORT-NAME>
              <SERVICE-ID>42</SERVICE-ID>
              <IS-REENTRANT>false</IS-REENTRANT>
              <IS-SYNCHRONOUS>true</IS-SYNCHRONOUS>
              <CALL-TYPE>REGULAR</CALL-TYPE>
              <EXECUTION-CONTEXT>UNSPECIFIED</EXECUTION-CONTEXT>
              <SW-SERVICE-IMPL-POLICY>STANDARD</SW-SERVICE-IMPL-POLICY>
              <BSW-ENTRY-KIND>CONCRETE</BSW-ENTRY-KIND>
            </BSW-MODULE-ENTRY>
			<BSW-MODULE-ENTRY UUID="ec77fc18-3b69-4fd5-b955-e2521f5a4d0a">
              <SHORT-NAME>Cdd_Pwm_HrSetTimeBasePeriod</SHORT-NAME>
              <SERVICE-ID>43</SERVICE-ID>
              <IS-REENTRANT>false</IS-REENTRANT>
              <IS-SYNCHRONOUS>true</IS-SYNCHRONOUS>
              <CALL-TYPE>REGULAR</CALL-TYPE>
              <EXECUTION-CONTEXT>UNSPECIFIED</EXECUTION-CONTEXT>
              <SW-SERVICE-IMPL-POLICY>STANDARD</SW-SERVICE-IMPL-POLICY>
              <BSW-ENTRY-KIND>CONCRETE</BSW-ENTRY-KIND>
            </BSW-MODULE-ENTRY>
			<BSW-MODULE-ENTRY UUID="55c3ad8e-1bf0-4809-be63-b74def80b971">
              <SHORT-NAME>Cdd_Pwm_HrSetCounterCompareValue</SHORT-NAME>
              <SERVICE-ID>44</SERVICE-ID>
              <IS-REENTRANT>false</IS-REENTRANT>
              <IS-SYNCHRONOUS>true</IS-SYNCHRONOUS>
              <CALL-TYPE>REGULAR</CALL-TYPE>
              <EXECUTION-CONTEXT>UNSPECIFIED</EXECUTION-CONTEXT>
              <SW-SERVICE-IMPL-POLICY>STANDARD</SW-SERVICE-IMPL-POLICY>
              <BSW-ENTRY-KIND>CONCRETE</BSW-ENTRY-KIND>
            </BSW-MODULE-ENTRY>
			<BSW-MODULE-ENTRY UUID="a6717cc0-21ef-4954-8faa-7da3dcb2cc58">
              <SHORT-NAME>Cdd_Pwm_HrSetXcmpRegValue</SHORT-NAME>
              <SERVICE-ID>49</SERVICE-ID>
              <IS-REENTRANT>false</IS-REENTRANT>
              <IS-SYNCHRONOUS>true</IS-SYNCHRONOUS>
              <CALL-TYPE>REGULAR</CALL-TYPE>
              <EXECUTION-CONTEXT>UNSPECIFIED</EXECUTION-CONTEXT>
              <SW-SERVICE-IMPL-POLICY>STANDARD</SW-SERVICE-IMPL-POLICY>
              <BSW-ENTRY-KIND>CONCRETE</BSW-ENTRY-KIND>
            </BSW-MODULE-ENTRY>
            <BSW-MODULE-ENTRY UUID="8c1ef70d-1cdd-4df5-ab68-447888d45cad">
              <SHORT-NAME>Cdd_Pwm_HrSfoCalibration</SHORT-NAME>
              <SERVICE-ID>34</SERVICE-ID>
              <IS-REENTRANT>false</IS-REENTRANT>
              <IS-SYNCHRONOUS>true</IS-SYNCHRONOUS>
              <CALL-TYPE>REGULAR</CALL-TYPE>
              <EXECUTION-CONTEXT>UNSPECIFIED</EXECUTION-CONTEXT>
              <SW-SERVICE-IMPL-POLICY>STANDARD</SW-SERVICE-IMPL-POLICY>
              <BSW-ENTRY-KIND>CONCRETE</BSW-ENTRY-KIND>
            </BSW-MODULE-ENTRY>
            <BSW-MODULE-ENTRY UUID="4da0a885-d404-4e14-b10c-53e5db910aea">
              <SHORT-NAME>Cdd_Pwm_HrSfoStatus</SHORT-NAME>
              <SERVICE-ID>35</SERVICE-ID>
              <IS-REENTRANT>true</IS-REENTRANT>
              <IS-SYNCHRONOUS>true</IS-SYNCHRONOUS>
              <CALL-TYPE>REGULAR</CALL-TYPE>
              <EXECUTION-CONTEXT>UNSPECIFIED</EXECUTION-CONTEXT>
              <SW-SERVICE-IMPL-POLICY>STANDARD</SW-SERVICE-IMPL-POLICY>
              <BSW-ENTRY-KIND>CONCRETE</BSW-ENTRY-KIND>
            </BSW-MODULE-ENTRY>
            <BSW-MODULE-ENTRY UUID="ea4b3dcf-41e0-4b0b-8a10-f9053c034fec">
              <SHORT-NAME>Cdd_Pwm_Init</SHORT-NAME>
              <SERVICE-ID>0</SERVICE-ID>
              <IS-REENTRANT>false</IS-REENTRANT>
              <IS-SYNCHRONOUS>true</IS-SYNCHRONOUS>
              <CALL-TYPE>REGULAR</CALL-TYPE>
              <EXECUTION-CONTEXT>UNSPECIFIED</EXECUTION-CONTEXT>
              <SW-SERVICE-IMPL-POLICY>STANDARD</SW-SERVICE-IMPL-POLICY>
              <BSW-ENTRY-KIND>CONCRETE</BSW-ENTRY-KIND>
            </BSW-MODULE-ENTRY>
            <BSW-MODULE-ENTRY UUID="197aab63-43f7-4908-9cd2-0ebe9c674ac3">
              <SHORT-NAME>Cdd_Pwm_RegisterReadback</SHORT-NAME>
              <SERVICE-ID>13</SERVICE-ID>
              <IS-REENTRANT>false</IS-REENTRANT>
              <IS-SYNCHRONOUS>true</IS-SYNCHRONOUS>
              <CALL-TYPE>REGULAR</CALL-TYPE>
              <EXECUTION-CONTEXT>UNSPECIFIED</EXECUTION-CONTEXT>
              <SW-SERVICE-IMPL-POLICY>STANDARD</SW-SERVICE-IMPL-POLICY>
              <BSW-ENTRY-KIND>CONCRETE</BSW-ENTRY-KIND>
            </BSW-MODULE-ENTRY>
            <BSW-MODULE-ENTRY UUID="b6d54449-1fa3-4317-9ca4-380ddac9b154">
              <SHORT-NAME>Cdd_Pwm_SetAbsoluteThreshold</SHORT-NAME>
              <SERVICE-ID>7</SERVICE-ID>
              <IS-REENTRANT>false</IS-REENTRANT>
              <IS-SYNCHRONOUS>true</IS-SYNCHRONOUS>
              <CALL-TYPE>REGULAR</CALL-TYPE>
              <EXECUTION-CONTEXT>UNSPECIFIED</EXECUTION-CONTEXT>
              <SW-SERVICE-IMPL-POLICY>STANDARD</SW-SERVICE-IMPL-POLICY>
              <BSW-ENTRY-KIND>CONCRETE</BSW-ENTRY-KIND>
            </BSW-MODULE-ENTRY>
            <BSW-MODULE-ENTRY UUID="3e8f16c9-6ed9-4e3b-ba85-a46c1838a9e5">
              <SHORT-NAME>Cdd_Pwm_SetAdcTrigger</SHORT-NAME>
              <SERVICE-ID>25</SERVICE-ID>
              <IS-REENTRANT>false</IS-REENTRANT>
              <IS-SYNCHRONOUS>true</IS-SYNCHRONOUS>
              <CALL-TYPE>REGULAR</CALL-TYPE>
              <EXECUTION-CONTEXT>UNSPECIFIED</EXECUTION-CONTEXT>
              <SW-SERVICE-IMPL-POLICY>STANDARD</SW-SERVICE-IMPL-POLICY>
              <BSW-ENTRY-KIND>CONCRETE</BSW-ENTRY-KIND>
            </BSW-MODULE-ENTRY>
            <BSW-MODULE-ENTRY UUID="b6f9eaba-068f-4efd-b30b-7c5b07bdf672">
              <SHORT-NAME>Cdd_Pwm_SetOutputToIdle</SHORT-NAME>
              <SERVICE-ID>15</SERVICE-ID>
              <IS-REENTRANT>false</IS-REENTRANT>
              <IS-SYNCHRONOUS>true</IS-SYNCHRONOUS>
              <CALL-TYPE>REGULAR</CALL-TYPE>
              <EXECUTION-CONTEXT>UNSPECIFIED</EXECUTION-CONTEXT>
              <SW-SERVICE-IMPL-POLICY>STANDARD</SW-SERVICE-IMPL-POLICY>
              <BSW-ENTRY-KIND>CONCRETE</BSW-ENTRY-KIND>
            </BSW-MODULE-ENTRY>
            <BSW-MODULE-ENTRY UUID="0689f40d-bd99-4108-a258-56db06389319">
              <SHORT-NAME>Cdd_Pwm_SetPeriodDutyPhase</SHORT-NAME>
              <SERVICE-ID>14</SERVICE-ID>
              <IS-REENTRANT>false</IS-REENTRANT>
              <IS-SYNCHRONOUS>true</IS-SYNCHRONOUS>
              <CALL-TYPE>REGULAR</CALL-TYPE>
              <EXECUTION-CONTEXT>UNSPECIFIED</EXECUTION-CONTEXT>
              <SW-SERVICE-IMPL-POLICY>STANDARD</SW-SERVICE-IMPL-POLICY>
              <BSW-ENTRY-KIND>CONCRETE</BSW-ENTRY-KIND>
            </BSW-MODULE-ENTRY>
			<BSW-MODULE-ENTRY UUID="a1a20b05-d3b9-4b4b-a7ca-b400d252bb99">
              <SHORT-NAME>Cdd_Pwm_SetTimeBaseCounterMode</SHORT-NAME>
              <SERVICE-ID>36</SERVICE-ID>
              <IS-REENTRANT>false</IS-REENTRANT>
              <IS-SYNCHRONOUS>true</IS-SYNCHRONOUS>
              <CALL-TYPE>REGULAR</CALL-TYPE>
              <EXECUTION-CONTEXT>UNSPECIFIED</EXECUTION-CONTEXT>
              <SW-SERVICE-IMPL-POLICY>STANDARD</SW-SERVICE-IMPL-POLICY>
              <BSW-ENTRY-KIND>CONCRETE</BSW-ENTRY-KIND>
            </BSW-MODULE-ENTRY>
			<BSW-MODULE-ENTRY UUID="be304eab-46f3-4f6b-a617-ff988ea053c0">
              <SHORT-NAME>Cdd_Pwm_SetPhaseShift</SHORT-NAME>
              <SERVICE-ID>37</SERVICE-ID>
              <IS-REENTRANT>false</IS-REENTRANT>
              <IS-SYNCHRONOUS>true</IS-SYNCHRONOUS>
              <CALL-TYPE>REGULAR</CALL-TYPE>
              <EXECUTION-CONTEXT>UNSPECIFIED</EXECUTION-CONTEXT>
              <SW-SERVICE-IMPL-POLICY>STANDARD</SW-SERVICE-IMPL-POLICY>
              <BSW-ENTRY-KIND>CONCRETE</BSW-ENTRY-KIND>
            </BSW-MODULE-ENTRY>
			<BSW-MODULE-ENTRY UUID="649a2e8b-1ecd-4f9b-b803-c6d25b45d9bd">
              <SHORT-NAME>Cdd_Pwm_SetTimeBasePeriod</SHORT-NAME>
              <SERVICE-ID>38</SERVICE-ID>
              <IS-REENTRANT>false</IS-REENTRANT>
              <IS-SYNCHRONOUS>true</IS-SYNCHRONOUS>
              <CALL-TYPE>REGULAR</CALL-TYPE>
              <EXECUTION-CONTEXT>UNSPECIFIED</EXECUTION-CONTEXT>
              <SW-SERVICE-IMPL-POLICY>STANDARD</SW-SERVICE-IMPL-POLICY>
              <BSW-ENTRY-KIND>CONCRETE</BSW-ENTRY-KIND>
            </BSW-MODULE-ENTRY>
			<BSW-MODULE-ENTRY UUID="7cc8aa21-5a47-4320-9dd3-c0cd8ea6b612">
              <SHORT-NAME>Cdd_Pwm_SetCounterCompareValue</SHORT-NAME>
              <SERVICE-ID>39</SERVICE-ID>
              <IS-REENTRANT>false</IS-REENTRANT>
              <IS-SYNCHRONOUS>true</IS-SYNCHRONOUS>
              <CALL-TYPE>REGULAR</CALL-TYPE>
              <EXECUTION-CONTEXT>UNSPECIFIED</EXECUTION-CONTEXT>
              <SW-SERVICE-IMPL-POLICY>STANDARD</SW-SERVICE-IMPL-POLICY>
              <BSW-ENTRY-KIND>CONCRETE</BSW-ENTRY-KIND>
            </BSW-MODULE-ENTRY>
			<BSW-MODULE-ENTRY UUID="4d825a39-415d-4890-8be1-17d8e3203b1f">
              <SHORT-NAME>Cdd_Pwm_SetXcmpRegValue</SHORT-NAME>
              <SERVICE-ID>48</SERVICE-ID>
              <IS-REENTRANT>false</IS-REENTRANT>
              <IS-SYNCHRONOUS>true</IS-SYNCHRONOUS>
              <CALL-TYPE>REGULAR</CALL-TYPE>
              <EXECUTION-CONTEXT>UNSPECIFIED</EXECUTION-CONTEXT>
              <SW-SERVICE-IMPL-POLICY>STANDARD</SW-SERVICE-IMPL-POLICY>
              <BSW-ENTRY-KIND>CONCRETE</BSW-ENTRY-KIND>
            </BSW-MODULE-ENTRY>
			<BSW-MODULE-ENTRY UUID="74cf7648-abc5-4d46-ad28-7c98db1adf5a">
              <SHORT-NAME>Cdd_Pwm_SetXMinMaxRegValue</SHORT-NAME>
              <SERVICE-ID>50</SERVICE-ID>
              <IS-REENTRANT>false</IS-REENTRANT>
              <IS-SYNCHRONOUS>true</IS-SYNCHRONOUS>
              <CALL-TYPE>REGULAR</CALL-TYPE>
              <EXECUTION-CONTEXT>UNSPECIFIED</EXECUTION-CONTEXT>
              <SW-SERVICE-IMPL-POLICY>STANDARD</SW-SERVICE-IMPL-POLICY>
              <BSW-ENTRY-KIND>CONCRETE</BSW-ENTRY-KIND>
            </BSW-MODULE-ENTRY>
			<BSW-MODULE-ENTRY UUID="a5dd1a7f-4171-4746-9cc0-f8e39f1514ba">
              <SHORT-NAME>Cdd_Pwm_SetCmpShadowRegValue</SHORT-NAME>
              <SERVICE-ID>51</SERVICE-ID>
              <IS-REENTRANT>false</IS-REENTRANT>
              <IS-SYNCHRONOUS>true</IS-SYNCHRONOUS>
              <CALL-TYPE>REGULAR</CALL-TYPE>
              <EXECUTION-CONTEXT>UNSPECIFIED</EXECUTION-CONTEXT>
              <SW-SERVICE-IMPL-POLICY>STANDARD</SW-SERVICE-IMPL-POLICY>
              <BSW-ENTRY-KIND>CONCRETE</BSW-ENTRY-KIND>
            </BSW-MODULE-ENTRY>
            <BSW-MODULE-ENTRY UUID="ca9bb07e-45c9-40f4-9302-a99f3597fc74">
              <SHORT-NAME>Cdd_Pwm_SetPinAction</SHORT-NAME>
              <SERVICE-ID>5</SERVICE-ID>
              <IS-REENTRANT>false</IS-REENTRANT>
              <IS-SYNCHRONOUS>true</IS-SYNCHRONOUS>
              <CALL-TYPE>REGULAR</CALL-TYPE>
              <EXECUTION-CONTEXT>TASK</EXECUTION-CONTEXT>
              <SW-SERVICE-IMPL-POLICY>STANDARD</SW-SERVICE-IMPL-POLICY>
              <BSW-ENTRY-KIND>CONCRETE</BSW-ENTRY-KIND>
            </BSW-MODULE-ENTRY>
            <BSW-MODULE-ENTRY UUID="eac7c81d-1ada-456b-92f5-ff63a2c94e0c">
              <SHORT-NAME>Cdd_Pwm_SetRelativeThreshold</SHORT-NAME>
              <SERVICE-ID>8</SERVICE-ID>
              <IS-REENTRANT>false</IS-REENTRANT>
              <IS-SYNCHRONOUS>true</IS-SYNCHRONOUS>
              <CALL-TYPE>REGULAR</CALL-TYPE>
              <EXECUTION-CONTEXT>UNSPECIFIED</EXECUTION-CONTEXT>
              <SW-SERVICE-IMPL-POLICY>STANDARD</SW-SERVICE-IMPL-POLICY>
              <BSW-ENTRY-KIND>CONCRETE</BSW-ENTRY-KIND>
            </BSW-MODULE-ENTRY>
            <BSW-MODULE-ENTRY UUID="7491164b-c979-499e-a47e-0e90b8e178f1">
              <SHORT-NAME>Cdd_Pwm_StartChannelCounter</SHORT-NAME>
              <SERVICE-ID>2</SERVICE-ID>
              <IS-REENTRANT>false</IS-REENTRANT>
              <IS-SYNCHRONOUS>true</IS-SYNCHRONOUS>
              <CALL-TYPE>REGULAR</CALL-TYPE>
              <EXECUTION-CONTEXT>UNSPECIFIED</EXECUTION-CONTEXT>
              <SW-SERVICE-IMPL-POLICY>STANDARD</SW-SERVICE-IMPL-POLICY>
              <BSW-ENTRY-KIND>CONCRETE</BSW-ENTRY-KIND>
            </BSW-MODULE-ENTRY>
            <BSW-MODULE-ENTRY UUID="2cf15cef-81b3-4089-be1c-973834547a13">
              <SHORT-NAME>Cdd_Pwm_StopChannelCounter</SHORT-NAME>
              <SERVICE-ID>3</SERVICE-ID>
              <IS-REENTRANT>false</IS-REENTRANT>
              <IS-SYNCHRONOUS>true</IS-SYNCHRONOUS>
              <CALL-TYPE>REGULAR</CALL-TYPE>
              <EXECUTION-CONTEXT>UNSPECIFIED</EXECUTION-CONTEXT>
              <SW-SERVICE-IMPL-POLICY>STANDARD</SW-SERVICE-IMPL-POLICY>
              <BSW-ENTRY-KIND>CONCRETE</BSW-ENTRY-KIND>
            </BSW-MODULE-ENTRY>
            <BSW-MODULE-ENTRY UUID="8cebcc06-d179-4953-8ea5-72ecbfff0966">
              <SHORT-NAME>Cdd_Pwm_SyncDisable</SHORT-NAME>
              <SERVICE-ID>43</SERVICE-ID>
              <IS-REENTRANT>false</IS-REENTRANT>
              <IS-SYNCHRONOUS>true</IS-SYNCHRONOUS>
              <CALL-TYPE>REGULAR</CALL-TYPE>
              <EXECUTION-CONTEXT>UNSPECIFIED</EXECUTION-CONTEXT>
              <SW-SERVICE-IMPL-POLICY>STANDARD</SW-SERVICE-IMPL-POLICY>
              <BSW-ENTRY-KIND>CONCRETE</BSW-ENTRY-KIND>
            </BSW-MODULE-ENTRY>
            <BSW-MODULE-ENTRY UUID="d848033d-c84a-4c7c-9837-746dd350fb52">
              <SHORT-NAME>Cdd_Pwm_SyncEnable</SHORT-NAME>
              <SERVICE-ID>42</SERVICE-ID>
              <IS-REENTRANT>false</IS-REENTRANT>
              <IS-SYNCHRONOUS>true</IS-SYNCHRONOUS>
              <CALL-TYPE>REGULAR</CALL-TYPE>
              <EXECUTION-CONTEXT>UNSPECIFIED</EXECUTION-CONTEXT>
              <SW-SERVICE-IMPL-POLICY>STANDARD</SW-SERVICE-IMPL-POLICY>
              <BSW-ENTRY-KIND>CONCRETE</BSW-ENTRY-KIND>
            </BSW-MODULE-ENTRY>
            <BSW-MODULE-ENTRY UUID="18bfe825-2131-49a7-8d8b-29a0cb67bc42">
              <SHORT-NAME>Cdd_Pwm_TzEventStatusClear</SHORT-NAME>
              <SERVICE-ID>32</SERVICE-ID>
              <IS-REENTRANT>false</IS-REENTRANT>
              <IS-SYNCHRONOUS>true</IS-SYNCHRONOUS>
              <CALL-TYPE>REGULAR</CALL-TYPE>
              <EXECUTION-CONTEXT>UNSPECIFIED</EXECUTION-CONTEXT>
              <SW-SERVICE-IMPL-POLICY>STANDARD</SW-SERVICE-IMPL-POLICY>
              <BSW-ENTRY-KIND>CONCRETE</BSW-ENTRY-KIND>
            </BSW-MODULE-ENTRY>
            <BSW-MODULE-ENTRY UUID="fe8df554-629f-4219-886b-78f862c4c090">
              <SHORT-NAME>Cdd_Pwm_TzGetEventStatus</SHORT-NAME>
              <SERVICE-ID>31</SERVICE-ID>
              <IS-REENTRANT>false</IS-REENTRANT>
              <IS-SYNCHRONOUS>true</IS-SYNCHRONOUS>
              <CALL-TYPE>REGULAR</CALL-TYPE>
              <EXECUTION-CONTEXT>UNSPECIFIED</EXECUTION-CONTEXT>
              <SW-SERVICE-IMPL-POLICY>STANDARD</SW-SERVICE-IMPL-POLICY>
              <BSW-ENTRY-KIND>CONCRETE</BSW-ENTRY-KIND>
            </BSW-MODULE-ENTRY>
            <BSW-MODULE-ENTRY UUID="5a101776-a6fd-4cf9-97ff-4536cdf337e0">
              <SHORT-NAME>Cdd_Pwm_TzIntrDisable</SHORT-NAME>
              <SERVICE-ID>30</SERVICE-ID>
              <IS-REENTRANT>false</IS-REENTRANT>
              <IS-SYNCHRONOUS>true</IS-SYNCHRONOUS>
              <CALL-TYPE>REGULAR</CALL-TYPE>
              <EXECUTION-CONTEXT>UNSPECIFIED</EXECUTION-CONTEXT>
              <SW-SERVICE-IMPL-POLICY>STANDARD</SW-SERVICE-IMPL-POLICY>
              <BSW-ENTRY-KIND>CONCRETE</BSW-ENTRY-KIND>
            </BSW-MODULE-ENTRY>
            <BSW-MODULE-ENTRY UUID="3364c858-447d-466a-abb4-29cd67eb5cc6">
              <SHORT-NAME>Cdd_Pwm_TzIntrEnable</SHORT-NAME>
              <SERVICE-ID>29</SERVICE-ID>
              <IS-REENTRANT>false</IS-REENTRANT>
              <IS-SYNCHRONOUS>true</IS-SYNCHRONOUS>
              <CALL-TYPE>REGULAR</CALL-TYPE>
              <EXECUTION-CONTEXT>UNSPECIFIED</EXECUTION-CONTEXT>
              <SW-SERVICE-IMPL-POLICY>STANDARD</SW-SERVICE-IMPL-POLICY>
              <BSW-ENTRY-KIND>CONCRETE</BSW-ENTRY-KIND>
            </BSW-MODULE-ENTRY>
            <BSW-MODULE-ENTRY UUID="43f5c596-6eba-427f-88cd-ab46316d5149">
              <SHORT-NAME>Cdd_Pwm_TzTripEventDisable</SHORT-NAME>
              <SERVICE-ID>28</SERVICE-ID>
              <IS-REENTRANT>false</IS-REENTRANT>
              <IS-SYNCHRONOUS>true</IS-SYNCHRONOUS>
              <CALL-TYPE>REGULAR</CALL-TYPE>
              <EXECUTION-CONTEXT>UNSPECIFIED</EXECUTION-CONTEXT>
              <SW-SERVICE-IMPL-POLICY>STANDARD</SW-SERVICE-IMPL-POLICY>
              <BSW-ENTRY-KIND>CONCRETE</BSW-ENTRY-KIND>
            </BSW-MODULE-ENTRY>
            <BSW-MODULE-ENTRY UUID="5c07ac02-3935-4791-a06a-ef2388d0f766">
              <SHORT-NAME>Cdd_Pwm_TzTripEventEnable</SHORT-NAME>
              <SERVICE-ID>27</SERVICE-ID>
              <IS-REENTRANT>false</IS-REENTRANT>
              <IS-SYNCHRONOUS>true</IS-SYNCHRONOUS>
              <CALL-TYPE>REGULAR</CALL-TYPE>
              <EXECUTION-CONTEXT>UNSPECIFIED</EXECUTION-CONTEXT>
              <SW-SERVICE-IMPL-POLICY>STANDARD</SW-SERVICE-IMPL-POLICY>
              <BSW-ENTRY-KIND>CONCRETE</BSW-ENTRY-KIND>
            </BSW-MODULE-ENTRY>
          </ELEMENTS>
        </AR-PACKAGE>
      </AR-PACKAGES>
    </AR-PACKAGE>
  </AR-PACKAGES>
</AUTOSAR>
