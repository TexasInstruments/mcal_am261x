<?xml version="1.0" encoding="UTF-8"?>
[!AUTOSPACING!][!//
[!VAR "INT_EXECUTION_CONTEXT"="node:when((as:modconf('Port')[1]/PortGeneral/PortTypeofInterruptFunction = 'PORT_ISR_CAT2'),'INTERRUPT-CAT-2','INTERRUPT-CAT-1')"!][!//
[!VAR "INT_CAT"="node:when((as:modconf('Port')[1]/PortGeneral/PortTypeofInterruptFunction = 'PORT_ISR_CAT2'),'CAT-2','CAT-1')"!][!//
[!VAR "port_bnk"="text:range(1,9)"!][!VAR "port_ch"="text:range(1,140)"!][!VAR "port_ch1"="$port_ch"!][!VAR "bank0"="num:i(1)"!][!VAR "chn0"="num:i(1)"!][!//
<AUTOSAR xmlns="http://autosar.org/schema/r4.0" xmlns:xsi="http://www.w3.org/2001/XMLSchema-instance" xsi:schemaLocation="http://autosar.org/schema/r4.0 AUTOSAR_00044.xsd">
  <AR-PACKAGES>
    <AR-PACKAGE UUID="d3266d92-2ac8-4a47-b489-41675e33c0f2">
      <SHORT-NAME>Port_TI_AM261x</SHORT-NAME>
      <ELEMENTS>
        <BSW-MODULE-DESCRIPTION UUID="4b423a63-011d-43a9-8193-13910ecf921c">
          <SHORT-NAME>Port</SHORT-NAME>
          <CATEGORY>BSW_MODULE</CATEGORY>
          <EXPECTED-ENTRYS>
            [!IF "as:modconf('Port')[1]/PortGeneral/PortClearIntrStatusApi = 'true'"!][!//
            <BSW-MODULE-ENTRY-REF-CONDITIONAL>
              <BSW-MODULE-ENTRY-REF DEST="BSW-MODULE-ENTRY">/Port_TI_AM261x/Port_ModuleEntry/Port_ClearInterruptStatus</BSW-MODULE-ENTRY-REF>
            </BSW-MODULE-ENTRY-REF-CONDITIONAL>
            [!ENDIF!][!//
            [!IF "as:modconf('Port')[1]/PortGeneral/PortGetIntrStatusApi = 'true'"!][!//
            <BSW-MODULE-ENTRY-REF-CONDITIONAL>
              <BSW-MODULE-ENTRY-REF DEST="BSW-MODULE-ENTRY">/Port_TI_AM261x/Port_ModuleEntry/Port_GetInterruptStatus</BSW-MODULE-ENTRY-REF>
            </BSW-MODULE-ENTRY-REF-CONDITIONAL>
            [!ENDIF!][!//
            [!IF "as:modconf('Port')[1]/PortGeneral/PortVersionInfoApi = 'true'"!][!//
            <BSW-MODULE-ENTRY-REF-CONDITIONAL>
              <BSW-MODULE-ENTRY-REF DEST="BSW-MODULE-ENTRY">/Port_TI_AM261x/Port_ModuleEntry/Port_GetVersionInfo</BSW-MODULE-ENTRY-REF>
            </BSW-MODULE-ENTRY-REF-CONDITIONAL>
            [!ENDIF!][!//
            <BSW-MODULE-ENTRY-REF-CONDITIONAL>
              <BSW-MODULE-ENTRY-REF DEST="BSW-MODULE-ENTRY">/Port_TI_AM261x/Port_ModuleEntry/Port_Init</BSW-MODULE-ENTRY-REF>
            </BSW-MODULE-ENTRY-REF-CONDITIONAL>
            [!IF "as:modconf('Port')[1]/PortGeneral/PortRefreshPortDirectionApi = 'true'"!][!//
            <BSW-MODULE-ENTRY-REF-CONDITIONAL>
              <BSW-MODULE-ENTRY-REF DEST="BSW-MODULE-ENTRY">/Port_TI_AM261x/Port_ModuleEntry/Port_RefreshPortDirection</BSW-MODULE-ENTRY-REF>
            </BSW-MODULE-ENTRY-REF-CONDITIONAL>
            [!ENDIF!][!//
            [!IF "as:modconf('Port')[1]/PortGeneral/PortSetPinDirectionApi = 'true'"!][!//
            <BSW-MODULE-ENTRY-REF-CONDITIONAL>
              <BSW-MODULE-ENTRY-REF DEST="BSW-MODULE-ENTRY">/Port_TI_AM261x/Port_ModuleEntry/Port_SetPinDirection</BSW-MODULE-ENTRY-REF>
            </BSW-MODULE-ENTRY-REF-CONDITIONAL>
            [!ENDIF!][!//
            [!IF "as:modconf('Port')[1]/PortGeneral/PortSetPinModeApi = 'true'"!][!//
            <BSW-MODULE-ENTRY-REF-CONDITIONAL>
              <BSW-MODULE-ENTRY-REF DEST="BSW-MODULE-ENTRY">/Port_TI_AM261x/Port_ModuleEntry/Port_SetPinMode</BSW-MODULE-ENTRY-REF>
            </BSW-MODULE-ENTRY-REF-CONDITIONAL>
            [!ENDIF!][!//
            [!IF "as:modconf('Port')[1]/PortGeneral/PortEnableIntrApi = 'true'"!][!//
            <BSW-MODULE-ENTRY-REF-CONDITIONAL>
              <BSW-MODULE-ENTRY-REF DEST="BSW-MODULE-ENTRY">/Port_TI_AM261x/Port_ModuleEntry/Port_PinDisableIntrNotification</BSW-MODULE-ENTRY-REF>
            </BSW-MODULE-ENTRY-REF-CONDITIONAL>
            <BSW-MODULE-ENTRY-REF-CONDITIONAL>
              <BSW-MODULE-ENTRY-REF DEST="BSW-MODULE-ENTRY">/Port_TI_AM261x/Port_ModuleEntry/Port_PinEnableIntrNotification</BSW-MODULE-ENTRY-REF>
            </BSW-MODULE-ENTRY-REF-CONDITIONAL>
            [!ENDIF!][!//
        [!LOOP "as:modconf('Port')[1]/PortConfigSet/*/PortDioConfig/*"!][!//
          [!VAR "McuGpioXbarOutMapVerify" = "node:value(node:ref(node:current()/PortMcuGpioXbarReference)/McuGpioXbarOutMap)"!][!//
          [!VAR "McuGpioIntrXbarVerify" = "node:value(node:ref(node:current()/PortMcuGpioXbarReference)/McuGpioIntrXbar)"!][!//
          [!VAR "portstr1" = "text:toupper(substring-after($McuGpioXbarOutMapVerify,'MCU_GPIO_INT_XBAR_VIM_MODULE'))"!][!//
          [!VAR "portstr2" = "text:toupper(substring-after($portstr1,'_'))"!][!//
          [!IF "(contains($McuGpioIntrXbarVerify , 'BANK_INTR'))"!][!//
            [!VAR "index" = "num:i(num:i(substring-after($McuGpioIntrXbarVerify,'BANK_INTR_'))+num:i(1))"!] [!//
            [!IF "(num:i($index) = num:i(1) and (num:i($bank0) != num:i(0)))"!][!//
            <BSW-MODULE-ENTRY-REF-CONDITIONAL>
              <BSW-MODULE-ENTRY-REF DEST="BSW-MODULE-ENTRY">/Port_TI_AM261x/Port_ModuleEntry/Port_Bnk0Isr</BSW-MODULE-ENTRY-REF>
            </BSW-MODULE-ENTRY-REF-CONDITIONAL>
              [!VAR "bank0"="num:i(0)"!][!//
            [!ELSEIF "( (num:i($index) != num:i(1)) and (num:i(text:split($port_bnk)[num:i($index)]) != num:i(0) ))"!][!//
            <BSW-MODULE-ENTRY-REF-CONDITIONAL>
              <BSW-MODULE-ENTRY-REF DEST="BSW-MODULE-ENTRY">/Port_TI_AM261x/Port_ModuleEntry/Port_Bnk[!"num:i(num:i($index)-1)"!]Isr</BSW-MODULE-ENTRY-REF>
            </BSW-MODULE-ENTRY-REF-CONDITIONAL>
              [!VAR "port_bnk"="text:replace($port_bnk,$index,'0')"!][!//
            [!ENDIF!][!//
          [!ELSEIF "(contains($McuGpioIntrXbarVerify , 'MCU_GPIO_'))"!][!//
            [!VAR "index" = "num:i(num:i(substring-after($McuGpioIntrXbarVerify,'MCU_GPIO_'))+num:i(1))"!][!//
            [!IF "(num:i($index) = num:i(1) and (num:i($chn0) != num:i(0)))"!][!//
            <BSW-MODULE-ENTRY-REF-CONDITIONAL>
              <BSW-MODULE-ENTRY-REF DEST="BSW-MODULE-ENTRY">/Port_TI_AM261x/Port_ModuleEntry/Port_Ch0Isr</BSW-MODULE-ENTRY-REF>
            </BSW-MODULE-ENTRY-REF-CONDITIONAL>
              [!VAR "chn0"="num:i(0)"!][!//
            [!ELSEIF "( (num:i($index) != num:i(1)) and (num:i(text:split($port_ch1)[num:i($index)]) != num:i(0)) and (text:match($port_ch,$index) = 'true'))"!][!//
            <BSW-MODULE-ENTRY-REF-CONDITIONAL>
              <BSW-MODULE-ENTRY-REF DEST="BSW-MODULE-ENTRY">/Port_TI_AM261x/Port_ModuleEntry/Port_Ch[!"num:i(num:i($index)-1)"!]Isr</BSW-MODULE-ENTRY-REF>
            </BSW-MODULE-ENTRY-REF-CONDITIONAL>
              [!VAR "port_ch1"="text:replace($port_ch1,$index,'0')"!][!//
            [!ENDIF!][!//
          [!ENDIF!][!//
        [!ENDLOOP!][!//
          </EXPECTED-ENTRYS>
          <MODULE-ID>124</MODULE-ID>
          <BSW-MODULE-DEPENDENCYS>
            <BSW-MODULE-DEPENDENCY UUID="7c5f2c30-4e93-4ef2-97d8-8e6e597f0d49">
              <SHORT-NAME>Dem</SHORT-NAME>
              <TARGET-MODULE-ID>54</TARGET-MODULE-ID>
              <TARGET-MODULE-REFS>
                <BSW-MODULE-DESCRIPTION-REF-CONDITIONAL>
                  <BSW-MODULE-DESCRIPTION-REF DEST="BSW-MODULE-DESCRIPTION">/AUTOSAR_Dem/Dem</BSW-MODULE-DESCRIPTION-REF>
                </BSW-MODULE-DESCRIPTION-REF-CONDITIONAL>
              </TARGET-MODULE-REFS>
            </BSW-MODULE-DEPENDENCY>
            [!IF "as:modconf('Port')[1]/PortGeneral/PortDevErrorDetect = 'true'"!][!//
            <BSW-MODULE-DEPENDENCY UUID="abd9e884-6fae-4533-9f35-683fae98d523">
              <SHORT-NAME>Det</SHORT-NAME>
              <TARGET-MODULE-ID>15</TARGET-MODULE-ID>
              <TARGET-MODULE-REFS>
                <BSW-MODULE-DESCRIPTION-REF-CONDITIONAL>
                  <BSW-MODULE-DESCRIPTION-REF DEST="BSW-MODULE-DESCRIPTION">/AUTOSAR_Det/Det</BSW-MODULE-DESCRIPTION-REF>
                </BSW-MODULE-DESCRIPTION-REF-CONDITIONAL>
              </TARGET-MODULE-REFS>
            </BSW-MODULE-DEPENDENCY>
            [!ENDIF!][!//
          </BSW-MODULE-DEPENDENCYS>
          <INTERNAL-BEHAVIORS>
            <BSW-INTERNAL-BEHAVIOR UUID="4c485df1-480d-4d70-8401-2bda11ac4ca6">
              <SHORT-NAME>Port_Behavior</SHORT-NAME>
              <EXCLUSIVE-AREAS>
                <EXCLUSIVE-AREA UUID="e13ab64b-9d8c-4bb3-9d50-294c62699200">
                  <SHORT-NAME>PORT_EXCLUSIVE_AREA_0</SHORT-NAME>
                </EXCLUSIVE-AREA>
              </EXCLUSIVE-AREAS>
              <ENTITYS>
          [!VAR "port_bnk"="text:range(1,9)"!][!VAR "port_ch"="text:range(1,140)"!][!VAR "port_ch1"="$port_ch"!][!VAR "bank0"="num:i(1)"!][!VAR "chn0"="num:i(1)"!][!//
          [!LOOP "as:modconf('Port')[1]/PortConfigSet/*/PortDioConfig/*"!][!//
          [!VAR "McuGpioXbarOutMapVerify" = "node:value(node:ref(node:current()/PortMcuGpioXbarReference)/McuGpioXbarOutMap)"!][!//
          [!VAR "McuGpioIntrXbarVerify" = "node:value(node:ref(node:current()/PortMcuGpioXbarReference)/McuGpioIntrXbar)"!][!//
          [!VAR "portstr1" = "text:toupper(substring-after($McuGpioXbarOutMapVerify,'MCU_GPIO_INT_XBAR_VIM_MODULE'))"!][!//
          [!VAR "portstr2" = "text:toupper(substring-after($portstr1,'_'))"!][!//
          [!IF "(contains($McuGpioIntrXbarVerify , 'BANK_INTR'))"!][!//
            [!VAR "index" = "num:i(num:i(substring-after($McuGpioIntrXbarVerify,'BANK_INTR_'))+num:i(1))"!] [!//
            [!IF "(num:i($index) = num:i(1) and (num:i($bank0) != num:i(0)))"!][!//
                <BSW-INTERRUPT-ENTITY UUID="[!"as:uuid()"!]">
                  <SHORT-NAME>Port_Bnk0Isr</SHORT-NAME>
                  <REENTRANCY-LEVEL>NON-REENTRANT</REENTRANCY-LEVEL>
                  [!IF "as:modconf('Port')[1]/PortGeneral/PortDevErrorDetect = 'true'"!][!//
                  <CALL-POINTS>
                    <BSW-DIRECT-CALL-POINT>
                      <SHORT-NAME>Det_ReportError</SHORT-NAME>
                      <CALLED-ENTRY-REF DEST="BSW-MODULE-ENTRY">/AUTOSAR_Det/BSWModuleEntry/Det_ReportError</CALLED-ENTRY-REF>
                    </BSW-DIRECT-CALL-POINT>
                  </CALL-POINTS>
                  [!ENDIF!][!//
                  <IMPLEMENTED-ENTRY-REF DEST="BSW-MODULE-ENTRY">/Port_TI_AM261x/Port_ModuleEntry/Port_Bnk0Isr</IMPLEMENTED-ENTRY-REF>
                  <INTERRUPT-CATEGORY>[!"$INT_CAT"!]</INTERRUPT-CATEGORY>
                </BSW-INTERRUPT-ENTITY>
                [!VAR "bank0"="num:i(0)"!][!//
            [!ELSEIF "( (num:i($index) != num:i(1)) and (num:i(text:split($port_bnk)[num:i($index)]) != num:i(0) ))"!][!//
                <BSW-INTERRUPT-ENTITY UUID="[!"as:uuid()"!]">
                  <SHORT-NAME>Port_Bnk[!"num:i(num:i($index)-1)"!]Isr</SHORT-NAME>
                  <REENTRANCY-LEVEL>NON-REENTRANT</REENTRANCY-LEVEL>
                  [!IF "as:modconf('Port')[1]/PortGeneral/PortDevErrorDetect = 'true'"!][!//
                  <CALL-POINTS>
                    <BSW-DIRECT-CALL-POINT>
                      <SHORT-NAME>Det_ReportError</SHORT-NAME>
                      <CALLED-ENTRY-REF DEST="BSW-MODULE-ENTRY">/AUTOSAR_Det/BSWModuleEntry/Det_ReportError</CALLED-ENTRY-REF>
                    </BSW-DIRECT-CALL-POINT>
                  </CALL-POINTS>
                  [!ENDIF!][!//
                  <IMPLEMENTED-ENTRY-REF DEST="BSW-MODULE-ENTRY">/Port_TI_AM261x/Port_ModuleEntry/Port_Bnk[!"num:i(num:i($index)-1)"!]Isr</IMPLEMENTED-ENTRY-REF>
                  <INTERRUPT-CATEGORY>[!"$INT_CAT"!]</INTERRUPT-CATEGORY>
                </BSW-INTERRUPT-ENTITY>
              [!VAR "port_bnk"="text:replace($port_bnk,$index,'0')"!][!//
            [!ENDIF!][!//
          [!ELSEIF "(contains($McuGpioIntrXbarVerify , 'MCU_GPIO_'))"!][!//
            [!VAR "index" = "num:i(num:i(substring-after($McuGpioIntrXbarVerify,'MCU_GPIO_'))+num:i(1))"!][!//
            [!IF "(num:i($index) = num:i(1) and (num:i($chn0) != num:i(0)))"!][!//
                <BSW-INTERRUPT-ENTITY UUID="[!"as:uuid()"!]">
                  <SHORT-NAME>Port_Ch0Isr</SHORT-NAME>
                  <REENTRANCY-LEVEL>NON-REENTRANT</REENTRANCY-LEVEL>
                  [!IF "as:modconf('Port')[1]/PortGeneral/PortDevErrorDetect = 'true'"!][!//
                  <CALL-POINTS>
                    <BSW-DIRECT-CALL-POINT>
                      <SHORT-NAME>Det_ReportError</SHORT-NAME>
                      <CALLED-ENTRY-REF DEST="BSW-MODULE-ENTRY">/AUTOSAR_Det/BSWModuleEntry/Det_ReportError</CALLED-ENTRY-REF>
                    </BSW-DIRECT-CALL-POINT>
                  </CALL-POINTS>
                  [!ENDIF!][!//
                  <IMPLEMENTED-ENTRY-REF DEST="BSW-MODULE-ENTRY">/Port_TI_AM261x/Port_ModuleEntry/Port_Ch0Isr</IMPLEMENTED-ENTRY-REF>
                  <INTERRUPT-CATEGORY>[!"$INT_CAT"!]</INTERRUPT-CATEGORY>
                </BSW-INTERRUPT-ENTITY>
              [!VAR "chn0"="num:i(0)"!][!//
            [!ELSEIF "( (num:i($index) != num:i(1)) and (num:i(text:split($port_ch1)[num:i($index)]) != num:i(0)) and (text:match($port_ch,$index) = 'true'))"!][!//
                <BSW-INTERRUPT-ENTITY UUID="[!"as:uuid()"!]">
                  <SHORT-NAME>Port_Ch[!"num:i(num:i($index)-1)"!]Isr</SHORT-NAME>
                  <REENTRANCY-LEVEL>NON-REENTRANT</REENTRANCY-LEVEL>
                  [!IF "as:modconf('Port')[1]/PortGeneral/PortDevErrorDetect = 'true'"!][!//
                  <CALL-POINTS>
                    <BSW-DIRECT-CALL-POINT>
                      <SHORT-NAME>Det_ReportError</SHORT-NAME>
                      <CALLED-ENTRY-REF DEST="BSW-MODULE-ENTRY">/AUTOSAR_Det/BSWModuleEntry/Det_ReportError</CALLED-ENTRY-REF>
                    </BSW-DIRECT-CALL-POINT>
                  </CALL-POINTS>
                  [!ENDIF!][!//
                  <IMPLEMENTED-ENTRY-REF DEST="BSW-MODULE-ENTRY">/Port_TI_AM261x/Port_ModuleEntry/Port_Ch[!"num:i(num:i($index)-1)"!]Isr</IMPLEMENTED-ENTRY-REF>
                  <INTERRUPT-CATEGORY>[!"$INT_CAT"!]</INTERRUPT-CATEGORY>
                </BSW-INTERRUPT-ENTITY>
              [!VAR "port_ch1"="text:replace($port_ch1,$index,'0')"!][!//
            [!ENDIF!][!//
          [!ENDIF!][!//
          [!ENDLOOP!][!//
                [!IF "as:modconf('Port')[1]/PortGeneral/PortClearIntrStatusApi = 'true'"!][!//
                <BSW-CALLED-ENTITY UUID="77db2b60-e52e-4f3c-a2d0-691f9a0557f7">
                  <SHORT-NAME>Port_ClearInterruptStatus</SHORT-NAME>
                  <REENTRANCY-LEVEL>SINGLE-CORE-REENTRANT</REENTRANCY-LEVEL>
                  [!IF "as:modconf('Port')[1]/PortGeneral/PortDevErrorDetect = 'true'"!][!//
                  <CALL-POINTS>
                    <BSW-DIRECT-CALL-POINT>
                      <SHORT-NAME>Det_ReportError</SHORT-NAME>
                      <CALLED-ENTRY-REF DEST="BSW-MODULE-ENTRY">/AUTOSAR_Det/BSWModuleEntry/Det_ReportError</CALLED-ENTRY-REF>
                    </BSW-DIRECT-CALL-POINT>
                  </CALL-POINTS>
                  [!ENDIF!][!//
                  <IMPLEMENTED-ENTRY-REF DEST="BSW-MODULE-ENTRY">/Port_TI_AM261x/Port_ModuleEntry/Port_ClearInterruptStatus</IMPLEMENTED-ENTRY-REF>
                </BSW-CALLED-ENTITY>
                [!ENDIF!][!//
                [!IF "as:modconf('Port')[1]/PortGeneral/PortGetIntrStatusApi = 'true'"!][!//
                <BSW-CALLED-ENTITY UUID="abd50d8a-2657-466b-bc7c-88e3fe792c7e">
                  <SHORT-NAME>Port_GetInterruptStatus</SHORT-NAME>
                  <REENTRANCY-LEVEL>SINGLE-CORE-REENTRANT</REENTRANCY-LEVEL>
                  [!IF "as:modconf('Port')[1]/PortGeneral/PortDevErrorDetect = 'true'"!][!//
                  <CALL-POINTS>
                    <BSW-DIRECT-CALL-POINT>
                      <SHORT-NAME>Det_ReportError</SHORT-NAME>
                      <CALLED-ENTRY-REF DEST="BSW-MODULE-ENTRY">/AUTOSAR_Det/BSWModuleEntry/Det_ReportError</CALLED-ENTRY-REF>
                    </BSW-DIRECT-CALL-POINT>
                  </CALL-POINTS>
                  [!ENDIF!][!//
                  <IMPLEMENTED-ENTRY-REF DEST="BSW-MODULE-ENTRY">/Port_TI_AM261x/Port_ModuleEntry/Port_GetInterruptStatus</IMPLEMENTED-ENTRY-REF>
                </BSW-CALLED-ENTITY>
                [!ENDIF!][!//
                [!IF "as:modconf('Port')[1]/PortGeneral/PortVersionInfoApi = 'true'"!][!//
                <BSW-CALLED-ENTITY UUID="51a3a10e-9720-4f8b-90dc-bdad3a7c925e">
                  <SHORT-NAME>Port_GetVersionInfo</SHORT-NAME>
                  <REENTRANCY-LEVEL>SINGLE-CORE-REENTRANT</REENTRANCY-LEVEL>
                  [!IF "as:modconf('Port')[1]/PortGeneral/PortDevErrorDetect = 'true'"!][!//
                  <CALL-POINTS>
                    <BSW-DIRECT-CALL-POINT>
                      <SHORT-NAME>Det_ReportError</SHORT-NAME>
                      <CALLED-ENTRY-REF DEST="BSW-MODULE-ENTRY">/AUTOSAR_Det/BSWModuleEntry/Det_ReportError</CALLED-ENTRY-REF>
                    </BSW-DIRECT-CALL-POINT>
                  </CALL-POINTS>
                  [!ENDIF!][!//
                  <IMPLEMENTED-ENTRY-REF DEST="BSW-MODULE-ENTRY">/Port_TI_AM261x/Port_ModuleEntry/Port_GetVersionInfo</IMPLEMENTED-ENTRY-REF>
                </BSW-CALLED-ENTITY>
                [!ENDIF!][!//
                <BSW-CALLED-ENTITY UUID="b06917a5-5fe0-4f4c-a66b-200ed05e52ff">
                  <SHORT-NAME>Port_Init</SHORT-NAME>
                  <REENTRANCY-LEVEL>NON-REENTRANT</REENTRANCY-LEVEL>
                  <CALL-POINTS>
                    <BSW-DIRECT-CALL-POINT>
                      <SHORT-NAME>Dem_SetEventStatus</SHORT-NAME>
                      <CALLED-ENTRY-REF DEST="BSW-MODULE-ENTRY">/AUTOSAR_Dem/BSWModuleEntry/Dem_SetEventStatus</CALLED-ENTRY-REF>
                    </BSW-DIRECT-CALL-POINT>
                    [!IF "as:modconf('Port')[1]/PortGeneral/PortDevErrorDetect = 'true'"!][!//
                    <BSW-DIRECT-CALL-POINT>
                      <SHORT-NAME>Det_ReportError</SHORT-NAME>
                      <CALLED-ENTRY-REF DEST="BSW-MODULE-ENTRY">/AUTOSAR_Det/BSWModuleEntry/Det_ReportError</CALLED-ENTRY-REF>
                    </BSW-DIRECT-CALL-POINT>
                    [!ENDIF!][!//
                  </CALL-POINTS>
                  <IMPLEMENTED-ENTRY-REF DEST="BSW-MODULE-ENTRY">/Port_TI_AM261x/Port_ModuleEntry/Port_Init</IMPLEMENTED-ENTRY-REF>
                </BSW-CALLED-ENTITY>
                [!IF "as:modconf('Port')[1]/PortGeneral/PortEnableIntrApi = 'true'"!][!//
                <BSW-CALLED-ENTITY UUID="fb08f3d7-0fd7-4d4c-9468-559d2db8bc8d">
                  <SHORT-NAME>Port_PinDisableIntrNotification</SHORT-NAME>
                  <REENTRANCY-LEVEL>SINGLE-CORE-REENTRANT</REENTRANCY-LEVEL>
                  [!IF "as:modconf('Port')[1]/PortGeneral/PortDevErrorDetect = 'true'"!][!//
                  <CALL-POINTS>
                    <BSW-DIRECT-CALL-POINT>
                      <SHORT-NAME>Det_ReportError</SHORT-NAME>
                      <CALLED-ENTRY-REF DEST="BSW-MODULE-ENTRY">/AUTOSAR_Det/BSWModuleEntry/Det_ReportError</CALLED-ENTRY-REF>
                    </BSW-DIRECT-CALL-POINT>
                  </CALL-POINTS>
                  [!ENDIF!][!//
                  <IMPLEMENTED-ENTRY-REF DEST="BSW-MODULE-ENTRY">/Port_TI_AM261x/Port_ModuleEntry/Port_PinDisableIntrNotification</IMPLEMENTED-ENTRY-REF>
                </BSW-CALLED-ENTITY>
                <BSW-CALLED-ENTITY UUID="fb496810-2608-460d-b4aa-af0aeb0f8587">
                  <SHORT-NAME>Port_PinEnableIntrNotification</SHORT-NAME>
                  <REENTRANCY-LEVEL>SINGLE-CORE-REENTRANT</REENTRANCY-LEVEL>
                  [!IF "as:modconf('Port')[1]/PortGeneral/PortDevErrorDetect = 'true'"!][!//
                  <CALL-POINTS>
                    <BSW-DIRECT-CALL-POINT>
                      <SHORT-NAME>Det_ReportError</SHORT-NAME>
                      <CALLED-ENTRY-REF DEST="BSW-MODULE-ENTRY">/AUTOSAR_Det/BSWModuleEntry/Det_ReportError</CALLED-ENTRY-REF>
                    </BSW-DIRECT-CALL-POINT>
                  </CALL-POINTS>
                  [!ENDIF!][!//
                  <IMPLEMENTED-ENTRY-REF DEST="BSW-MODULE-ENTRY">/Port_TI_AM261x/Port_ModuleEntry/Port_PinEnableIntrNotification</IMPLEMENTED-ENTRY-REF>
                </BSW-CALLED-ENTITY>
                [!ENDIF!][!//
                [!IF "as:modconf('Port')[1]/PortGeneral/PortRefreshPortDirectionApi = 'true'"!][!//
                <BSW-CALLED-ENTITY UUID="62bd7f28-f53d-4145-99a2-6b31430a59f9">
                  <SHORT-NAME>Port_RefreshPortDirection</SHORT-NAME>
                  <REENTRANCY-LEVEL>NON-REENTRANT</REENTRANCY-LEVEL>
                  <CALL-POINTS>
                    <BSW-DIRECT-CALL-POINT>
                      <SHORT-NAME>Dem_SetEventStatus</SHORT-NAME>
                      <CALLED-ENTRY-REF DEST="BSW-MODULE-ENTRY">/AUTOSAR_Dem/BSWModuleEntry/Dem_SetEventStatus</CALLED-ENTRY-REF>
                    </BSW-DIRECT-CALL-POINT>
                    [!IF "as:modconf('Port')[1]/PortGeneral/PortDevErrorDetect = 'true'"!][!//
                    <BSW-DIRECT-CALL-POINT>
                      <SHORT-NAME>Det_ReportError</SHORT-NAME>
                      <CALLED-ENTRY-REF DEST="BSW-MODULE-ENTRY">/AUTOSAR_Det/BSWModuleEntry/Det_ReportError</CALLED-ENTRY-REF>
                    </BSW-DIRECT-CALL-POINT>
                    [!ENDIF!][!//
                  </CALL-POINTS>
                  <IMPLEMENTED-ENTRY-REF DEST="BSW-MODULE-ENTRY">/Port_TI_AM261x/Port_ModuleEntry/Port_RefreshPortDirection</IMPLEMENTED-ENTRY-REF>
                </BSW-CALLED-ENTITY>
                [!ENDIF!][!//
                [!IF "as:modconf('Port')[1]/PortGeneral/PortSetPinDirectionApi = 'true'"!][!//
                <BSW-CALLED-ENTITY UUID="9d8ff517-897f-4b5a-b4d0-0e7e6be5d238">
                  <SHORT-NAME>Port_SetPinDirection</SHORT-NAME>
                  <CAN-ENTER-EXCLUSIVE-AREA-REFS>
                    <CAN-ENTER-EXCLUSIVE-AREA-REF DEST="EXCLUSIVE-AREA">/Port_TI_AM261x/Port/Port_Behavior/PORT_EXCLUSIVE_AREA_0</CAN-ENTER-EXCLUSIVE-AREA-REF>
                  </CAN-ENTER-EXCLUSIVE-AREA-REFS>
                  <REENTRANCY-LEVEL>SINGLE-CORE-REENTRANT</REENTRANCY-LEVEL>
                  <CALL-POINTS>
                    <BSW-DIRECT-CALL-POINT>
                      <SHORT-NAME>Dem_SetEventStatus</SHORT-NAME>
                      <CALLED-ENTRY-REF DEST="BSW-MODULE-ENTRY">/AUTOSAR_Dem/BSWModuleEntry/Dem_SetEventStatus</CALLED-ENTRY-REF>
                    </BSW-DIRECT-CALL-POINT>
                    [!IF "as:modconf('Port')[1]/PortGeneral/PortDevErrorDetect = 'true'"!][!//
                    <BSW-DIRECT-CALL-POINT>
                      <SHORT-NAME>Det_ReportError</SHORT-NAME>
                      <CALLED-ENTRY-REF DEST="BSW-MODULE-ENTRY">/AUTOSAR_Det/BSWModuleEntry/Det_ReportError</CALLED-ENTRY-REF>
                    </BSW-DIRECT-CALL-POINT>
                    [!ENDIF!][!//
                  </CALL-POINTS>
                  <IMPLEMENTED-ENTRY-REF DEST="BSW-MODULE-ENTRY">/Port_TI_AM261x/Port_ModuleEntry/Port_SetPinDirection</IMPLEMENTED-ENTRY-REF>
                </BSW-CALLED-ENTITY>
                [!ENDIF!][!//
                [!IF "as:modconf('Port')[1]/PortGeneral/PortSetPinModeApi = 'true'"!][!//
                <BSW-CALLED-ENTITY UUID="5b68be65-b364-4973-afb2-4319c90ac7e5">
                  <SHORT-NAME>Port_SetPinMode</SHORT-NAME>
                  <CAN-ENTER-EXCLUSIVE-AREA-REFS>
                    <CAN-ENTER-EXCLUSIVE-AREA-REF DEST="EXCLUSIVE-AREA">/Port_TI_AM261x/Port/Port_Behavior/PORT_EXCLUSIVE_AREA_0</CAN-ENTER-EXCLUSIVE-AREA-REF>
                  </CAN-ENTER-EXCLUSIVE-AREA-REFS>
                  <REENTRANCY-LEVEL>SINGLE-CORE-REENTRANT</REENTRANCY-LEVEL>
                  <CALL-POINTS>
                    <BSW-DIRECT-CALL-POINT>
                      <SHORT-NAME>Dem_SetEventStatus</SHORT-NAME>
                      <CALLED-ENTRY-REF DEST="BSW-MODULE-ENTRY">/AUTOSAR_Dem/BSWModuleEntry/Dem_SetEventStatus</CALLED-ENTRY-REF>
                    </BSW-DIRECT-CALL-POINT>
                    [!IF "as:modconf('Port')[1]/PortGeneral/PortDevErrorDetect = 'true'"!][!//
                    <BSW-DIRECT-CALL-POINT>
                      <SHORT-NAME>Det_ReportError</SHORT-NAME>
                      <CALLED-ENTRY-REF DEST="BSW-MODULE-ENTRY">/AUTOSAR_Det/BSWModuleEntry/Det_ReportError</CALLED-ENTRY-REF>
                    </BSW-DIRECT-CALL-POINT>
                    [!ENDIF!][!//
                  </CALL-POINTS>
                  <IMPLEMENTED-ENTRY-REF DEST="BSW-MODULE-ENTRY">/Port_TI_AM261x/Port_ModuleEntry/Port_SetPinMode</IMPLEMENTED-ENTRY-REF>
                </BSW-CALLED-ENTITY>
                [!ENDIF!][!//
              </ENTITYS>
            </BSW-INTERNAL-BEHAVIOR>
          </INTERNAL-BEHAVIORS>
        </BSW-MODULE-DESCRIPTION>
        <BSW-IMPLEMENTATION UUID="e8a70875-aed0-41a9-970b-81397bf1e60c">
          <SHORT-NAME>Port_Impl</SHORT-NAME>
          <CODE-DESCRIPTORS>
            <CODE UUID="66966fb6-9ba2-4ae0-8cc2-4ed89326a0f7">
              <SHORT-NAME>Files</SHORT-NAME>
              <ARTIFACT-DESCRIPTORS>
                <AUTOSAR-ENGINEERING-OBJECT>
                  <SHORT-LABEL>V0::Port_Irq.h</SHORT-LABEL>
                  <CATEGORY>SWHDR</CATEGORY>
                </AUTOSAR-ENGINEERING-OBJECT>
                <AUTOSAR-ENGINEERING-OBJECT>
                  <SHORT-LABEL>V0::Port_Irq.c</SHORT-LABEL>
                  <CATEGORY>SWSRC</CATEGORY>
                </AUTOSAR-ENGINEERING-OBJECT>
                <AUTOSAR-ENGINEERING-OBJECT>
                  <SHORT-LABEL>V0::Port_Priv.c</SHORT-LABEL>
                  <CATEGORY>SWSRC</CATEGORY>
                </AUTOSAR-ENGINEERING-OBJECT>
                <AUTOSAR-ENGINEERING-OBJECT>
                  <SHORT-LABEL>V0::Port_Priv.h</SHORT-LABEL>
                  <CATEGORY>SWHDR</CATEGORY>
                </AUTOSAR-ENGINEERING-OBJECT>
                <AUTOSAR-ENGINEERING-OBJECT>
                  <SHORT-LABEL>generate::include::Port_Cfg.h</SHORT-LABEL>
                  <CATEGORY>SWHDR</CATEGORY>
                </AUTOSAR-ENGINEERING-OBJECT>
                <AUTOSAR-ENGINEERING-OBJECT>
                  <SHORT-LABEL>generate::src::Port_Cfg.c</SHORT-LABEL>
                  <CATEGORY>SWSRC</CATEGORY>
                </AUTOSAR-ENGINEERING-OBJECT>
                <AUTOSAR-ENGINEERING-OBJECT>
                  <SHORT-LABEL>generate::src::Port_PBcfg.c</SHORT-LABEL>
                  <CATEGORY>SWSRC</CATEGORY>
                </AUTOSAR-ENGINEERING-OBJECT>
                <AUTOSAR-ENGINEERING-OBJECT>
                  <SHORT-LABEL>include::Port.h</SHORT-LABEL>
                  <CATEGORY>SWHDR</CATEGORY>
                </AUTOSAR-ENGINEERING-OBJECT>
                <AUTOSAR-ENGINEERING-OBJECT>
                  <SHORT-LABEL>src::Port.c</SHORT-LABEL>
                  <CATEGORY>SWSRC</CATEGORY>
                </AUTOSAR-ENGINEERING-OBJECT>
              </ARTIFACT-DESCRIPTORS>
            </CODE>
          </CODE-DESCRIPTORS>
          <COMPILERS>
            <COMPILER UUID="3752f12b-e82d-40cf-9254-dbcf47e6c9b7">
              <SHORT-NAME>tiarmclang</SHORT-NAME>
              <NAME>TI ARM Clang</NAME>
              <VENDOR>Texas Instruments</VENDOR>
              <VERSION>4.0.0</VERSION>
            </COMPILER>
          </COMPILERS>
          <LINKERS>
            <LINKER UUID="82681b81-c22b-449c-b728-bde2212ab0e2">
              <SHORT-NAME>tiarmlnk</SHORT-NAME>
              <NAME>TI ARM Clang Linker</NAME>
              <VENDOR>Texas Instruments</VENDOR>
              <VERSION>4.0.0</VERSION>
            </LINKER>
          </LINKERS>
          <PROGRAMMING-LANGUAGE>C</PROGRAMMING-LANGUAGE>
          <RESOURCE-CONSUMPTION UUID="9f8fca35-d02c-45b4-80e9-2d91fba8ec55">
            <SHORT-NAME>ResourceConsumption</SHORT-NAME>
            <MEMORY-SECTIONS>
              <MEMORY-SECTION UUID="e79fa4b8-d350-4bb4-8b25-3b577fa494e0">
                <SHORT-NAME>PORT_CODE</SHORT-NAME>
                <SW-ADDRMETHOD-REF DEST="SW-ADDR-METHOD">/AUTOSAR_MemMap/SwAddrMethods/CODE</SW-ADDRMETHOD-REF>
                <SYMBOL>CODE</SYMBOL>
              </MEMORY-SECTION>
              <MEMORY-SECTION UUID="99790ffc-e37f-4fff-b434-906c63d52c06">
                <SHORT-NAME>PORT_CONFIG_DATA</SHORT-NAME>
                <ALIGNMENT>UNSPECIFIED</ALIGNMENT>
                <SW-ADDRMETHOD-REF DEST="SW-ADDR-METHOD">/AUTOSAR_MemMap/SwAddrMethods/CONST_PBCFG</SW-ADDRMETHOD-REF>
                <SYMBOL>CONFIG_DATA</SYMBOL>
              </MEMORY-SECTION>
              <MEMORY-SECTION UUID="c6ce9737-67cc-4599-ad0e-e7740767e07d">
                <SHORT-NAME>PORT_CONST_UNSPECIFIED</SHORT-NAME>
                <ALIGNMENT>UNSPECIFIED</ALIGNMENT>
                <SW-ADDRMETHOD-REF DEST="SW-ADDR-METHOD">/AUTOSAR_MemMap/SwAddrMethods/CONST</SW-ADDRMETHOD-REF>
                <SYMBOL>CONST_UNSPECIFIED</SYMBOL>
              </MEMORY-SECTION>
              <MEMORY-SECTION UUID="89f83ee1-34e7-4554-81d5-bfbb950b1eb6">
                <SHORT-NAME>PORT_ISR_CODE</SHORT-NAME>
                <SW-ADDRMETHOD-REF DEST="SW-ADDR-METHOD">/AUTOSAR_MemMap/SwAddrMethods/CODE</SW-ADDRMETHOD-REF>
                <SYMBOL>ISR_CODE</SYMBOL>
              </MEMORY-SECTION>
              <MEMORY-SECTION UUID="ef55c84f-da8a-457e-8298-1275dee6f55a">
                <SHORT-NAME>PORT_VAR_INIT_UNSPECIFIED</SHORT-NAME>
                <ALIGNMENT>UNSPECIFIED</ALIGNMENT>
                <SW-ADDRMETHOD-REF DEST="SW-ADDR-METHOD">/AUTOSAR_MemMap/SwAddrMethods/VAR_INIT</SW-ADDRMETHOD-REF>
                <SYMBOL>VAR_INIT_UNSPECIFIED</SYMBOL>
              </MEMORY-SECTION>
              <MEMORY-SECTION UUID="c42f739f-4b64-404d-936e-44469a1133cd">
                <SHORT-NAME>PORT_VAR_NO_INIT_UNSPECIFIED</SHORT-NAME>
                <ALIGNMENT>UNSPECIFIED</ALIGNMENT>
                <SW-ADDRMETHOD-REF DEST="SW-ADDR-METHOD">/AUTOSAR_MemMap/SwAddrMethods/VAR_NO_INIT</SW-ADDRMETHOD-REF>
                <SYMBOL>VAR_NO_INIT_UNSPECIFIED</SYMBOL>
              </MEMORY-SECTION>
            </MEMORY-SECTIONS>            
          </RESOURCE-CONSUMPTION>
          <SW-VERSION>10.01.00</SW-VERSION>
          <VENDOR-ID>44</VENDOR-ID>
          <AR-RELEASE-VERSION>4.3.1</AR-RELEASE-VERSION>
          <BEHAVIOR-REF DEST="BSW-INTERNAL-BEHAVIOR">/Port_TI_AM261x/Port/Port_Behavior</BEHAVIOR-REF>
          <VENDOR-SPECIFIC-MODULE-DEF-REFS>
            <VENDOR-SPECIFIC-MODULE-DEF-REF DEST="ECUC-MODULE-DEF">/TI_AM261x/Port</VENDOR-SPECIFIC-MODULE-DEF-REF>
          </VENDOR-SPECIFIC-MODULE-DEF-REFS>
        </BSW-IMPLEMENTATION>
      </ELEMENTS>
      <AR-PACKAGES>
        <AR-PACKAGE UUID="271035c6-10c9-4a58-9342-35835fbd0e10">
          <SHORT-NAME>Port_ModuleEntry</SHORT-NAME>
          <ELEMENTS>
            <BSW-MODULE-ENTRY UUID="d6cc451e-0a27-4c6c-8c9b-aba909f18fb3">
              <SHORT-NAME>Port_ClearInterruptStatus</SHORT-NAME>
              <SERVICE-ID>8</SERVICE-ID>
              <IS-REENTRANT>true</IS-REENTRANT>
              <IS-SYNCHRONOUS>true</IS-SYNCHRONOUS>
              <CALL-TYPE>REGULAR</CALL-TYPE>
              <EXECUTION-CONTEXT>UNSPECIFIED</EXECUTION-CONTEXT>
              <SW-SERVICE-IMPL-POLICY>STANDARD</SW-SERVICE-IMPL-POLICY>
              <BSW-ENTRY-KIND>CONCRETE</BSW-ENTRY-KIND>
            </BSW-MODULE-ENTRY>
            <BSW-MODULE-ENTRY UUID="d3a5aa66-8e9a-44d5-a51a-7d7db11cb31a">
              <SHORT-NAME>Port_GetInterruptStatus</SHORT-NAME>
              <SERVICE-ID>7</SERVICE-ID>
              <IS-REENTRANT>true</IS-REENTRANT>
              <IS-SYNCHRONOUS>true</IS-SYNCHRONOUS>
              <CALL-TYPE>REGULAR</CALL-TYPE>
              <EXECUTION-CONTEXT>UNSPECIFIED</EXECUTION-CONTEXT>
              <SW-SERVICE-IMPL-POLICY>STANDARD</SW-SERVICE-IMPL-POLICY>
              <BSW-ENTRY-KIND>CONCRETE</BSW-ENTRY-KIND>
            </BSW-MODULE-ENTRY>
            <BSW-MODULE-ENTRY UUID="f9832214-1f27-4710-8a72-faeb90fcbd22">
              <SHORT-NAME>Port_GetVersionInfo</SHORT-NAME>
              <SERVICE-ID>3</SERVICE-ID>
              <IS-REENTRANT>true</IS-REENTRANT>
              <IS-SYNCHRONOUS>true</IS-SYNCHRONOUS>
              <CALL-TYPE>REGULAR</CALL-TYPE>
              <EXECUTION-CONTEXT>UNSPECIFIED</EXECUTION-CONTEXT>
              <SW-SERVICE-IMPL-POLICY>STANDARD</SW-SERVICE-IMPL-POLICY>
              <BSW-ENTRY-KIND>CONCRETE</BSW-ENTRY-KIND>
            </BSW-MODULE-ENTRY>
            <BSW-MODULE-ENTRY UUID="82897212-435e-495d-9c72-a4c0d8806637">
              <SHORT-NAME>Port_Init</SHORT-NAME>
              <SERVICE-ID>0</SERVICE-ID>
              <IS-REENTRANT>false</IS-REENTRANT>
              <IS-SYNCHRONOUS>true</IS-SYNCHRONOUS>
              <CALL-TYPE>REGULAR</CALL-TYPE>
              <EXECUTION-CONTEXT>UNSPECIFIED</EXECUTION-CONTEXT>
              <SW-SERVICE-IMPL-POLICY>STANDARD</SW-SERVICE-IMPL-POLICY>
              <BSW-ENTRY-KIND>CONCRETE</BSW-ENTRY-KIND>
            </BSW-MODULE-ENTRY>
            <BSW-MODULE-ENTRY UUID="27fc19ba-198a-4603-bdc3-61a96bfe3fcd">
              <SHORT-NAME>Port_PinDisableIntrNotification</SHORT-NAME>
              <SERVICE-ID>6</SERVICE-ID>
              <IS-REENTRANT>true</IS-REENTRANT>
              <IS-SYNCHRONOUS>true</IS-SYNCHRONOUS>
              <CALL-TYPE>REGULAR</CALL-TYPE>
              <EXECUTION-CONTEXT>UNSPECIFIED</EXECUTION-CONTEXT>
              <SW-SERVICE-IMPL-POLICY>STANDARD</SW-SERVICE-IMPL-POLICY>
              <BSW-ENTRY-KIND>CONCRETE</BSW-ENTRY-KIND>
            </BSW-MODULE-ENTRY>
            <BSW-MODULE-ENTRY UUID="b81fe5bd-2b4f-42f3-83ad-71ea30b6250e">
              <SHORT-NAME>Port_PinEnableIntrNotification</SHORT-NAME>
              <SERVICE-ID>5</SERVICE-ID>
              <IS-REENTRANT>true</IS-REENTRANT>
              <IS-SYNCHRONOUS>true</IS-SYNCHRONOUS>
              <CALL-TYPE>REGULAR</CALL-TYPE>
              <EXECUTION-CONTEXT>UNSPECIFIED</EXECUTION-CONTEXT>
              <SW-SERVICE-IMPL-POLICY>STANDARD</SW-SERVICE-IMPL-POLICY>
              <BSW-ENTRY-KIND>CONCRETE</BSW-ENTRY-KIND>
            </BSW-MODULE-ENTRY>
            <BSW-MODULE-ENTRY UUID="75677e83-c082-4a8e-bda5-500d45fd36a8">
              <SHORT-NAME>Port_RefreshPortDirection</SHORT-NAME>
              <SERVICE-ID>2</SERVICE-ID>
              <IS-REENTRANT>false</IS-REENTRANT>
              <IS-SYNCHRONOUS>true</IS-SYNCHRONOUS>
              <CALL-TYPE>REGULAR</CALL-TYPE>
              <EXECUTION-CONTEXT>UNSPECIFIED</EXECUTION-CONTEXT>
              <SW-SERVICE-IMPL-POLICY>STANDARD</SW-SERVICE-IMPL-POLICY>
              <BSW-ENTRY-KIND>CONCRETE</BSW-ENTRY-KIND>
            </BSW-MODULE-ENTRY>
            <BSW-MODULE-ENTRY UUID="6cea51b1-e536-460e-8983-c1d97e1366ac">
              <SHORT-NAME>Port_SetPinDirection</SHORT-NAME>
              <SERVICE-ID>1</SERVICE-ID>
              <IS-REENTRANT>true</IS-REENTRANT>
              <IS-SYNCHRONOUS>true</IS-SYNCHRONOUS>
              <CALL-TYPE>REGULAR</CALL-TYPE>
              <EXECUTION-CONTEXT>UNSPECIFIED</EXECUTION-CONTEXT>
              <SW-SERVICE-IMPL-POLICY>STANDARD</SW-SERVICE-IMPL-POLICY>
              <BSW-ENTRY-KIND>CONCRETE</BSW-ENTRY-KIND>
            </BSW-MODULE-ENTRY>
            <BSW-MODULE-ENTRY UUID="74b9dd37-5ff9-4bff-b7b0-e344faf2aaef">
              <SHORT-NAME>Port_SetPinMode</SHORT-NAME>
              <SERVICE-ID>4</SERVICE-ID>
              <IS-REENTRANT>true</IS-REENTRANT>
              <IS-SYNCHRONOUS>true</IS-SYNCHRONOUS>
              <CALL-TYPE>REGULAR</CALL-TYPE>
              <EXECUTION-CONTEXT>UNSPECIFIED</EXECUTION-CONTEXT>
              <SW-SERVICE-IMPL-POLICY>STANDARD</SW-SERVICE-IMPL-POLICY>
              <BSW-ENTRY-KIND>CONCRETE</BSW-ENTRY-KIND>
            </BSW-MODULE-ENTRY>    
            <BSW-MODULE-ENTRY UUID="9bdb438c-18da-4970-b969-3763e8924822">
              <SHORT-NAME>Port_Bnk0Isr</SHORT-NAME>
              <IS-REENTRANT>false</IS-REENTRANT>
              <IS-SYNCHRONOUS>true</IS-SYNCHRONOUS>
              <CALL-TYPE>INTERRUPT</CALL-TYPE>
              <EXECUTION-CONTEXT>[!"$INT_EXECUTION_CONTEXT"!]</EXECUTION-CONTEXT>
              <SW-SERVICE-IMPL-POLICY>STANDARD</SW-SERVICE-IMPL-POLICY>
              <BSW-ENTRY-KIND>CONCRETE</BSW-ENTRY-KIND>
            </BSW-MODULE-ENTRY>    
            <BSW-MODULE-ENTRY UUID="0a61856c-5f87-45a9-96c4-1354b5496fcc">
              <SHORT-NAME>Port_Bnk1Isr</SHORT-NAME>
              <IS-REENTRANT>false</IS-REENTRANT>
              <IS-SYNCHRONOUS>true</IS-SYNCHRONOUS>
              <CALL-TYPE>INTERRUPT</CALL-TYPE>
              <EXECUTION-CONTEXT>[!"$INT_EXECUTION_CONTEXT"!]</EXECUTION-CONTEXT>
              <SW-SERVICE-IMPL-POLICY>STANDARD</SW-SERVICE-IMPL-POLICY>
              <BSW-ENTRY-KIND>CONCRETE</BSW-ENTRY-KIND>
            </BSW-MODULE-ENTRY>    
            <BSW-MODULE-ENTRY UUID="7658564e-35df-4a4e-a541-d6e72b760103">
              <SHORT-NAME>Port_Bnk2Isr</SHORT-NAME>
              <IS-REENTRANT>false</IS-REENTRANT>
              <IS-SYNCHRONOUS>true</IS-SYNCHRONOUS>
              <CALL-TYPE>INTERRUPT</CALL-TYPE>
              <EXECUTION-CONTEXT>[!"$INT_EXECUTION_CONTEXT"!]</EXECUTION-CONTEXT>
              <SW-SERVICE-IMPL-POLICY>STANDARD</SW-SERVICE-IMPL-POLICY>
              <BSW-ENTRY-KIND>CONCRETE</BSW-ENTRY-KIND>
            </BSW-MODULE-ENTRY>    
            <BSW-MODULE-ENTRY UUID="4aa64ea2-59ab-4942-b702-211ed01fe26a">
              <SHORT-NAME>Port_Bnk3Isr</SHORT-NAME>
              <IS-REENTRANT>false</IS-REENTRANT>
              <IS-SYNCHRONOUS>true</IS-SYNCHRONOUS>
              <CALL-TYPE>INTERRUPT</CALL-TYPE>
              <EXECUTION-CONTEXT>[!"$INT_EXECUTION_CONTEXT"!]</EXECUTION-CONTEXT>
              <SW-SERVICE-IMPL-POLICY>STANDARD</SW-SERVICE-IMPL-POLICY>
              <BSW-ENTRY-KIND>CONCRETE</BSW-ENTRY-KIND>
            </BSW-MODULE-ENTRY>    
            <BSW-MODULE-ENTRY UUID="9284cefb-c210-4384-8520-780f30754880">
              <SHORT-NAME>Port_Bnk4Isr</SHORT-NAME>
              <IS-REENTRANT>false</IS-REENTRANT>
              <IS-SYNCHRONOUS>true</IS-SYNCHRONOUS>
              <CALL-TYPE>INTERRUPT</CALL-TYPE>
              <EXECUTION-CONTEXT>[!"$INT_EXECUTION_CONTEXT"!]</EXECUTION-CONTEXT>
              <SW-SERVICE-IMPL-POLICY>STANDARD</SW-SERVICE-IMPL-POLICY>
              <BSW-ENTRY-KIND>CONCRETE</BSW-ENTRY-KIND>
            </BSW-MODULE-ENTRY>    
            <BSW-MODULE-ENTRY UUID="f00145b2-968f-4928-aff0-738e7d7fbb3c">
              <SHORT-NAME>Port_Bnk5Isr</SHORT-NAME>
              <IS-REENTRANT>false</IS-REENTRANT>
              <IS-SYNCHRONOUS>true</IS-SYNCHRONOUS>
              <CALL-TYPE>INTERRUPT</CALL-TYPE>
              <EXECUTION-CONTEXT>[!"$INT_EXECUTION_CONTEXT"!]</EXECUTION-CONTEXT>
              <SW-SERVICE-IMPL-POLICY>STANDARD</SW-SERVICE-IMPL-POLICY>
              <BSW-ENTRY-KIND>CONCRETE</BSW-ENTRY-KIND>
            </BSW-MODULE-ENTRY>    
            <BSW-MODULE-ENTRY UUID="eeb0c9f2-2658-447f-87e4-9b7989c5b424">
              <SHORT-NAME>Port_Bnk6Isr</SHORT-NAME>
              <IS-REENTRANT>false</IS-REENTRANT>
              <IS-SYNCHRONOUS>true</IS-SYNCHRONOUS>
              <CALL-TYPE>INTERRUPT</CALL-TYPE>
              <EXECUTION-CONTEXT>[!"$INT_EXECUTION_CONTEXT"!]</EXECUTION-CONTEXT>
              <SW-SERVICE-IMPL-POLICY>STANDARD</SW-SERVICE-IMPL-POLICY>
              <BSW-ENTRY-KIND>CONCRETE</BSW-ENTRY-KIND>
            </BSW-MODULE-ENTRY>    
            <BSW-MODULE-ENTRY UUID="71858098-3efd-4140-ad75-85889eaa8598">
              <SHORT-NAME>Port_Bnk7Isr</SHORT-NAME>
              <IS-REENTRANT>false</IS-REENTRANT>
              <IS-SYNCHRONOUS>true</IS-SYNCHRONOUS>
              <CALL-TYPE>INTERRUPT</CALL-TYPE>
              <EXECUTION-CONTEXT>[!"$INT_EXECUTION_CONTEXT"!]</EXECUTION-CONTEXT>
              <SW-SERVICE-IMPL-POLICY>STANDARD</SW-SERVICE-IMPL-POLICY>
              <BSW-ENTRY-KIND>CONCRETE</BSW-ENTRY-KIND>
            </BSW-MODULE-ENTRY>    
            <BSW-MODULE-ENTRY UUID="ba5427b9-07c5-4a44-8de7-c9ddaa1f8bb9">
              <SHORT-NAME>Port_Bnk8Isr</SHORT-NAME>
              <IS-REENTRANT>false</IS-REENTRANT>
              <IS-SYNCHRONOUS>true</IS-SYNCHRONOUS>
              <CALL-TYPE>INTERRUPT</CALL-TYPE>
              <EXECUTION-CONTEXT>[!"$INT_EXECUTION_CONTEXT"!]</EXECUTION-CONTEXT>
              <SW-SERVICE-IMPL-POLICY>STANDARD</SW-SERVICE-IMPL-POLICY>
              <BSW-ENTRY-KIND>CONCRETE</BSW-ENTRY-KIND>
            </BSW-MODULE-ENTRY>    
            <BSW-MODULE-ENTRY UUID="f9cb832c-e579-4937-a482-a8e55e559eb5">
              <SHORT-NAME>Port_Ch0Isr</SHORT-NAME>
              <IS-REENTRANT>false</IS-REENTRANT>
              <IS-SYNCHRONOUS>true</IS-SYNCHRONOUS>
              <CALL-TYPE>INTERRUPT</CALL-TYPE>
              <EXECUTION-CONTEXT>[!"$INT_EXECUTION_CONTEXT"!]</EXECUTION-CONTEXT>              
              <SW-SERVICE-IMPL-POLICY>STANDARD</SW-SERVICE-IMPL-POLICY>
              <BSW-ENTRY-KIND>CONCRETE</BSW-ENTRY-KIND>
            </BSW-MODULE-ENTRY>    
            <BSW-MODULE-ENTRY UUID="a0c2aa82-9824-453c-b6a1-8f2f5d83a8ba">
              <SHORT-NAME>Port_Ch1Isr</SHORT-NAME>
              <IS-REENTRANT>false</IS-REENTRANT>
              <IS-SYNCHRONOUS>true</IS-SYNCHRONOUS>
              <CALL-TYPE>INTERRUPT</CALL-TYPE>
              <EXECUTION-CONTEXT>[!"$INT_EXECUTION_CONTEXT"!]</EXECUTION-CONTEXT>              
              <SW-SERVICE-IMPL-POLICY>STANDARD</SW-SERVICE-IMPL-POLICY>
              <BSW-ENTRY-KIND>CONCRETE</BSW-ENTRY-KIND>
            </BSW-MODULE-ENTRY>    
            <BSW-MODULE-ENTRY UUID="749ac46b-e59c-45c4-be91-0b348c225301">
              <SHORT-NAME>Port_Ch2Isr</SHORT-NAME>
              <IS-REENTRANT>false</IS-REENTRANT>
              <IS-SYNCHRONOUS>true</IS-SYNCHRONOUS>
              <CALL-TYPE>INTERRUPT</CALL-TYPE>
              <EXECUTION-CONTEXT>[!"$INT_EXECUTION_CONTEXT"!]</EXECUTION-CONTEXT>              
              <SW-SERVICE-IMPL-POLICY>STANDARD</SW-SERVICE-IMPL-POLICY>
              <BSW-ENTRY-KIND>CONCRETE</BSW-ENTRY-KIND>
            </BSW-MODULE-ENTRY>    
            <BSW-MODULE-ENTRY UUID="28248c50-a82e-40ca-9241-9e707a658dcb">
              <SHORT-NAME>Port_Ch3Isr</SHORT-NAME>
              <IS-REENTRANT>false</IS-REENTRANT>
              <IS-SYNCHRONOUS>true</IS-SYNCHRONOUS>
              <CALL-TYPE>INTERRUPT</CALL-TYPE>
              <EXECUTION-CONTEXT>[!"$INT_EXECUTION_CONTEXT"!]</EXECUTION-CONTEXT>              
              <SW-SERVICE-IMPL-POLICY>STANDARD</SW-SERVICE-IMPL-POLICY>
              <BSW-ENTRY-KIND>CONCRETE</BSW-ENTRY-KIND>
            </BSW-MODULE-ENTRY>    
            <BSW-MODULE-ENTRY UUID="85990009-5a92-4609-abe5-ebfae7cf1507">
              <SHORT-NAME>Port_Ch4Isr</SHORT-NAME>
              <IS-REENTRANT>false</IS-REENTRANT>
              <IS-SYNCHRONOUS>true</IS-SYNCHRONOUS>
              <CALL-TYPE>INTERRUPT</CALL-TYPE>
              <EXECUTION-CONTEXT>[!"$INT_EXECUTION_CONTEXT"!]</EXECUTION-CONTEXT>              
              <SW-SERVICE-IMPL-POLICY>STANDARD</SW-SERVICE-IMPL-POLICY>
              <BSW-ENTRY-KIND>CONCRETE</BSW-ENTRY-KIND>
            </BSW-MODULE-ENTRY>    
            <BSW-MODULE-ENTRY UUID="87c49adf-02c6-49cf-a89c-c5822367a027">
              <SHORT-NAME>Port_Ch5Isr</SHORT-NAME>
              <IS-REENTRANT>false</IS-REENTRANT>
              <IS-SYNCHRONOUS>true</IS-SYNCHRONOUS>
              <CALL-TYPE>INTERRUPT</CALL-TYPE>
              <EXECUTION-CONTEXT>[!"$INT_EXECUTION_CONTEXT"!]</EXECUTION-CONTEXT>              
              <SW-SERVICE-IMPL-POLICY>STANDARD</SW-SERVICE-IMPL-POLICY>
              <BSW-ENTRY-KIND>CONCRETE</BSW-ENTRY-KIND>
            </BSW-MODULE-ENTRY>    
            <BSW-MODULE-ENTRY UUID="9778ad12-6601-4640-83eb-77af1483a0e6">
              <SHORT-NAME>Port_Ch6Isr</SHORT-NAME>
              <IS-REENTRANT>false</IS-REENTRANT>
              <IS-SYNCHRONOUS>true</IS-SYNCHRONOUS>
              <CALL-TYPE>INTERRUPT</CALL-TYPE>
              <EXECUTION-CONTEXT>[!"$INT_EXECUTION_CONTEXT"!]</EXECUTION-CONTEXT>              
              <SW-SERVICE-IMPL-POLICY>STANDARD</SW-SERVICE-IMPL-POLICY>
              <BSW-ENTRY-KIND>CONCRETE</BSW-ENTRY-KIND>
            </BSW-MODULE-ENTRY>    
            <BSW-MODULE-ENTRY UUID="26738526-7d3e-454a-9069-9dc626483cb7">
              <SHORT-NAME>Port_Ch7Isr</SHORT-NAME>
              <IS-REENTRANT>false</IS-REENTRANT>
              <IS-SYNCHRONOUS>true</IS-SYNCHRONOUS>
              <CALL-TYPE>INTERRUPT</CALL-TYPE>
              <EXECUTION-CONTEXT>[!"$INT_EXECUTION_CONTEXT"!]</EXECUTION-CONTEXT>              
              <SW-SERVICE-IMPL-POLICY>STANDARD</SW-SERVICE-IMPL-POLICY>
              <BSW-ENTRY-KIND>CONCRETE</BSW-ENTRY-KIND>
            </BSW-MODULE-ENTRY>    
            <BSW-MODULE-ENTRY UUID="ed9f1a84-9d14-4caf-85f9-ed9567e0fef6">
              <SHORT-NAME>Port_Ch8Isr</SHORT-NAME>
              <IS-REENTRANT>false</IS-REENTRANT>
              <IS-SYNCHRONOUS>true</IS-SYNCHRONOUS>
              <CALL-TYPE>INTERRUPT</CALL-TYPE>
              <EXECUTION-CONTEXT>[!"$INT_EXECUTION_CONTEXT"!]</EXECUTION-CONTEXT>              
              <SW-SERVICE-IMPL-POLICY>STANDARD</SW-SERVICE-IMPL-POLICY>
              <BSW-ENTRY-KIND>CONCRETE</BSW-ENTRY-KIND>
            </BSW-MODULE-ENTRY>    
            <BSW-MODULE-ENTRY UUID="5d24ff98-8eb6-4839-849c-85ceb8cc03fc">
              <SHORT-NAME>Port_Ch9Isr</SHORT-NAME>
              <IS-REENTRANT>false</IS-REENTRANT>
              <IS-SYNCHRONOUS>true</IS-SYNCHRONOUS>
              <CALL-TYPE>INTERRUPT</CALL-TYPE>
              <EXECUTION-CONTEXT>[!"$INT_EXECUTION_CONTEXT"!]</EXECUTION-CONTEXT>              
              <SW-SERVICE-IMPL-POLICY>STANDARD</SW-SERVICE-IMPL-POLICY>
              <BSW-ENTRY-KIND>CONCRETE</BSW-ENTRY-KIND>
            </BSW-MODULE-ENTRY>    
            <BSW-MODULE-ENTRY UUID="441f2d98-3a03-40b3-bd38-cf2cb7695431">
              <SHORT-NAME>Port_Ch10Isr</SHORT-NAME>
              <IS-REENTRANT>false</IS-REENTRANT>
              <IS-SYNCHRONOUS>true</IS-SYNCHRONOUS>
              <CALL-TYPE>INTERRUPT</CALL-TYPE>
              <EXECUTION-CONTEXT>[!"$INT_EXECUTION_CONTEXT"!]</EXECUTION-CONTEXT>              
              <SW-SERVICE-IMPL-POLICY>STANDARD</SW-SERVICE-IMPL-POLICY>
              <BSW-ENTRY-KIND>CONCRETE</BSW-ENTRY-KIND>
            </BSW-MODULE-ENTRY>    
            <BSW-MODULE-ENTRY UUID="e789af6b-3130-4ff2-b9a5-1cc24e58f1b5">
              <SHORT-NAME>Port_Ch11Isr</SHORT-NAME>
              <IS-REENTRANT>false</IS-REENTRANT>
              <IS-SYNCHRONOUS>true</IS-SYNCHRONOUS>
              <CALL-TYPE>INTERRUPT</CALL-TYPE>
              <EXECUTION-CONTEXT>[!"$INT_EXECUTION_CONTEXT"!]</EXECUTION-CONTEXT>              
              <SW-SERVICE-IMPL-POLICY>STANDARD</SW-SERVICE-IMPL-POLICY>
              <BSW-ENTRY-KIND>CONCRETE</BSW-ENTRY-KIND>
            </BSW-MODULE-ENTRY>    
            <BSW-MODULE-ENTRY UUID="a1bea161-71b2-48ee-bc53-6dc073442cf2">
              <SHORT-NAME>Port_Ch12Isr</SHORT-NAME>
              <IS-REENTRANT>false</IS-REENTRANT>
              <IS-SYNCHRONOUS>true</IS-SYNCHRONOUS>
              <CALL-TYPE>INTERRUPT</CALL-TYPE>
              <EXECUTION-CONTEXT>[!"$INT_EXECUTION_CONTEXT"!]</EXECUTION-CONTEXT>              
              <SW-SERVICE-IMPL-POLICY>STANDARD</SW-SERVICE-IMPL-POLICY>
              <BSW-ENTRY-KIND>CONCRETE</BSW-ENTRY-KIND>
            </BSW-MODULE-ENTRY>    
            <BSW-MODULE-ENTRY UUID="d426330f-01df-4a32-a8ab-13ae18cc1ac1">
              <SHORT-NAME>Port_Ch13Isr</SHORT-NAME>
              <IS-REENTRANT>false</IS-REENTRANT>
              <IS-SYNCHRONOUS>true</IS-SYNCHRONOUS>
              <CALL-TYPE>INTERRUPT</CALL-TYPE>
              <EXECUTION-CONTEXT>[!"$INT_EXECUTION_CONTEXT"!]</EXECUTION-CONTEXT>              
              <SW-SERVICE-IMPL-POLICY>STANDARD</SW-SERVICE-IMPL-POLICY>
              <BSW-ENTRY-KIND>CONCRETE</BSW-ENTRY-KIND>
            </BSW-MODULE-ENTRY>    
            <BSW-MODULE-ENTRY UUID="7fc5a752-2d54-4996-afbd-3f1555b956c1">
              <SHORT-NAME>Port_Ch14Isr</SHORT-NAME>
              <IS-REENTRANT>false</IS-REENTRANT>
              <IS-SYNCHRONOUS>true</IS-SYNCHRONOUS>
              <CALL-TYPE>INTERRUPT</CALL-TYPE>
              <EXECUTION-CONTEXT>[!"$INT_EXECUTION_CONTEXT"!]</EXECUTION-CONTEXT>              
              <SW-SERVICE-IMPL-POLICY>STANDARD</SW-SERVICE-IMPL-POLICY>
              <BSW-ENTRY-KIND>CONCRETE</BSW-ENTRY-KIND>
            </BSW-MODULE-ENTRY>    
            <BSW-MODULE-ENTRY UUID="5808bd11-deda-4661-bb0c-f8ef47f55545">
              <SHORT-NAME>Port_Ch15Isr</SHORT-NAME>
              <IS-REENTRANT>false</IS-REENTRANT>
              <IS-SYNCHRONOUS>true</IS-SYNCHRONOUS>
              <CALL-TYPE>INTERRUPT</CALL-TYPE>
              <EXECUTION-CONTEXT>[!"$INT_EXECUTION_CONTEXT"!]</EXECUTION-CONTEXT>              
              <SW-SERVICE-IMPL-POLICY>STANDARD</SW-SERVICE-IMPL-POLICY>
              <BSW-ENTRY-KIND>CONCRETE</BSW-ENTRY-KIND>
            </BSW-MODULE-ENTRY>    
            <BSW-MODULE-ENTRY UUID="92b9aff3-d7bc-47f3-889c-a0fdad4bd95c">
              <SHORT-NAME>Port_Ch16Isr</SHORT-NAME>
              <IS-REENTRANT>false</IS-REENTRANT>
              <IS-SYNCHRONOUS>true</IS-SYNCHRONOUS>
              <CALL-TYPE>INTERRUPT</CALL-TYPE>
              <EXECUTION-CONTEXT>[!"$INT_EXECUTION_CONTEXT"!]</EXECUTION-CONTEXT>              
              <SW-SERVICE-IMPL-POLICY>STANDARD</SW-SERVICE-IMPL-POLICY>
              <BSW-ENTRY-KIND>CONCRETE</BSW-ENTRY-KIND>
            </BSW-MODULE-ENTRY>    
            <BSW-MODULE-ENTRY UUID="269fb80e-8b91-46a2-bebb-9fd4fd6ecf5f">
              <SHORT-NAME>Port_Ch17Isr</SHORT-NAME>
              <IS-REENTRANT>false</IS-REENTRANT>
              <IS-SYNCHRONOUS>true</IS-SYNCHRONOUS>
              <CALL-TYPE>INTERRUPT</CALL-TYPE>
              <EXECUTION-CONTEXT>[!"$INT_EXECUTION_CONTEXT"!]</EXECUTION-CONTEXT>              
              <SW-SERVICE-IMPL-POLICY>STANDARD</SW-SERVICE-IMPL-POLICY>
              <BSW-ENTRY-KIND>CONCRETE</BSW-ENTRY-KIND>
            </BSW-MODULE-ENTRY>    
            <BSW-MODULE-ENTRY UUID="d903dd6f-bbce-47c1-9c70-8cde7d8afff2">
              <SHORT-NAME>Port_Ch18Isr</SHORT-NAME>
              <IS-REENTRANT>false</IS-REENTRANT>
              <IS-SYNCHRONOUS>true</IS-SYNCHRONOUS>
              <CALL-TYPE>INTERRUPT</CALL-TYPE>
              <EXECUTION-CONTEXT>[!"$INT_EXECUTION_CONTEXT"!]</EXECUTION-CONTEXT>              
              <SW-SERVICE-IMPL-POLICY>STANDARD</SW-SERVICE-IMPL-POLICY>
              <BSW-ENTRY-KIND>CONCRETE</BSW-ENTRY-KIND>
            </BSW-MODULE-ENTRY>    
            <BSW-MODULE-ENTRY UUID="998ada7f-878f-40e4-ac10-90a47d7abd47">
              <SHORT-NAME>Port_Ch19Isr</SHORT-NAME>
              <IS-REENTRANT>false</IS-REENTRANT>
              <IS-SYNCHRONOUS>true</IS-SYNCHRONOUS>
              <CALL-TYPE>INTERRUPT</CALL-TYPE>
              <EXECUTION-CONTEXT>[!"$INT_EXECUTION_CONTEXT"!]</EXECUTION-CONTEXT>              
              <SW-SERVICE-IMPL-POLICY>STANDARD</SW-SERVICE-IMPL-POLICY>
              <BSW-ENTRY-KIND>CONCRETE</BSW-ENTRY-KIND>
            </BSW-MODULE-ENTRY>    
            <BSW-MODULE-ENTRY UUID="20931d90-5648-4a2a-8299-5daf235cdc0c">
              <SHORT-NAME>Port_Ch20Isr</SHORT-NAME>
              <IS-REENTRANT>false</IS-REENTRANT>
              <IS-SYNCHRONOUS>true</IS-SYNCHRONOUS>
              <CALL-TYPE>INTERRUPT</CALL-TYPE>
              <EXECUTION-CONTEXT>[!"$INT_EXECUTION_CONTEXT"!]</EXECUTION-CONTEXT>              
              <SW-SERVICE-IMPL-POLICY>STANDARD</SW-SERVICE-IMPL-POLICY>
              <BSW-ENTRY-KIND>CONCRETE</BSW-ENTRY-KIND>
            </BSW-MODULE-ENTRY>    
            <BSW-MODULE-ENTRY UUID="8e3bdd60-62f4-4f30-9c91-3b18a36dca72">
              <SHORT-NAME>Port_Ch21Isr</SHORT-NAME>
              <IS-REENTRANT>false</IS-REENTRANT>
              <IS-SYNCHRONOUS>true</IS-SYNCHRONOUS>
              <CALL-TYPE>INTERRUPT</CALL-TYPE>
              <EXECUTION-CONTEXT>[!"$INT_EXECUTION_CONTEXT"!]</EXECUTION-CONTEXT>              
              <SW-SERVICE-IMPL-POLICY>STANDARD</SW-SERVICE-IMPL-POLICY>
              <BSW-ENTRY-KIND>CONCRETE</BSW-ENTRY-KIND>
            </BSW-MODULE-ENTRY>    
            <BSW-MODULE-ENTRY UUID="129bb8eb-bd4a-4c73-a7f7-bbfcd0c9e559">
              <SHORT-NAME>Port_Ch22Isr</SHORT-NAME>
              <IS-REENTRANT>false</IS-REENTRANT>
              <IS-SYNCHRONOUS>true</IS-SYNCHRONOUS>
              <CALL-TYPE>INTERRUPT</CALL-TYPE>
              <EXECUTION-CONTEXT>[!"$INT_EXECUTION_CONTEXT"!]</EXECUTION-CONTEXT>              
              <SW-SERVICE-IMPL-POLICY>STANDARD</SW-SERVICE-IMPL-POLICY>
              <BSW-ENTRY-KIND>CONCRETE</BSW-ENTRY-KIND>
            </BSW-MODULE-ENTRY>    
            <BSW-MODULE-ENTRY UUID="adc72c64-93f1-48cf-9a42-b7e2f7002d53">
              <SHORT-NAME>Port_Ch23Isr</SHORT-NAME>
              <IS-REENTRANT>false</IS-REENTRANT>
              <IS-SYNCHRONOUS>true</IS-SYNCHRONOUS>
              <CALL-TYPE>INTERRUPT</CALL-TYPE>
              <EXECUTION-CONTEXT>[!"$INT_EXECUTION_CONTEXT"!]</EXECUTION-CONTEXT>              
              <SW-SERVICE-IMPL-POLICY>STANDARD</SW-SERVICE-IMPL-POLICY>
              <BSW-ENTRY-KIND>CONCRETE</BSW-ENTRY-KIND>
            </BSW-MODULE-ENTRY>    
            <BSW-MODULE-ENTRY UUID="a1375471-4e1b-4436-96ca-9086ece11bb1">
              <SHORT-NAME>Port_Ch24Isr</SHORT-NAME>
              <IS-REENTRANT>false</IS-REENTRANT>
              <IS-SYNCHRONOUS>true</IS-SYNCHRONOUS>
              <CALL-TYPE>INTERRUPT</CALL-TYPE>
              <EXECUTION-CONTEXT>[!"$INT_EXECUTION_CONTEXT"!]</EXECUTION-CONTEXT>              
              <SW-SERVICE-IMPL-POLICY>STANDARD</SW-SERVICE-IMPL-POLICY>
              <BSW-ENTRY-KIND>CONCRETE</BSW-ENTRY-KIND>
            </BSW-MODULE-ENTRY>    
            <BSW-MODULE-ENTRY UUID="24f5e99e-5779-4453-94de-b202c0e757b4">
              <SHORT-NAME>Port_Ch25Isr</SHORT-NAME>
              <IS-REENTRANT>false</IS-REENTRANT>
              <IS-SYNCHRONOUS>true</IS-SYNCHRONOUS>
              <CALL-TYPE>INTERRUPT</CALL-TYPE>
              <EXECUTION-CONTEXT>[!"$INT_EXECUTION_CONTEXT"!]</EXECUTION-CONTEXT>              
              <SW-SERVICE-IMPL-POLICY>STANDARD</SW-SERVICE-IMPL-POLICY>
              <BSW-ENTRY-KIND>CONCRETE</BSW-ENTRY-KIND>
            </BSW-MODULE-ENTRY>    
            <BSW-MODULE-ENTRY UUID="b18c6ae3-21c0-4dbc-ac97-f06df17e44aa">
              <SHORT-NAME>Port_Ch26Isr</SHORT-NAME>
              <IS-REENTRANT>false</IS-REENTRANT>
              <IS-SYNCHRONOUS>true</IS-SYNCHRONOUS>
              <CALL-TYPE>INTERRUPT</CALL-TYPE>
              <EXECUTION-CONTEXT>[!"$INT_EXECUTION_CONTEXT"!]</EXECUTION-CONTEXT>              
              <SW-SERVICE-IMPL-POLICY>STANDARD</SW-SERVICE-IMPL-POLICY>
              <BSW-ENTRY-KIND>CONCRETE</BSW-ENTRY-KIND>
            </BSW-MODULE-ENTRY>    
            <BSW-MODULE-ENTRY UUID="7336aa46-f8e8-4973-a092-b2df982dcebf">
              <SHORT-NAME>Port_Ch27Isr</SHORT-NAME>
              <IS-REENTRANT>false</IS-REENTRANT>
              <IS-SYNCHRONOUS>true</IS-SYNCHRONOUS>
              <CALL-TYPE>INTERRUPT</CALL-TYPE>
              <EXECUTION-CONTEXT>[!"$INT_EXECUTION_CONTEXT"!]</EXECUTION-CONTEXT>              
              <SW-SERVICE-IMPL-POLICY>STANDARD</SW-SERVICE-IMPL-POLICY>
              <BSW-ENTRY-KIND>CONCRETE</BSW-ENTRY-KIND>
            </BSW-MODULE-ENTRY>    
            <BSW-MODULE-ENTRY UUID="0eb2529c-9769-4fea-8c4e-8921b3278d27">
              <SHORT-NAME>Port_Ch28Isr</SHORT-NAME>
              <IS-REENTRANT>false</IS-REENTRANT>
              <IS-SYNCHRONOUS>true</IS-SYNCHRONOUS>
              <CALL-TYPE>INTERRUPT</CALL-TYPE>
              <EXECUTION-CONTEXT>[!"$INT_EXECUTION_CONTEXT"!]</EXECUTION-CONTEXT>              
              <SW-SERVICE-IMPL-POLICY>STANDARD</SW-SERVICE-IMPL-POLICY>
              <BSW-ENTRY-KIND>CONCRETE</BSW-ENTRY-KIND>
            </BSW-MODULE-ENTRY>    
            <BSW-MODULE-ENTRY UUID="4f00c147-04bc-4aa8-8050-a96e0a61f4a2">
              <SHORT-NAME>Port_Ch29Isr</SHORT-NAME>
              <IS-REENTRANT>false</IS-REENTRANT>
              <IS-SYNCHRONOUS>true</IS-SYNCHRONOUS>
              <CALL-TYPE>INTERRUPT</CALL-TYPE>
              <EXECUTION-CONTEXT>[!"$INT_EXECUTION_CONTEXT"!]</EXECUTION-CONTEXT>              
              <SW-SERVICE-IMPL-POLICY>STANDARD</SW-SERVICE-IMPL-POLICY>
              <BSW-ENTRY-KIND>CONCRETE</BSW-ENTRY-KIND>
            </BSW-MODULE-ENTRY>    
            <BSW-MODULE-ENTRY UUID="bb973118-3e2f-4134-a656-c4c96001220c">
              <SHORT-NAME>Port_Ch30Isr</SHORT-NAME>
              <IS-REENTRANT>false</IS-REENTRANT>
              <IS-SYNCHRONOUS>true</IS-SYNCHRONOUS>
              <CALL-TYPE>INTERRUPT</CALL-TYPE>
              <EXECUTION-CONTEXT>[!"$INT_EXECUTION_CONTEXT"!]</EXECUTION-CONTEXT>              
              <SW-SERVICE-IMPL-POLICY>STANDARD</SW-SERVICE-IMPL-POLICY>
              <BSW-ENTRY-KIND>CONCRETE</BSW-ENTRY-KIND>
            </BSW-MODULE-ENTRY>    
            <BSW-MODULE-ENTRY UUID="fbc4411e-9da0-4184-b44e-ff5071bcf5df">
              <SHORT-NAME>Port_Ch31Isr</SHORT-NAME>
              <IS-REENTRANT>false</IS-REENTRANT>
              <IS-SYNCHRONOUS>true</IS-SYNCHRONOUS>
              <CALL-TYPE>INTERRUPT</CALL-TYPE>
              <EXECUTION-CONTEXT>[!"$INT_EXECUTION_CONTEXT"!]</EXECUTION-CONTEXT>              
              <SW-SERVICE-IMPL-POLICY>STANDARD</SW-SERVICE-IMPL-POLICY>
              <BSW-ENTRY-KIND>CONCRETE</BSW-ENTRY-KIND>
            </BSW-MODULE-ENTRY>    
            <BSW-MODULE-ENTRY UUID="19abd4b1-282d-4168-8b00-4928bee0ee48">
              <SHORT-NAME>Port_Ch32Isr</SHORT-NAME>
              <IS-REENTRANT>false</IS-REENTRANT>
              <IS-SYNCHRONOUS>true</IS-SYNCHRONOUS>
              <CALL-TYPE>INTERRUPT</CALL-TYPE>
              <EXECUTION-CONTEXT>[!"$INT_EXECUTION_CONTEXT"!]</EXECUTION-CONTEXT>              
              <SW-SERVICE-IMPL-POLICY>STANDARD</SW-SERVICE-IMPL-POLICY>
              <BSW-ENTRY-KIND>CONCRETE</BSW-ENTRY-KIND>
            </BSW-MODULE-ENTRY>    
            <BSW-MODULE-ENTRY UUID="59acb7bd-a551-40f3-9a56-21783890d1bc">
              <SHORT-NAME>Port_Ch33Isr</SHORT-NAME>
              <IS-REENTRANT>false</IS-REENTRANT>
              <IS-SYNCHRONOUS>true</IS-SYNCHRONOUS>
              <CALL-TYPE>INTERRUPT</CALL-TYPE>
              <EXECUTION-CONTEXT>[!"$INT_EXECUTION_CONTEXT"!]</EXECUTION-CONTEXT>              
              <SW-SERVICE-IMPL-POLICY>STANDARD</SW-SERVICE-IMPL-POLICY>
              <BSW-ENTRY-KIND>CONCRETE</BSW-ENTRY-KIND>
            </BSW-MODULE-ENTRY>    
            <BSW-MODULE-ENTRY UUID="4e4789d1-6c55-40f6-a681-98334588e29a">
              <SHORT-NAME>Port_Ch34Isr</SHORT-NAME>
              <IS-REENTRANT>false</IS-REENTRANT>
              <IS-SYNCHRONOUS>true</IS-SYNCHRONOUS>
              <CALL-TYPE>INTERRUPT</CALL-TYPE>
              <EXECUTION-CONTEXT>[!"$INT_EXECUTION_CONTEXT"!]</EXECUTION-CONTEXT>              
              <SW-SERVICE-IMPL-POLICY>STANDARD</SW-SERVICE-IMPL-POLICY>
              <BSW-ENTRY-KIND>CONCRETE</BSW-ENTRY-KIND>
            </BSW-MODULE-ENTRY>    
            <BSW-MODULE-ENTRY UUID="d2db6118-be45-4350-86aa-d68a7944a10f">
              <SHORT-NAME>Port_Ch35Isr</SHORT-NAME>
              <IS-REENTRANT>false</IS-REENTRANT>
              <IS-SYNCHRONOUS>true</IS-SYNCHRONOUS>
              <CALL-TYPE>INTERRUPT</CALL-TYPE>
              <EXECUTION-CONTEXT>[!"$INT_EXECUTION_CONTEXT"!]</EXECUTION-CONTEXT>              
              <SW-SERVICE-IMPL-POLICY>STANDARD</SW-SERVICE-IMPL-POLICY>
              <BSW-ENTRY-KIND>CONCRETE</BSW-ENTRY-KIND>
            </BSW-MODULE-ENTRY>    
            <BSW-MODULE-ENTRY UUID="46ef9087-5356-4675-a761-8e72d68b4926">
              <SHORT-NAME>Port_Ch36Isr</SHORT-NAME>
              <IS-REENTRANT>false</IS-REENTRANT>
              <IS-SYNCHRONOUS>true</IS-SYNCHRONOUS>
              <CALL-TYPE>INTERRUPT</CALL-TYPE>
              <EXECUTION-CONTEXT>[!"$INT_EXECUTION_CONTEXT"!]</EXECUTION-CONTEXT>              
              <SW-SERVICE-IMPL-POLICY>STANDARD</SW-SERVICE-IMPL-POLICY>
              <BSW-ENTRY-KIND>CONCRETE</BSW-ENTRY-KIND>
            </BSW-MODULE-ENTRY>    
            <BSW-MODULE-ENTRY UUID="000cad9a-09b8-447b-a17d-87eb4fe6ee30">
              <SHORT-NAME>Port_Ch37Isr</SHORT-NAME>
              <IS-REENTRANT>false</IS-REENTRANT>
              <IS-SYNCHRONOUS>true</IS-SYNCHRONOUS>
              <CALL-TYPE>INTERRUPT</CALL-TYPE>
              <EXECUTION-CONTEXT>[!"$INT_EXECUTION_CONTEXT"!]</EXECUTION-CONTEXT>              
              <SW-SERVICE-IMPL-POLICY>STANDARD</SW-SERVICE-IMPL-POLICY>
              <BSW-ENTRY-KIND>CONCRETE</BSW-ENTRY-KIND>
            </BSW-MODULE-ENTRY>    
            <BSW-MODULE-ENTRY UUID="d698d3d9-ac35-443b-be9f-a1688b1d091d">
              <SHORT-NAME>Port_Ch38Isr</SHORT-NAME>
              <IS-REENTRANT>false</IS-REENTRANT>
              <IS-SYNCHRONOUS>true</IS-SYNCHRONOUS>
              <CALL-TYPE>INTERRUPT</CALL-TYPE>
              <EXECUTION-CONTEXT>[!"$INT_EXECUTION_CONTEXT"!]</EXECUTION-CONTEXT>              
              <SW-SERVICE-IMPL-POLICY>STANDARD</SW-SERVICE-IMPL-POLICY>
              <BSW-ENTRY-KIND>CONCRETE</BSW-ENTRY-KIND>
            </BSW-MODULE-ENTRY>    
            <BSW-MODULE-ENTRY UUID="019184b6-3567-4f3f-adfa-8947a1ae2062">
              <SHORT-NAME>Port_Ch39Isr</SHORT-NAME>
              <IS-REENTRANT>false</IS-REENTRANT>
              <IS-SYNCHRONOUS>true</IS-SYNCHRONOUS>
              <CALL-TYPE>INTERRUPT</CALL-TYPE>
              <EXECUTION-CONTEXT>[!"$INT_EXECUTION_CONTEXT"!]</EXECUTION-CONTEXT>              
              <SW-SERVICE-IMPL-POLICY>STANDARD</SW-SERVICE-IMPL-POLICY>
              <BSW-ENTRY-KIND>CONCRETE</BSW-ENTRY-KIND>
            </BSW-MODULE-ENTRY>    
            <BSW-MODULE-ENTRY UUID="c262211c-89f8-4ea2-b9c6-e56d16d7c35d">
              <SHORT-NAME>Port_Ch40Isr</SHORT-NAME>
              <IS-REENTRANT>false</IS-REENTRANT>
              <IS-SYNCHRONOUS>true</IS-SYNCHRONOUS>
              <CALL-TYPE>INTERRUPT</CALL-TYPE>
              <EXECUTION-CONTEXT>[!"$INT_EXECUTION_CONTEXT"!]</EXECUTION-CONTEXT>              
              <SW-SERVICE-IMPL-POLICY>STANDARD</SW-SERVICE-IMPL-POLICY>
              <BSW-ENTRY-KIND>CONCRETE</BSW-ENTRY-KIND>
            </BSW-MODULE-ENTRY>    
            <BSW-MODULE-ENTRY UUID="b55d09c9-2a2f-4d41-aee7-dd0ebc87d4e3">
              <SHORT-NAME>Port_Ch41Isr</SHORT-NAME>
              <IS-REENTRANT>false</IS-REENTRANT>
              <IS-SYNCHRONOUS>true</IS-SYNCHRONOUS>
              <CALL-TYPE>INTERRUPT</CALL-TYPE>
              <EXECUTION-CONTEXT>[!"$INT_EXECUTION_CONTEXT"!]</EXECUTION-CONTEXT>              
              <SW-SERVICE-IMPL-POLICY>STANDARD</SW-SERVICE-IMPL-POLICY>
              <BSW-ENTRY-KIND>CONCRETE</BSW-ENTRY-KIND>
            </BSW-MODULE-ENTRY>    
            <BSW-MODULE-ENTRY UUID="bb5f4a1e-b658-4209-9955-ebe301f352c3">
              <SHORT-NAME>Port_Ch42Isr</SHORT-NAME>
              <IS-REENTRANT>false</IS-REENTRANT>
              <IS-SYNCHRONOUS>true</IS-SYNCHRONOUS>
              <CALL-TYPE>INTERRUPT</CALL-TYPE>
              <EXECUTION-CONTEXT>[!"$INT_EXECUTION_CONTEXT"!]</EXECUTION-CONTEXT>              
              <SW-SERVICE-IMPL-POLICY>STANDARD</SW-SERVICE-IMPL-POLICY>
              <BSW-ENTRY-KIND>CONCRETE</BSW-ENTRY-KIND>
            </BSW-MODULE-ENTRY>    
            <BSW-MODULE-ENTRY UUID="90922fab-38cd-43f1-a250-c3af48e3db2c">
              <SHORT-NAME>Port_Ch43Isr</SHORT-NAME>
              <IS-REENTRANT>false</IS-REENTRANT>
              <IS-SYNCHRONOUS>true</IS-SYNCHRONOUS>
              <CALL-TYPE>INTERRUPT</CALL-TYPE>
              <EXECUTION-CONTEXT>[!"$INT_EXECUTION_CONTEXT"!]</EXECUTION-CONTEXT>              
              <SW-SERVICE-IMPL-POLICY>STANDARD</SW-SERVICE-IMPL-POLICY>
              <BSW-ENTRY-KIND>CONCRETE</BSW-ENTRY-KIND>
            </BSW-MODULE-ENTRY>    
            <BSW-MODULE-ENTRY UUID="4a59d3e5-7394-428f-8981-2687a93c3bd4">
              <SHORT-NAME>Port_Ch44Isr</SHORT-NAME>
              <IS-REENTRANT>false</IS-REENTRANT>
              <IS-SYNCHRONOUS>true</IS-SYNCHRONOUS>
              <CALL-TYPE>INTERRUPT</CALL-TYPE>
              <EXECUTION-CONTEXT>[!"$INT_EXECUTION_CONTEXT"!]</EXECUTION-CONTEXT>              
              <SW-SERVICE-IMPL-POLICY>STANDARD</SW-SERVICE-IMPL-POLICY>
              <BSW-ENTRY-KIND>CONCRETE</BSW-ENTRY-KIND>
            </BSW-MODULE-ENTRY>    
            <BSW-MODULE-ENTRY UUID="764d3261-b0c2-4292-99b8-5ee038282720">
              <SHORT-NAME>Port_Ch45Isr</SHORT-NAME>
              <IS-REENTRANT>false</IS-REENTRANT>
              <IS-SYNCHRONOUS>true</IS-SYNCHRONOUS>
              <CALL-TYPE>INTERRUPT</CALL-TYPE>
              <EXECUTION-CONTEXT>[!"$INT_EXECUTION_CONTEXT"!]</EXECUTION-CONTEXT>              
              <SW-SERVICE-IMPL-POLICY>STANDARD</SW-SERVICE-IMPL-POLICY>
              <BSW-ENTRY-KIND>CONCRETE</BSW-ENTRY-KIND>
            </BSW-MODULE-ENTRY>    
            <BSW-MODULE-ENTRY UUID="16908eaa-f542-4fde-82c2-15cf4c93d666">
              <SHORT-NAME>Port_Ch46Isr</SHORT-NAME>
              <IS-REENTRANT>false</IS-REENTRANT>
              <IS-SYNCHRONOUS>true</IS-SYNCHRONOUS>
              <CALL-TYPE>INTERRUPT</CALL-TYPE>
              <EXECUTION-CONTEXT>[!"$INT_EXECUTION_CONTEXT"!]</EXECUTION-CONTEXT>              
              <SW-SERVICE-IMPL-POLICY>STANDARD</SW-SERVICE-IMPL-POLICY>
              <BSW-ENTRY-KIND>CONCRETE</BSW-ENTRY-KIND>
            </BSW-MODULE-ENTRY>    
            <BSW-MODULE-ENTRY UUID="bf083897-38e7-4a62-bc1c-9478745a3de9">
              <SHORT-NAME>Port_Ch47Isr</SHORT-NAME>
              <IS-REENTRANT>false</IS-REENTRANT>
              <IS-SYNCHRONOUS>true</IS-SYNCHRONOUS>
              <CALL-TYPE>INTERRUPT</CALL-TYPE>
              <EXECUTION-CONTEXT>[!"$INT_EXECUTION_CONTEXT"!]</EXECUTION-CONTEXT>              
              <SW-SERVICE-IMPL-POLICY>STANDARD</SW-SERVICE-IMPL-POLICY>
              <BSW-ENTRY-KIND>CONCRETE</BSW-ENTRY-KIND>
            </BSW-MODULE-ENTRY>    
            <BSW-MODULE-ENTRY UUID="99e2819b-8695-4ea8-9784-421562bf9d50">
              <SHORT-NAME>Port_Ch48Isr</SHORT-NAME>
              <IS-REENTRANT>false</IS-REENTRANT>
              <IS-SYNCHRONOUS>true</IS-SYNCHRONOUS>
              <CALL-TYPE>INTERRUPT</CALL-TYPE>
              <EXECUTION-CONTEXT>[!"$INT_EXECUTION_CONTEXT"!]</EXECUTION-CONTEXT>              
              <SW-SERVICE-IMPL-POLICY>STANDARD</SW-SERVICE-IMPL-POLICY>
              <BSW-ENTRY-KIND>CONCRETE</BSW-ENTRY-KIND>
            </BSW-MODULE-ENTRY>    
            <BSW-MODULE-ENTRY UUID="9ab6c0c1-f322-45f4-b0f1-842319fa160a">
              <SHORT-NAME>Port_Ch49Isr</SHORT-NAME>
              <IS-REENTRANT>false</IS-REENTRANT>
              <IS-SYNCHRONOUS>true</IS-SYNCHRONOUS>
              <CALL-TYPE>INTERRUPT</CALL-TYPE>
              <EXECUTION-CONTEXT>[!"$INT_EXECUTION_CONTEXT"!]</EXECUTION-CONTEXT>              
              <SW-SERVICE-IMPL-POLICY>STANDARD</SW-SERVICE-IMPL-POLICY>
              <BSW-ENTRY-KIND>CONCRETE</BSW-ENTRY-KIND>
            </BSW-MODULE-ENTRY>    
            <BSW-MODULE-ENTRY UUID="90700d52-3644-4d35-a9a3-2cef9a0afd08">
              <SHORT-NAME>Port_Ch50Isr</SHORT-NAME>
              <IS-REENTRANT>false</IS-REENTRANT>
              <IS-SYNCHRONOUS>true</IS-SYNCHRONOUS>
              <CALL-TYPE>INTERRUPT</CALL-TYPE>
              <EXECUTION-CONTEXT>[!"$INT_EXECUTION_CONTEXT"!]</EXECUTION-CONTEXT>              
              <SW-SERVICE-IMPL-POLICY>STANDARD</SW-SERVICE-IMPL-POLICY>
              <BSW-ENTRY-KIND>CONCRETE</BSW-ENTRY-KIND>
            </BSW-MODULE-ENTRY>    
            <BSW-MODULE-ENTRY UUID="5be99f84-af2c-489d-82e8-48d571c6ddc0">
              <SHORT-NAME>Port_Ch51Isr</SHORT-NAME>
              <IS-REENTRANT>false</IS-REENTRANT>
              <IS-SYNCHRONOUS>true</IS-SYNCHRONOUS>
              <CALL-TYPE>INTERRUPT</CALL-TYPE>
              <EXECUTION-CONTEXT>[!"$INT_EXECUTION_CONTEXT"!]</EXECUTION-CONTEXT>              
              <SW-SERVICE-IMPL-POLICY>STANDARD</SW-SERVICE-IMPL-POLICY>
              <BSW-ENTRY-KIND>CONCRETE</BSW-ENTRY-KIND>
            </BSW-MODULE-ENTRY>    
            <BSW-MODULE-ENTRY UUID="e7b4e154-7de8-4914-90a0-64b467fae816">
              <SHORT-NAME>Port_Ch52Isr</SHORT-NAME>
              <IS-REENTRANT>false</IS-REENTRANT>
              <IS-SYNCHRONOUS>true</IS-SYNCHRONOUS>
              <CALL-TYPE>INTERRUPT</CALL-TYPE>
              <EXECUTION-CONTEXT>[!"$INT_EXECUTION_CONTEXT"!]</EXECUTION-CONTEXT>              
              <SW-SERVICE-IMPL-POLICY>STANDARD</SW-SERVICE-IMPL-POLICY>
              <BSW-ENTRY-KIND>CONCRETE</BSW-ENTRY-KIND>
            </BSW-MODULE-ENTRY>    
            <BSW-MODULE-ENTRY UUID="a909da55-48ff-4fe9-b32c-83f2c8283e78">
              <SHORT-NAME>Port_Ch53Isr</SHORT-NAME>
              <IS-REENTRANT>false</IS-REENTRANT>
              <IS-SYNCHRONOUS>true</IS-SYNCHRONOUS>
              <CALL-TYPE>INTERRUPT</CALL-TYPE>
              <EXECUTION-CONTEXT>[!"$INT_EXECUTION_CONTEXT"!]</EXECUTION-CONTEXT>              
              <SW-SERVICE-IMPL-POLICY>STANDARD</SW-SERVICE-IMPL-POLICY>
              <BSW-ENTRY-KIND>CONCRETE</BSW-ENTRY-KIND>
            </BSW-MODULE-ENTRY>    
            <BSW-MODULE-ENTRY UUID="c76e1371-bdac-48a3-92ff-8827ae29ca75">
              <SHORT-NAME>Port_Ch54Isr</SHORT-NAME>
              <IS-REENTRANT>false</IS-REENTRANT>
              <IS-SYNCHRONOUS>true</IS-SYNCHRONOUS>
              <CALL-TYPE>INTERRUPT</CALL-TYPE>
              <EXECUTION-CONTEXT>[!"$INT_EXECUTION_CONTEXT"!]</EXECUTION-CONTEXT>              
              <SW-SERVICE-IMPL-POLICY>STANDARD</SW-SERVICE-IMPL-POLICY>
              <BSW-ENTRY-KIND>CONCRETE</BSW-ENTRY-KIND>
            </BSW-MODULE-ENTRY>    
            <BSW-MODULE-ENTRY UUID="62fbb26d-c1c0-4316-8323-003c3d0bfb0f">
              <SHORT-NAME>Port_Ch55Isr</SHORT-NAME>
              <IS-REENTRANT>false</IS-REENTRANT>
              <IS-SYNCHRONOUS>true</IS-SYNCHRONOUS>
              <CALL-TYPE>INTERRUPT</CALL-TYPE>
              <EXECUTION-CONTEXT>[!"$INT_EXECUTION_CONTEXT"!]</EXECUTION-CONTEXT>              
              <SW-SERVICE-IMPL-POLICY>STANDARD</SW-SERVICE-IMPL-POLICY>
              <BSW-ENTRY-KIND>CONCRETE</BSW-ENTRY-KIND>
            </BSW-MODULE-ENTRY>    
            <BSW-MODULE-ENTRY UUID="c2d2e100-45e3-44f4-8879-037041ebfd0c">
              <SHORT-NAME>Port_Ch56Isr</SHORT-NAME>
              <IS-REENTRANT>false</IS-REENTRANT>
              <IS-SYNCHRONOUS>true</IS-SYNCHRONOUS>
              <CALL-TYPE>INTERRUPT</CALL-TYPE>
              <EXECUTION-CONTEXT>[!"$INT_EXECUTION_CONTEXT"!]</EXECUTION-CONTEXT>              
              <SW-SERVICE-IMPL-POLICY>STANDARD</SW-SERVICE-IMPL-POLICY>
              <BSW-ENTRY-KIND>CONCRETE</BSW-ENTRY-KIND>
            </BSW-MODULE-ENTRY>    
            <BSW-MODULE-ENTRY UUID="a117f992-46ee-4133-ad35-d1839e45ec9c">
              <SHORT-NAME>Port_Ch57Isr</SHORT-NAME>
              <IS-REENTRANT>false</IS-REENTRANT>
              <IS-SYNCHRONOUS>true</IS-SYNCHRONOUS>
              <CALL-TYPE>INTERRUPT</CALL-TYPE>
              <EXECUTION-CONTEXT>[!"$INT_EXECUTION_CONTEXT"!]</EXECUTION-CONTEXT>              
              <SW-SERVICE-IMPL-POLICY>STANDARD</SW-SERVICE-IMPL-POLICY>
              <BSW-ENTRY-KIND>CONCRETE</BSW-ENTRY-KIND>
            </BSW-MODULE-ENTRY>    
            <BSW-MODULE-ENTRY UUID="0df46f1c-af73-4a05-bde6-9682b6ec0cdf">
              <SHORT-NAME>Port_Ch58Isr</SHORT-NAME>
              <IS-REENTRANT>false</IS-REENTRANT>
              <IS-SYNCHRONOUS>true</IS-SYNCHRONOUS>
              <CALL-TYPE>INTERRUPT</CALL-TYPE>
              <EXECUTION-CONTEXT>[!"$INT_EXECUTION_CONTEXT"!]</EXECUTION-CONTEXT>              
              <SW-SERVICE-IMPL-POLICY>STANDARD</SW-SERVICE-IMPL-POLICY>
              <BSW-ENTRY-KIND>CONCRETE</BSW-ENTRY-KIND>
            </BSW-MODULE-ENTRY>    
            <BSW-MODULE-ENTRY UUID="5ad4925d-7d70-48b3-9fa3-bd8dfd70149e">
              <SHORT-NAME>Port_Ch59Isr</SHORT-NAME>
              <IS-REENTRANT>false</IS-REENTRANT>
              <IS-SYNCHRONOUS>true</IS-SYNCHRONOUS>
              <CALL-TYPE>INTERRUPT</CALL-TYPE>
              <EXECUTION-CONTEXT>[!"$INT_EXECUTION_CONTEXT"!]</EXECUTION-CONTEXT>              
              <SW-SERVICE-IMPL-POLICY>STANDARD</SW-SERVICE-IMPL-POLICY>
              <BSW-ENTRY-KIND>CONCRETE</BSW-ENTRY-KIND>
            </BSW-MODULE-ENTRY>    
            <BSW-MODULE-ENTRY UUID="df5515b9-f6ae-420d-ae97-0dd5c9182d50">
              <SHORT-NAME>Port_Ch60Isr</SHORT-NAME>
              <IS-REENTRANT>false</IS-REENTRANT>
              <IS-SYNCHRONOUS>true</IS-SYNCHRONOUS>
              <CALL-TYPE>INTERRUPT</CALL-TYPE>
              <EXECUTION-CONTEXT>[!"$INT_EXECUTION_CONTEXT"!]</EXECUTION-CONTEXT>              
              <SW-SERVICE-IMPL-POLICY>STANDARD</SW-SERVICE-IMPL-POLICY>
              <BSW-ENTRY-KIND>CONCRETE</BSW-ENTRY-KIND>
            </BSW-MODULE-ENTRY>    
            <BSW-MODULE-ENTRY UUID="a93b21ce-ede7-4fe1-bd4d-7518db1b8430">
              <SHORT-NAME>Port_Ch61Isr</SHORT-NAME>
              <IS-REENTRANT>false</IS-REENTRANT>
              <IS-SYNCHRONOUS>true</IS-SYNCHRONOUS>
              <CALL-TYPE>INTERRUPT</CALL-TYPE>
              <EXECUTION-CONTEXT>[!"$INT_EXECUTION_CONTEXT"!]</EXECUTION-CONTEXT>              
              <SW-SERVICE-IMPL-POLICY>STANDARD</SW-SERVICE-IMPL-POLICY>
              <BSW-ENTRY-KIND>CONCRETE</BSW-ENTRY-KIND>
            </BSW-MODULE-ENTRY>    
            <BSW-MODULE-ENTRY UUID="bfc72e95-d604-498a-9b7e-854f18d02498">
              <SHORT-NAME>Port_Ch62Isr</SHORT-NAME>
              <IS-REENTRANT>false</IS-REENTRANT>
              <IS-SYNCHRONOUS>true</IS-SYNCHRONOUS>
              <CALL-TYPE>INTERRUPT</CALL-TYPE>
              <EXECUTION-CONTEXT>[!"$INT_EXECUTION_CONTEXT"!]</EXECUTION-CONTEXT>              
              <SW-SERVICE-IMPL-POLICY>STANDARD</SW-SERVICE-IMPL-POLICY>
              <BSW-ENTRY-KIND>CONCRETE</BSW-ENTRY-KIND>
            </BSW-MODULE-ENTRY>    
            <BSW-MODULE-ENTRY UUID="e689dbe2-794c-4472-a2a4-f41435889185">
              <SHORT-NAME>Port_Ch63Isr</SHORT-NAME>
              <IS-REENTRANT>false</IS-REENTRANT>
              <IS-SYNCHRONOUS>true</IS-SYNCHRONOUS>
              <CALL-TYPE>INTERRUPT</CALL-TYPE>
              <EXECUTION-CONTEXT>[!"$INT_EXECUTION_CONTEXT"!]</EXECUTION-CONTEXT>              
              <SW-SERVICE-IMPL-POLICY>STANDARD</SW-SERVICE-IMPL-POLICY>
              <BSW-ENTRY-KIND>CONCRETE</BSW-ENTRY-KIND>
            </BSW-MODULE-ENTRY>    
            <BSW-MODULE-ENTRY UUID="39ee0f67-f38e-42bf-a0a4-a0bc795bc94e">
              <SHORT-NAME>Port_Ch64Isr</SHORT-NAME>
              <IS-REENTRANT>false</IS-REENTRANT>
              <IS-SYNCHRONOUS>true</IS-SYNCHRONOUS>
              <CALL-TYPE>INTERRUPT</CALL-TYPE>
              <EXECUTION-CONTEXT>[!"$INT_EXECUTION_CONTEXT"!]</EXECUTION-CONTEXT>              
              <SW-SERVICE-IMPL-POLICY>STANDARD</SW-SERVICE-IMPL-POLICY>
              <BSW-ENTRY-KIND>CONCRETE</BSW-ENTRY-KIND>
            </BSW-MODULE-ENTRY>    
            <BSW-MODULE-ENTRY UUID="88365cff-c735-428a-ab73-8fb43f1dd252">
              <SHORT-NAME>Port_Ch65Isr</SHORT-NAME>
              <IS-REENTRANT>false</IS-REENTRANT>
              <IS-SYNCHRONOUS>true</IS-SYNCHRONOUS>
              <CALL-TYPE>INTERRUPT</CALL-TYPE>
              <EXECUTION-CONTEXT>[!"$INT_EXECUTION_CONTEXT"!]</EXECUTION-CONTEXT>              
              <SW-SERVICE-IMPL-POLICY>STANDARD</SW-SERVICE-IMPL-POLICY>
              <BSW-ENTRY-KIND>CONCRETE</BSW-ENTRY-KIND>
            </BSW-MODULE-ENTRY>    
            <BSW-MODULE-ENTRY UUID="08416f2e-dbca-4845-ad87-03288f18b1c5">
              <SHORT-NAME>Port_Ch66Isr</SHORT-NAME>
              <IS-REENTRANT>false</IS-REENTRANT>
              <IS-SYNCHRONOUS>true</IS-SYNCHRONOUS>
              <CALL-TYPE>INTERRUPT</CALL-TYPE>
              <EXECUTION-CONTEXT>[!"$INT_EXECUTION_CONTEXT"!]</EXECUTION-CONTEXT>              
              <SW-SERVICE-IMPL-POLICY>STANDARD</SW-SERVICE-IMPL-POLICY>
              <BSW-ENTRY-KIND>CONCRETE</BSW-ENTRY-KIND>
            </BSW-MODULE-ENTRY>    
            <BSW-MODULE-ENTRY UUID="56cf64b9-5f3b-4e3b-be37-9b8d368e6604">
              <SHORT-NAME>Port_Ch67Isr</SHORT-NAME>
              <IS-REENTRANT>false</IS-REENTRANT>
              <IS-SYNCHRONOUS>true</IS-SYNCHRONOUS>
              <CALL-TYPE>INTERRUPT</CALL-TYPE>
              <EXECUTION-CONTEXT>[!"$INT_EXECUTION_CONTEXT"!]</EXECUTION-CONTEXT>              
              <SW-SERVICE-IMPL-POLICY>STANDARD</SW-SERVICE-IMPL-POLICY>
              <BSW-ENTRY-KIND>CONCRETE</BSW-ENTRY-KIND>
            </BSW-MODULE-ENTRY>    
            <BSW-MODULE-ENTRY UUID="4d2b1ffa-885a-4747-b18e-2fc3aa8690a7">
              <SHORT-NAME>Port_Ch68Isr</SHORT-NAME>
              <IS-REENTRANT>false</IS-REENTRANT>
              <IS-SYNCHRONOUS>true</IS-SYNCHRONOUS>
              <CALL-TYPE>INTERRUPT</CALL-TYPE>
              <EXECUTION-CONTEXT>[!"$INT_EXECUTION_CONTEXT"!]</EXECUTION-CONTEXT>              
              <SW-SERVICE-IMPL-POLICY>STANDARD</SW-SERVICE-IMPL-POLICY>
              <BSW-ENTRY-KIND>CONCRETE</BSW-ENTRY-KIND>
            </BSW-MODULE-ENTRY>    
            <BSW-MODULE-ENTRY UUID="c14c2cba-dea4-41bc-a256-e4ca77a28a83">
              <SHORT-NAME>Port_Ch69Isr</SHORT-NAME>
              <IS-REENTRANT>false</IS-REENTRANT>
              <IS-SYNCHRONOUS>true</IS-SYNCHRONOUS>
              <CALL-TYPE>INTERRUPT</CALL-TYPE>
              <EXECUTION-CONTEXT>[!"$INT_EXECUTION_CONTEXT"!]</EXECUTION-CONTEXT>              
              <SW-SERVICE-IMPL-POLICY>STANDARD</SW-SERVICE-IMPL-POLICY>
              <BSW-ENTRY-KIND>CONCRETE</BSW-ENTRY-KIND>
            </BSW-MODULE-ENTRY>    
            <BSW-MODULE-ENTRY UUID="b45e3e05-983b-4da1-aab2-500a9fbc3f37">
              <SHORT-NAME>Port_Ch70Isr</SHORT-NAME>
              <IS-REENTRANT>false</IS-REENTRANT>
              <IS-SYNCHRONOUS>true</IS-SYNCHRONOUS>
              <CALL-TYPE>INTERRUPT</CALL-TYPE>
              <EXECUTION-CONTEXT>[!"$INT_EXECUTION_CONTEXT"!]</EXECUTION-CONTEXT>              
              <SW-SERVICE-IMPL-POLICY>STANDARD</SW-SERVICE-IMPL-POLICY>
              <BSW-ENTRY-KIND>CONCRETE</BSW-ENTRY-KIND>
            </BSW-MODULE-ENTRY>    
            <BSW-MODULE-ENTRY UUID="cd9dbfe4-a21d-44d3-85d5-1ccbec1f1fad">
              <SHORT-NAME>Port_Ch71Isr</SHORT-NAME>
              <IS-REENTRANT>false</IS-REENTRANT>
              <IS-SYNCHRONOUS>true</IS-SYNCHRONOUS>
              <CALL-TYPE>INTERRUPT</CALL-TYPE>
              <EXECUTION-CONTEXT>[!"$INT_EXECUTION_CONTEXT"!]</EXECUTION-CONTEXT>              
              <SW-SERVICE-IMPL-POLICY>STANDARD</SW-SERVICE-IMPL-POLICY>
              <BSW-ENTRY-KIND>CONCRETE</BSW-ENTRY-KIND>
            </BSW-MODULE-ENTRY>    
            <BSW-MODULE-ENTRY UUID="b2897413-4394-46f1-a764-ac0a30b7a55f">
              <SHORT-NAME>Port_Ch72Isr</SHORT-NAME>
              <IS-REENTRANT>false</IS-REENTRANT>
              <IS-SYNCHRONOUS>true</IS-SYNCHRONOUS>
              <CALL-TYPE>INTERRUPT</CALL-TYPE>
              <EXECUTION-CONTEXT>[!"$INT_EXECUTION_CONTEXT"!]</EXECUTION-CONTEXT>              
              <SW-SERVICE-IMPL-POLICY>STANDARD</SW-SERVICE-IMPL-POLICY>
              <BSW-ENTRY-KIND>CONCRETE</BSW-ENTRY-KIND>
            </BSW-MODULE-ENTRY>    
            <BSW-MODULE-ENTRY UUID="8cbe2bd9-cc32-4049-ad74-d65e28df7d33">
              <SHORT-NAME>Port_Ch73Isr</SHORT-NAME>
              <IS-REENTRANT>false</IS-REENTRANT>
              <IS-SYNCHRONOUS>true</IS-SYNCHRONOUS>
              <CALL-TYPE>INTERRUPT</CALL-TYPE>
              <EXECUTION-CONTEXT>[!"$INT_EXECUTION_CONTEXT"!]</EXECUTION-CONTEXT>              
              <SW-SERVICE-IMPL-POLICY>STANDARD</SW-SERVICE-IMPL-POLICY>
              <BSW-ENTRY-KIND>CONCRETE</BSW-ENTRY-KIND>
            </BSW-MODULE-ENTRY>    
            <BSW-MODULE-ENTRY UUID="e547247b-c1c8-45f6-b89a-a8b4a705fd1c">
              <SHORT-NAME>Port_Ch74Isr</SHORT-NAME>
              <IS-REENTRANT>false</IS-REENTRANT>
              <IS-SYNCHRONOUS>true</IS-SYNCHRONOUS>
              <CALL-TYPE>INTERRUPT</CALL-TYPE>
              <EXECUTION-CONTEXT>[!"$INT_EXECUTION_CONTEXT"!]</EXECUTION-CONTEXT>              
              <SW-SERVICE-IMPL-POLICY>STANDARD</SW-SERVICE-IMPL-POLICY>
              <BSW-ENTRY-KIND>CONCRETE</BSW-ENTRY-KIND>
            </BSW-MODULE-ENTRY>    
            <BSW-MODULE-ENTRY UUID="a347e6d7-a942-422f-9ab6-a6eb0920e8fb">
              <SHORT-NAME>Port_Ch75Isr</SHORT-NAME>
              <IS-REENTRANT>false</IS-REENTRANT>
              <IS-SYNCHRONOUS>true</IS-SYNCHRONOUS>
              <CALL-TYPE>INTERRUPT</CALL-TYPE>
              <EXECUTION-CONTEXT>[!"$INT_EXECUTION_CONTEXT"!]</EXECUTION-CONTEXT>              
              <SW-SERVICE-IMPL-POLICY>STANDARD</SW-SERVICE-IMPL-POLICY>
              <BSW-ENTRY-KIND>CONCRETE</BSW-ENTRY-KIND>
            </BSW-MODULE-ENTRY>    
            <BSW-MODULE-ENTRY UUID="967e83d7-6698-45ba-86ee-402ea48f33da">
              <SHORT-NAME>Port_Ch76Isr</SHORT-NAME>
              <IS-REENTRANT>false</IS-REENTRANT>
              <IS-SYNCHRONOUS>true</IS-SYNCHRONOUS>
              <CALL-TYPE>INTERRUPT</CALL-TYPE>
              <EXECUTION-CONTEXT>[!"$INT_EXECUTION_CONTEXT"!]</EXECUTION-CONTEXT>              
              <SW-SERVICE-IMPL-POLICY>STANDARD</SW-SERVICE-IMPL-POLICY>
              <BSW-ENTRY-KIND>CONCRETE</BSW-ENTRY-KIND>
            </BSW-MODULE-ENTRY>    
            <BSW-MODULE-ENTRY UUID="a0ac66b2-ecba-44f2-aab7-53ddb712dbc9">
              <SHORT-NAME>Port_Ch77Isr</SHORT-NAME>
              <IS-REENTRANT>false</IS-REENTRANT>
              <IS-SYNCHRONOUS>true</IS-SYNCHRONOUS>
              <CALL-TYPE>INTERRUPT</CALL-TYPE>
              <EXECUTION-CONTEXT>[!"$INT_EXECUTION_CONTEXT"!]</EXECUTION-CONTEXT>              
              <SW-SERVICE-IMPL-POLICY>STANDARD</SW-SERVICE-IMPL-POLICY>
              <BSW-ENTRY-KIND>CONCRETE</BSW-ENTRY-KIND>
            </BSW-MODULE-ENTRY>    
            <BSW-MODULE-ENTRY UUID="383698f5-e2ac-402b-9c3c-8c4abe4eec71">
              <SHORT-NAME>Port_Ch78Isr</SHORT-NAME>
              <IS-REENTRANT>false</IS-REENTRANT>
              <IS-SYNCHRONOUS>true</IS-SYNCHRONOUS>
              <CALL-TYPE>INTERRUPT</CALL-TYPE>
              <EXECUTION-CONTEXT>[!"$INT_EXECUTION_CONTEXT"!]</EXECUTION-CONTEXT>              
              <SW-SERVICE-IMPL-POLICY>STANDARD</SW-SERVICE-IMPL-POLICY>
              <BSW-ENTRY-KIND>CONCRETE</BSW-ENTRY-KIND>
            </BSW-MODULE-ENTRY>    
            <BSW-MODULE-ENTRY UUID="ed77d0b2-73fc-4536-bfd4-bf6ac5c71210">
              <SHORT-NAME>Port_Ch79Isr</SHORT-NAME>
              <IS-REENTRANT>false</IS-REENTRANT>
              <IS-SYNCHRONOUS>true</IS-SYNCHRONOUS>
              <CALL-TYPE>INTERRUPT</CALL-TYPE>
              <EXECUTION-CONTEXT>[!"$INT_EXECUTION_CONTEXT"!]</EXECUTION-CONTEXT>              
              <SW-SERVICE-IMPL-POLICY>STANDARD</SW-SERVICE-IMPL-POLICY>
              <BSW-ENTRY-KIND>CONCRETE</BSW-ENTRY-KIND>
            </BSW-MODULE-ENTRY>    
            <BSW-MODULE-ENTRY UUID="e5255ec7-1bc6-4fcb-a98c-f1fc61725b72">
              <SHORT-NAME>Port_Ch80Isr</SHORT-NAME>
              <IS-REENTRANT>false</IS-REENTRANT>
              <IS-SYNCHRONOUS>true</IS-SYNCHRONOUS>
              <CALL-TYPE>INTERRUPT</CALL-TYPE>
              <EXECUTION-CONTEXT>[!"$INT_EXECUTION_CONTEXT"!]</EXECUTION-CONTEXT>              
              <SW-SERVICE-IMPL-POLICY>STANDARD</SW-SERVICE-IMPL-POLICY>
              <BSW-ENTRY-KIND>CONCRETE</BSW-ENTRY-KIND>
            </BSW-MODULE-ENTRY>    
            <BSW-MODULE-ENTRY UUID="56043e12-1145-4187-9d9d-8397e9fa21a5">
              <SHORT-NAME>Port_Ch81Isr</SHORT-NAME>
              <IS-REENTRANT>false</IS-REENTRANT>
              <IS-SYNCHRONOUS>true</IS-SYNCHRONOUS>
              <CALL-TYPE>INTERRUPT</CALL-TYPE>
              <EXECUTION-CONTEXT>[!"$INT_EXECUTION_CONTEXT"!]</EXECUTION-CONTEXT>              
              <SW-SERVICE-IMPL-POLICY>STANDARD</SW-SERVICE-IMPL-POLICY>
              <BSW-ENTRY-KIND>CONCRETE</BSW-ENTRY-KIND>
            </BSW-MODULE-ENTRY>    
            <BSW-MODULE-ENTRY UUID="8d317ca3-c23c-4d16-95c9-c92a03c324ee">
              <SHORT-NAME>Port_Ch82Isr</SHORT-NAME>
              <IS-REENTRANT>false</IS-REENTRANT>
              <IS-SYNCHRONOUS>true</IS-SYNCHRONOUS>
              <CALL-TYPE>INTERRUPT</CALL-TYPE>
              <EXECUTION-CONTEXT>[!"$INT_EXECUTION_CONTEXT"!]</EXECUTION-CONTEXT>              
              <SW-SERVICE-IMPL-POLICY>STANDARD</SW-SERVICE-IMPL-POLICY>
              <BSW-ENTRY-KIND>CONCRETE</BSW-ENTRY-KIND>
            </BSW-MODULE-ENTRY>    
            <BSW-MODULE-ENTRY UUID="a8456926-2349-4460-bb7f-9e7e46a63be7">
              <SHORT-NAME>Port_Ch83Isr</SHORT-NAME>
              <IS-REENTRANT>false</IS-REENTRANT>
              <IS-SYNCHRONOUS>true</IS-SYNCHRONOUS>
              <CALL-TYPE>INTERRUPT</CALL-TYPE>
              <EXECUTION-CONTEXT>[!"$INT_EXECUTION_CONTEXT"!]</EXECUTION-CONTEXT>              
              <SW-SERVICE-IMPL-POLICY>STANDARD</SW-SERVICE-IMPL-POLICY>
              <BSW-ENTRY-KIND>CONCRETE</BSW-ENTRY-KIND>
            </BSW-MODULE-ENTRY>    
            <BSW-MODULE-ENTRY UUID="41fe60fa-e9ec-4548-b660-c00e4edfd1c7">
              <SHORT-NAME>Port_Ch84Isr</SHORT-NAME>
              <IS-REENTRANT>false</IS-REENTRANT>
              <IS-SYNCHRONOUS>true</IS-SYNCHRONOUS>
              <CALL-TYPE>INTERRUPT</CALL-TYPE>
              <EXECUTION-CONTEXT>[!"$INT_EXECUTION_CONTEXT"!]</EXECUTION-CONTEXT>              
              <SW-SERVICE-IMPL-POLICY>STANDARD</SW-SERVICE-IMPL-POLICY>
              <BSW-ENTRY-KIND>CONCRETE</BSW-ENTRY-KIND>
            </BSW-MODULE-ENTRY>    
            <BSW-MODULE-ENTRY UUID="d58e3ff8-b02c-43d5-92df-4d4973008eae">
              <SHORT-NAME>Port_Ch85Isr</SHORT-NAME>
              <IS-REENTRANT>false</IS-REENTRANT>
              <IS-SYNCHRONOUS>true</IS-SYNCHRONOUS>
              <CALL-TYPE>INTERRUPT</CALL-TYPE>
              <EXECUTION-CONTEXT>[!"$INT_EXECUTION_CONTEXT"!]</EXECUTION-CONTEXT>              
              <SW-SERVICE-IMPL-POLICY>STANDARD</SW-SERVICE-IMPL-POLICY>
              <BSW-ENTRY-KIND>CONCRETE</BSW-ENTRY-KIND>
            </BSW-MODULE-ENTRY>    
            <BSW-MODULE-ENTRY UUID="a6972ba2-adbf-43ec-bc8f-75c4be22572f">
              <SHORT-NAME>Port_Ch86Isr</SHORT-NAME>
              <IS-REENTRANT>false</IS-REENTRANT>
              <IS-SYNCHRONOUS>true</IS-SYNCHRONOUS>
              <CALL-TYPE>INTERRUPT</CALL-TYPE>
              <EXECUTION-CONTEXT>[!"$INT_EXECUTION_CONTEXT"!]</EXECUTION-CONTEXT>              
              <SW-SERVICE-IMPL-POLICY>STANDARD</SW-SERVICE-IMPL-POLICY>
              <BSW-ENTRY-KIND>CONCRETE</BSW-ENTRY-KIND>
            </BSW-MODULE-ENTRY>    
            <BSW-MODULE-ENTRY UUID="b496990c-ab54-4364-af0f-f34a8c88aac1">
              <SHORT-NAME>Port_Ch87Isr</SHORT-NAME>
              <IS-REENTRANT>false</IS-REENTRANT>
              <IS-SYNCHRONOUS>true</IS-SYNCHRONOUS>
              <CALL-TYPE>INTERRUPT</CALL-TYPE>
              <EXECUTION-CONTEXT>[!"$INT_EXECUTION_CONTEXT"!]</EXECUTION-CONTEXT>              
              <SW-SERVICE-IMPL-POLICY>STANDARD</SW-SERVICE-IMPL-POLICY>
              <BSW-ENTRY-KIND>CONCRETE</BSW-ENTRY-KIND>
            </BSW-MODULE-ENTRY>    
            <BSW-MODULE-ENTRY UUID="a5f45511-5d11-435a-b241-5ff4a97c6529">
              <SHORT-NAME>Port_Ch88Isr</SHORT-NAME>
              <IS-REENTRANT>false</IS-REENTRANT>
              <IS-SYNCHRONOUS>true</IS-SYNCHRONOUS>
              <CALL-TYPE>INTERRUPT</CALL-TYPE>
              <EXECUTION-CONTEXT>[!"$INT_EXECUTION_CONTEXT"!]</EXECUTION-CONTEXT>              
              <SW-SERVICE-IMPL-POLICY>STANDARD</SW-SERVICE-IMPL-POLICY>
              <BSW-ENTRY-KIND>CONCRETE</BSW-ENTRY-KIND>
            </BSW-MODULE-ENTRY>    
            <BSW-MODULE-ENTRY UUID="949ed0a5-85ef-4136-802b-2b14539d1982">
              <SHORT-NAME>Port_Ch89Isr</SHORT-NAME>
              <IS-REENTRANT>false</IS-REENTRANT>
              <IS-SYNCHRONOUS>true</IS-SYNCHRONOUS>
              <CALL-TYPE>INTERRUPT</CALL-TYPE>
              <EXECUTION-CONTEXT>[!"$INT_EXECUTION_CONTEXT"!]</EXECUTION-CONTEXT>              
              <SW-SERVICE-IMPL-POLICY>STANDARD</SW-SERVICE-IMPL-POLICY>
              <BSW-ENTRY-KIND>CONCRETE</BSW-ENTRY-KIND>
            </BSW-MODULE-ENTRY>    
            <BSW-MODULE-ENTRY UUID="0a963ea2-a382-4af4-9e1b-c4ee72966cf1">
              <SHORT-NAME>Port_Ch90Isr</SHORT-NAME>
              <IS-REENTRANT>false</IS-REENTRANT>
              <IS-SYNCHRONOUS>true</IS-SYNCHRONOUS>
              <CALL-TYPE>INTERRUPT</CALL-TYPE>
              <EXECUTION-CONTEXT>[!"$INT_EXECUTION_CONTEXT"!]</EXECUTION-CONTEXT>              
              <SW-SERVICE-IMPL-POLICY>STANDARD</SW-SERVICE-IMPL-POLICY>
              <BSW-ENTRY-KIND>CONCRETE</BSW-ENTRY-KIND>
            </BSW-MODULE-ENTRY>    
            <BSW-MODULE-ENTRY UUID="dea7d81f-bc26-46bf-a4b1-eed66b40c516">
              <SHORT-NAME>Port_Ch91Isr</SHORT-NAME>
              <IS-REENTRANT>false</IS-REENTRANT>
              <IS-SYNCHRONOUS>true</IS-SYNCHRONOUS>
              <CALL-TYPE>INTERRUPT</CALL-TYPE>
              <EXECUTION-CONTEXT>[!"$INT_EXECUTION_CONTEXT"!]</EXECUTION-CONTEXT>              
              <SW-SERVICE-IMPL-POLICY>STANDARD</SW-SERVICE-IMPL-POLICY>
              <BSW-ENTRY-KIND>CONCRETE</BSW-ENTRY-KIND>
            </BSW-MODULE-ENTRY>    
            <BSW-MODULE-ENTRY UUID="13f5423b-ab12-4153-b755-3f31b4c64b7b">
              <SHORT-NAME>Port_Ch92Isr</SHORT-NAME>
              <IS-REENTRANT>false</IS-REENTRANT>
              <IS-SYNCHRONOUS>true</IS-SYNCHRONOUS>
              <CALL-TYPE>INTERRUPT</CALL-TYPE>
              <EXECUTION-CONTEXT>[!"$INT_EXECUTION_CONTEXT"!]</EXECUTION-CONTEXT>              
              <SW-SERVICE-IMPL-POLICY>STANDARD</SW-SERVICE-IMPL-POLICY>
              <BSW-ENTRY-KIND>CONCRETE</BSW-ENTRY-KIND>
            </BSW-MODULE-ENTRY>    
            <BSW-MODULE-ENTRY UUID="4ed4f151-b683-46be-9513-eccafb121bcb">
              <SHORT-NAME>Port_Ch93Isr</SHORT-NAME>
              <IS-REENTRANT>false</IS-REENTRANT>
              <IS-SYNCHRONOUS>true</IS-SYNCHRONOUS>
              <CALL-TYPE>INTERRUPT</CALL-TYPE>
              <EXECUTION-CONTEXT>[!"$INT_EXECUTION_CONTEXT"!]</EXECUTION-CONTEXT>              
              <SW-SERVICE-IMPL-POLICY>STANDARD</SW-SERVICE-IMPL-POLICY>
              <BSW-ENTRY-KIND>CONCRETE</BSW-ENTRY-KIND>
            </BSW-MODULE-ENTRY>    
            <BSW-MODULE-ENTRY UUID="a355a41a-1368-4d40-bc71-bd0535b2e478">
              <SHORT-NAME>Port_Ch94Isr</SHORT-NAME>
              <IS-REENTRANT>false</IS-REENTRANT>
              <IS-SYNCHRONOUS>true</IS-SYNCHRONOUS>
              <CALL-TYPE>INTERRUPT</CALL-TYPE>
              <EXECUTION-CONTEXT>[!"$INT_EXECUTION_CONTEXT"!]</EXECUTION-CONTEXT>              
              <SW-SERVICE-IMPL-POLICY>STANDARD</SW-SERVICE-IMPL-POLICY>
              <BSW-ENTRY-KIND>CONCRETE</BSW-ENTRY-KIND>
            </BSW-MODULE-ENTRY>    
            <BSW-MODULE-ENTRY UUID="c78c0d72-ce8c-4f59-a2d3-e84e35cd8af4">
              <SHORT-NAME>Port_Ch95Isr</SHORT-NAME>
              <IS-REENTRANT>false</IS-REENTRANT>
              <IS-SYNCHRONOUS>true</IS-SYNCHRONOUS>
              <CALL-TYPE>INTERRUPT</CALL-TYPE>
              <EXECUTION-CONTEXT>[!"$INT_EXECUTION_CONTEXT"!]</EXECUTION-CONTEXT>              
              <SW-SERVICE-IMPL-POLICY>STANDARD</SW-SERVICE-IMPL-POLICY>
              <BSW-ENTRY-KIND>CONCRETE</BSW-ENTRY-KIND>
            </BSW-MODULE-ENTRY>    
            <BSW-MODULE-ENTRY UUID="4616eba1-7e44-4c09-a7a0-48291113e68b">
              <SHORT-NAME>Port_Ch96Isr</SHORT-NAME>
              <IS-REENTRANT>false</IS-REENTRANT>
              <IS-SYNCHRONOUS>true</IS-SYNCHRONOUS>
              <CALL-TYPE>INTERRUPT</CALL-TYPE>
              <EXECUTION-CONTEXT>[!"$INT_EXECUTION_CONTEXT"!]</EXECUTION-CONTEXT>              
              <SW-SERVICE-IMPL-POLICY>STANDARD</SW-SERVICE-IMPL-POLICY>
              <BSW-ENTRY-KIND>CONCRETE</BSW-ENTRY-KIND>
            </BSW-MODULE-ENTRY>    
            <BSW-MODULE-ENTRY UUID="2336b6d9-5a7e-48e1-84ad-4b5356a254b0">
              <SHORT-NAME>Port_Ch97Isr</SHORT-NAME>
              <IS-REENTRANT>false</IS-REENTRANT>
              <IS-SYNCHRONOUS>true</IS-SYNCHRONOUS>
              <CALL-TYPE>INTERRUPT</CALL-TYPE>
              <EXECUTION-CONTEXT>[!"$INT_EXECUTION_CONTEXT"!]</EXECUTION-CONTEXT>              
              <SW-SERVICE-IMPL-POLICY>STANDARD</SW-SERVICE-IMPL-POLICY>
              <BSW-ENTRY-KIND>CONCRETE</BSW-ENTRY-KIND>
            </BSW-MODULE-ENTRY>    
            <BSW-MODULE-ENTRY UUID="b53f7940-8ba5-49ec-ac2e-ab1864801c90">
              <SHORT-NAME>Port_Ch98Isr</SHORT-NAME>
              <IS-REENTRANT>false</IS-REENTRANT>
              <IS-SYNCHRONOUS>true</IS-SYNCHRONOUS>
              <CALL-TYPE>INTERRUPT</CALL-TYPE>
              <EXECUTION-CONTEXT>[!"$INT_EXECUTION_CONTEXT"!]</EXECUTION-CONTEXT>              
              <SW-SERVICE-IMPL-POLICY>STANDARD</SW-SERVICE-IMPL-POLICY>
              <BSW-ENTRY-KIND>CONCRETE</BSW-ENTRY-KIND>
            </BSW-MODULE-ENTRY>    
            <BSW-MODULE-ENTRY UUID="f8934b3e-10d7-4662-b3c6-72ea56266056">
              <SHORT-NAME>Port_Ch99Isr</SHORT-NAME>
              <IS-REENTRANT>false</IS-REENTRANT>
              <IS-SYNCHRONOUS>true</IS-SYNCHRONOUS>
              <CALL-TYPE>INTERRUPT</CALL-TYPE>
              <EXECUTION-CONTEXT>[!"$INT_EXECUTION_CONTEXT"!]</EXECUTION-CONTEXT>              
              <SW-SERVICE-IMPL-POLICY>STANDARD</SW-SERVICE-IMPL-POLICY>
              <BSW-ENTRY-KIND>CONCRETE</BSW-ENTRY-KIND>
            </BSW-MODULE-ENTRY>    
            <BSW-MODULE-ENTRY UUID="d2b8b2fc-e717-441d-ae54-da4bc19d9c4e">
              <SHORT-NAME>Port_Ch100Isr</SHORT-NAME>
              <IS-REENTRANT>false</IS-REENTRANT>
              <IS-SYNCHRONOUS>true</IS-SYNCHRONOUS>
              <CALL-TYPE>INTERRUPT</CALL-TYPE>
              <EXECUTION-CONTEXT>[!"$INT_EXECUTION_CONTEXT"!]</EXECUTION-CONTEXT>              
              <SW-SERVICE-IMPL-POLICY>STANDARD</SW-SERVICE-IMPL-POLICY>
              <BSW-ENTRY-KIND>CONCRETE</BSW-ENTRY-KIND>
            </BSW-MODULE-ENTRY>    
            <BSW-MODULE-ENTRY UUID="b299aaff-9c48-4346-ad55-b3d45b08f412">
              <SHORT-NAME>Port_Ch101Isr</SHORT-NAME>
              <IS-REENTRANT>false</IS-REENTRANT>
              <IS-SYNCHRONOUS>true</IS-SYNCHRONOUS>
              <CALL-TYPE>INTERRUPT</CALL-TYPE>
              <EXECUTION-CONTEXT>[!"$INT_EXECUTION_CONTEXT"!]</EXECUTION-CONTEXT>              
              <SW-SERVICE-IMPL-POLICY>STANDARD</SW-SERVICE-IMPL-POLICY>
              <BSW-ENTRY-KIND>CONCRETE</BSW-ENTRY-KIND>
            </BSW-MODULE-ENTRY>    
            <BSW-MODULE-ENTRY UUID="cd323506-eac3-4046-82e8-2894ded06c6e">
              <SHORT-NAME>Port_Ch102Isr</SHORT-NAME>
              <IS-REENTRANT>false</IS-REENTRANT>
              <IS-SYNCHRONOUS>true</IS-SYNCHRONOUS>
              <CALL-TYPE>INTERRUPT</CALL-TYPE>
              <EXECUTION-CONTEXT>[!"$INT_EXECUTION_CONTEXT"!]</EXECUTION-CONTEXT>              
              <SW-SERVICE-IMPL-POLICY>STANDARD</SW-SERVICE-IMPL-POLICY>
              <BSW-ENTRY-KIND>CONCRETE</BSW-ENTRY-KIND>
            </BSW-MODULE-ENTRY>    
            <BSW-MODULE-ENTRY UUID="e9cf4f03-6130-44b5-a80f-fad0e8efbb80">
              <SHORT-NAME>Port_Ch103Isr</SHORT-NAME>
              <IS-REENTRANT>false</IS-REENTRANT>
              <IS-SYNCHRONOUS>true</IS-SYNCHRONOUS>
              <CALL-TYPE>INTERRUPT</CALL-TYPE>
              <EXECUTION-CONTEXT>[!"$INT_EXECUTION_CONTEXT"!]</EXECUTION-CONTEXT>              
              <SW-SERVICE-IMPL-POLICY>STANDARD</SW-SERVICE-IMPL-POLICY>
              <BSW-ENTRY-KIND>CONCRETE</BSW-ENTRY-KIND>
            </BSW-MODULE-ENTRY>    
            <BSW-MODULE-ENTRY UUID="aa9ee87c-e70e-4620-8128-e7fd57449e58">
              <SHORT-NAME>Port_Ch104Isr</SHORT-NAME>
              <IS-REENTRANT>false</IS-REENTRANT>
              <IS-SYNCHRONOUS>true</IS-SYNCHRONOUS>
              <CALL-TYPE>INTERRUPT</CALL-TYPE>
              <EXECUTION-CONTEXT>[!"$INT_EXECUTION_CONTEXT"!]</EXECUTION-CONTEXT>              
              <SW-SERVICE-IMPL-POLICY>STANDARD</SW-SERVICE-IMPL-POLICY>
              <BSW-ENTRY-KIND>CONCRETE</BSW-ENTRY-KIND>
            </BSW-MODULE-ENTRY>    
            <BSW-MODULE-ENTRY UUID="a8ad97e2-8057-4090-bbe0-5e76532b30ed">
              <SHORT-NAME>Port_Ch105Isr</SHORT-NAME>
              <IS-REENTRANT>false</IS-REENTRANT>
              <IS-SYNCHRONOUS>true</IS-SYNCHRONOUS>
              <CALL-TYPE>INTERRUPT</CALL-TYPE>
              <EXECUTION-CONTEXT>[!"$INT_EXECUTION_CONTEXT"!]</EXECUTION-CONTEXT>              
              <SW-SERVICE-IMPL-POLICY>STANDARD</SW-SERVICE-IMPL-POLICY>
              <BSW-ENTRY-KIND>CONCRETE</BSW-ENTRY-KIND>
            </BSW-MODULE-ENTRY>    
            <BSW-MODULE-ENTRY UUID="6b12e023-6baa-4526-a029-3dc90ee99191">
              <SHORT-NAME>Port_Ch106Isr</SHORT-NAME>
              <IS-REENTRANT>false</IS-REENTRANT>
              <IS-SYNCHRONOUS>true</IS-SYNCHRONOUS>
              <CALL-TYPE>INTERRUPT</CALL-TYPE>
              <EXECUTION-CONTEXT>[!"$INT_EXECUTION_CONTEXT"!]</EXECUTION-CONTEXT>              
              <SW-SERVICE-IMPL-POLICY>STANDARD</SW-SERVICE-IMPL-POLICY>
              <BSW-ENTRY-KIND>CONCRETE</BSW-ENTRY-KIND>
            </BSW-MODULE-ENTRY>    
            <BSW-MODULE-ENTRY UUID="9a33f62e-de18-4e68-b193-2246d8ae39fa">
              <SHORT-NAME>Port_Ch107Isr</SHORT-NAME>
              <IS-REENTRANT>false</IS-REENTRANT>
              <IS-SYNCHRONOUS>true</IS-SYNCHRONOUS>
              <CALL-TYPE>INTERRUPT</CALL-TYPE>
              <EXECUTION-CONTEXT>[!"$INT_EXECUTION_CONTEXT"!]</EXECUTION-CONTEXT>              
              <SW-SERVICE-IMPL-POLICY>STANDARD</SW-SERVICE-IMPL-POLICY>
              <BSW-ENTRY-KIND>CONCRETE</BSW-ENTRY-KIND>
            </BSW-MODULE-ENTRY>    
            <BSW-MODULE-ENTRY UUID="0bd538ac-bda8-4281-9e16-db4bd2ef35a6">
              <SHORT-NAME>Port_Ch108Isr</SHORT-NAME>
              <IS-REENTRANT>false</IS-REENTRANT>
              <IS-SYNCHRONOUS>true</IS-SYNCHRONOUS>
              <CALL-TYPE>INTERRUPT</CALL-TYPE>
              <EXECUTION-CONTEXT>[!"$INT_EXECUTION_CONTEXT"!]</EXECUTION-CONTEXT>              
              <SW-SERVICE-IMPL-POLICY>STANDARD</SW-SERVICE-IMPL-POLICY>
              <BSW-ENTRY-KIND>CONCRETE</BSW-ENTRY-KIND>
            </BSW-MODULE-ENTRY>    
            <BSW-MODULE-ENTRY UUID="f5d4134c-3340-4653-8849-68df67f37bfa">
              <SHORT-NAME>Port_Ch109Isr</SHORT-NAME>
              <IS-REENTRANT>false</IS-REENTRANT>
              <IS-SYNCHRONOUS>true</IS-SYNCHRONOUS>
              <CALL-TYPE>INTERRUPT</CALL-TYPE>
              <EXECUTION-CONTEXT>[!"$INT_EXECUTION_CONTEXT"!]</EXECUTION-CONTEXT>              
              <SW-SERVICE-IMPL-POLICY>STANDARD</SW-SERVICE-IMPL-POLICY>
              <BSW-ENTRY-KIND>CONCRETE</BSW-ENTRY-KIND>
            </BSW-MODULE-ENTRY>    
            <BSW-MODULE-ENTRY UUID="713c870c-f44e-4f42-bd52-da16b64bd079">
              <SHORT-NAME>Port_Ch110Isr</SHORT-NAME>
              <IS-REENTRANT>false</IS-REENTRANT>
              <IS-SYNCHRONOUS>true</IS-SYNCHRONOUS>
              <CALL-TYPE>INTERRUPT</CALL-TYPE>
              <EXECUTION-CONTEXT>[!"$INT_EXECUTION_CONTEXT"!]</EXECUTION-CONTEXT>              
              <SW-SERVICE-IMPL-POLICY>STANDARD</SW-SERVICE-IMPL-POLICY>
              <BSW-ENTRY-KIND>CONCRETE</BSW-ENTRY-KIND>
            </BSW-MODULE-ENTRY>    
            <BSW-MODULE-ENTRY UUID="c96318ec-1f38-486a-b5c9-3a471ddebe4b">
              <SHORT-NAME>Port_Ch111Isr</SHORT-NAME>
              <IS-REENTRANT>false</IS-REENTRANT>
              <IS-SYNCHRONOUS>true</IS-SYNCHRONOUS>
              <CALL-TYPE>INTERRUPT</CALL-TYPE>
              <EXECUTION-CONTEXT>[!"$INT_EXECUTION_CONTEXT"!]</EXECUTION-CONTEXT>              
              <SW-SERVICE-IMPL-POLICY>STANDARD</SW-SERVICE-IMPL-POLICY>
              <BSW-ENTRY-KIND>CONCRETE</BSW-ENTRY-KIND>
            </BSW-MODULE-ENTRY>    
            <BSW-MODULE-ENTRY UUID="c15302b5-89cb-4dfa-838e-7b5c0abfc4de">
              <SHORT-NAME>Port_Ch112Isr</SHORT-NAME>
              <IS-REENTRANT>false</IS-REENTRANT>
              <IS-SYNCHRONOUS>true</IS-SYNCHRONOUS>
              <CALL-TYPE>INTERRUPT</CALL-TYPE>
              <EXECUTION-CONTEXT>[!"$INT_EXECUTION_CONTEXT"!]</EXECUTION-CONTEXT>              
              <SW-SERVICE-IMPL-POLICY>STANDARD</SW-SERVICE-IMPL-POLICY>
              <BSW-ENTRY-KIND>CONCRETE</BSW-ENTRY-KIND>
            </BSW-MODULE-ENTRY>    
            <BSW-MODULE-ENTRY UUID="5f039978-39d0-4093-965b-195a123ff00a">
              <SHORT-NAME>Port_Ch113Isr</SHORT-NAME>
              <IS-REENTRANT>false</IS-REENTRANT>
              <IS-SYNCHRONOUS>true</IS-SYNCHRONOUS>
              <CALL-TYPE>INTERRUPT</CALL-TYPE>
              <EXECUTION-CONTEXT>[!"$INT_EXECUTION_CONTEXT"!]</EXECUTION-CONTEXT>              
              <SW-SERVICE-IMPL-POLICY>STANDARD</SW-SERVICE-IMPL-POLICY>
              <BSW-ENTRY-KIND>CONCRETE</BSW-ENTRY-KIND>
            </BSW-MODULE-ENTRY>    
            <BSW-MODULE-ENTRY UUID="5d8c3d9f-0147-48e0-aeac-c5c1ba93bec2">
              <SHORT-NAME>Port_Ch114Isr</SHORT-NAME>
              <IS-REENTRANT>false</IS-REENTRANT>
              <IS-SYNCHRONOUS>true</IS-SYNCHRONOUS>
              <CALL-TYPE>INTERRUPT</CALL-TYPE>
              <EXECUTION-CONTEXT>[!"$INT_EXECUTION_CONTEXT"!]</EXECUTION-CONTEXT>              
              <SW-SERVICE-IMPL-POLICY>STANDARD</SW-SERVICE-IMPL-POLICY>
              <BSW-ENTRY-KIND>CONCRETE</BSW-ENTRY-KIND>
            </BSW-MODULE-ENTRY>    
            <BSW-MODULE-ENTRY UUID="06c45233-f9f0-419c-946e-68e3fae6cd12">
              <SHORT-NAME>Port_Ch115Isr</SHORT-NAME>
              <IS-REENTRANT>false</IS-REENTRANT>
              <IS-SYNCHRONOUS>true</IS-SYNCHRONOUS>
              <CALL-TYPE>INTERRUPT</CALL-TYPE>
              <EXECUTION-CONTEXT>[!"$INT_EXECUTION_CONTEXT"!]</EXECUTION-CONTEXT>              
              <SW-SERVICE-IMPL-POLICY>STANDARD</SW-SERVICE-IMPL-POLICY>
              <BSW-ENTRY-KIND>CONCRETE</BSW-ENTRY-KIND>
            </BSW-MODULE-ENTRY>    
            <BSW-MODULE-ENTRY UUID="48a9f242-2041-41cb-b331-80db8a1be0e3">
              <SHORT-NAME>Port_Ch116Isr</SHORT-NAME>
              <IS-REENTRANT>false</IS-REENTRANT>
              <IS-SYNCHRONOUS>true</IS-SYNCHRONOUS>
              <CALL-TYPE>INTERRUPT</CALL-TYPE>
              <EXECUTION-CONTEXT>[!"$INT_EXECUTION_CONTEXT"!]</EXECUTION-CONTEXT>              
              <SW-SERVICE-IMPL-POLICY>STANDARD</SW-SERVICE-IMPL-POLICY>
              <BSW-ENTRY-KIND>CONCRETE</BSW-ENTRY-KIND>
            </BSW-MODULE-ENTRY>    
            <BSW-MODULE-ENTRY UUID="346bc7fc-0dc8-46af-9f48-ae6365cbde15">
              <SHORT-NAME>Port_Ch117Isr</SHORT-NAME>
              <IS-REENTRANT>false</IS-REENTRANT>
              <IS-SYNCHRONOUS>true</IS-SYNCHRONOUS>
              <CALL-TYPE>INTERRUPT</CALL-TYPE>
              <EXECUTION-CONTEXT>[!"$INT_EXECUTION_CONTEXT"!]</EXECUTION-CONTEXT>              
              <SW-SERVICE-IMPL-POLICY>STANDARD</SW-SERVICE-IMPL-POLICY>
              <BSW-ENTRY-KIND>CONCRETE</BSW-ENTRY-KIND>
            </BSW-MODULE-ENTRY>    
            <BSW-MODULE-ENTRY UUID="7826ccc1-e1ad-4e23-b04f-aa71e810f26d">
              <SHORT-NAME>Port_Ch118Isr</SHORT-NAME>
              <IS-REENTRANT>false</IS-REENTRANT>
              <IS-SYNCHRONOUS>true</IS-SYNCHRONOUS>
              <CALL-TYPE>INTERRUPT</CALL-TYPE>
              <EXECUTION-CONTEXT>[!"$INT_EXECUTION_CONTEXT"!]</EXECUTION-CONTEXT>              
              <SW-SERVICE-IMPL-POLICY>STANDARD</SW-SERVICE-IMPL-POLICY>
              <BSW-ENTRY-KIND>CONCRETE</BSW-ENTRY-KIND>
            </BSW-MODULE-ENTRY>    
            <BSW-MODULE-ENTRY UUID="28d8534e-7357-4eae-b02e-9eb9ee7b5a2d">
              <SHORT-NAME>Port_Ch119Isr</SHORT-NAME>
              <IS-REENTRANT>false</IS-REENTRANT>
              <IS-SYNCHRONOUS>true</IS-SYNCHRONOUS>
              <CALL-TYPE>INTERRUPT</CALL-TYPE>
              <EXECUTION-CONTEXT>[!"$INT_EXECUTION_CONTEXT"!]</EXECUTION-CONTEXT>              
              <SW-SERVICE-IMPL-POLICY>STANDARD</SW-SERVICE-IMPL-POLICY>
              <BSW-ENTRY-KIND>CONCRETE</BSW-ENTRY-KIND>
            </BSW-MODULE-ENTRY>    
            <BSW-MODULE-ENTRY UUID="3f4402da-f58c-49a3-aa42-2489e03c872f">
              <SHORT-NAME>Port_Ch120Isr</SHORT-NAME>
              <IS-REENTRANT>false</IS-REENTRANT>
              <IS-SYNCHRONOUS>true</IS-SYNCHRONOUS>
              <CALL-TYPE>INTERRUPT</CALL-TYPE>
              <EXECUTION-CONTEXT>[!"$INT_EXECUTION_CONTEXT"!]</EXECUTION-CONTEXT>              
              <SW-SERVICE-IMPL-POLICY>STANDARD</SW-SERVICE-IMPL-POLICY>
              <BSW-ENTRY-KIND>CONCRETE</BSW-ENTRY-KIND>
            </BSW-MODULE-ENTRY>    
            <BSW-MODULE-ENTRY UUID="cea78c87-2c33-43d2-9249-810b3cff3656">
              <SHORT-NAME>Port_Ch121Isr</SHORT-NAME>
              <IS-REENTRANT>false</IS-REENTRANT>
              <IS-SYNCHRONOUS>true</IS-SYNCHRONOUS>
              <CALL-TYPE>INTERRUPT</CALL-TYPE>
              <EXECUTION-CONTEXT>[!"$INT_EXECUTION_CONTEXT"!]</EXECUTION-CONTEXT>              
              <SW-SERVICE-IMPL-POLICY>STANDARD</SW-SERVICE-IMPL-POLICY>
              <BSW-ENTRY-KIND>CONCRETE</BSW-ENTRY-KIND>
            </BSW-MODULE-ENTRY>    
            <BSW-MODULE-ENTRY UUID="a5f46f53-b308-409a-abdc-b29c0eefef1a">
              <SHORT-NAME>Port_Ch122Isr</SHORT-NAME>
              <IS-REENTRANT>false</IS-REENTRANT>
              <IS-SYNCHRONOUS>true</IS-SYNCHRONOUS>
              <CALL-TYPE>INTERRUPT</CALL-TYPE>
              <EXECUTION-CONTEXT>[!"$INT_EXECUTION_CONTEXT"!]</EXECUTION-CONTEXT>              
              <SW-SERVICE-IMPL-POLICY>STANDARD</SW-SERVICE-IMPL-POLICY>
              <BSW-ENTRY-KIND>CONCRETE</BSW-ENTRY-KIND>
            </BSW-MODULE-ENTRY>    
            <BSW-MODULE-ENTRY UUID="c3a9cfc6-7af6-446b-a345-d36e7b43ce09">
              <SHORT-NAME>Port_Ch123Isr</SHORT-NAME>
              <IS-REENTRANT>false</IS-REENTRANT>
              <IS-SYNCHRONOUS>true</IS-SYNCHRONOUS>
              <CALL-TYPE>INTERRUPT</CALL-TYPE>
              <EXECUTION-CONTEXT>[!"$INT_EXECUTION_CONTEXT"!]</EXECUTION-CONTEXT>              
              <SW-SERVICE-IMPL-POLICY>STANDARD</SW-SERVICE-IMPL-POLICY>
              <BSW-ENTRY-KIND>CONCRETE</BSW-ENTRY-KIND>
            </BSW-MODULE-ENTRY>    
            <BSW-MODULE-ENTRY UUID="7de7e992-01b8-4f8a-ba53-03c758c298dd">
              <SHORT-NAME>Port_Ch124Isr</SHORT-NAME>
              <IS-REENTRANT>false</IS-REENTRANT>
              <IS-SYNCHRONOUS>true</IS-SYNCHRONOUS>
              <CALL-TYPE>INTERRUPT</CALL-TYPE>
              <EXECUTION-CONTEXT>[!"$INT_EXECUTION_CONTEXT"!]</EXECUTION-CONTEXT>              
              <SW-SERVICE-IMPL-POLICY>STANDARD</SW-SERVICE-IMPL-POLICY>
              <BSW-ENTRY-KIND>CONCRETE</BSW-ENTRY-KIND>
            </BSW-MODULE-ENTRY>    
            <BSW-MODULE-ENTRY UUID="5a460610-1f7c-45ab-9137-310f0618005a">
              <SHORT-NAME>Port_Ch125Isr</SHORT-NAME>
              <IS-REENTRANT>false</IS-REENTRANT>
              <IS-SYNCHRONOUS>true</IS-SYNCHRONOUS>
              <CALL-TYPE>INTERRUPT</CALL-TYPE>
              <EXECUTION-CONTEXT>[!"$INT_EXECUTION_CONTEXT"!]</EXECUTION-CONTEXT>              
              <SW-SERVICE-IMPL-POLICY>STANDARD</SW-SERVICE-IMPL-POLICY>
              <BSW-ENTRY-KIND>CONCRETE</BSW-ENTRY-KIND>
            </BSW-MODULE-ENTRY>    
            <BSW-MODULE-ENTRY UUID="719aabce-a8d8-44b3-9778-d779b7c30baa">
              <SHORT-NAME>Port_Ch126Isr</SHORT-NAME>
              <IS-REENTRANT>false</IS-REENTRANT>
              <IS-SYNCHRONOUS>true</IS-SYNCHRONOUS>
              <CALL-TYPE>INTERRUPT</CALL-TYPE>
              <EXECUTION-CONTEXT>[!"$INT_EXECUTION_CONTEXT"!]</EXECUTION-CONTEXT>              
              <SW-SERVICE-IMPL-POLICY>STANDARD</SW-SERVICE-IMPL-POLICY>
              <BSW-ENTRY-KIND>CONCRETE</BSW-ENTRY-KIND>
            </BSW-MODULE-ENTRY>    
            <BSW-MODULE-ENTRY UUID="6b5bc97c-f94e-4136-af3c-8f3538e45db7">
              <SHORT-NAME>Port_Ch127Isr</SHORT-NAME>
              <IS-REENTRANT>false</IS-REENTRANT>
              <IS-SYNCHRONOUS>true</IS-SYNCHRONOUS>
              <CALL-TYPE>INTERRUPT</CALL-TYPE>
              <EXECUTION-CONTEXT>[!"$INT_EXECUTION_CONTEXT"!]</EXECUTION-CONTEXT>              
              <SW-SERVICE-IMPL-POLICY>STANDARD</SW-SERVICE-IMPL-POLICY>
              <BSW-ENTRY-KIND>CONCRETE</BSW-ENTRY-KIND>
            </BSW-MODULE-ENTRY>    
            <BSW-MODULE-ENTRY UUID="f8bcafa7-0d90-4bc3-8034-ec0d39073131">
              <SHORT-NAME>Port_Ch128Isr</SHORT-NAME>
              <IS-REENTRANT>false</IS-REENTRANT>
              <IS-SYNCHRONOUS>true</IS-SYNCHRONOUS>
              <CALL-TYPE>INTERRUPT</CALL-TYPE>
              <EXECUTION-CONTEXT>[!"$INT_EXECUTION_CONTEXT"!]</EXECUTION-CONTEXT>              
              <SW-SERVICE-IMPL-POLICY>STANDARD</SW-SERVICE-IMPL-POLICY>
              <BSW-ENTRY-KIND>CONCRETE</BSW-ENTRY-KIND>
            </BSW-MODULE-ENTRY>    
            <BSW-MODULE-ENTRY UUID="e7dfb13d-1f7c-419b-a429-1c9e79a23dc8">
              <SHORT-NAME>Port_Ch129Isr</SHORT-NAME>
              <IS-REENTRANT>false</IS-REENTRANT>
              <IS-SYNCHRONOUS>true</IS-SYNCHRONOUS>
              <CALL-TYPE>INTERRUPT</CALL-TYPE>
              <EXECUTION-CONTEXT>[!"$INT_EXECUTION_CONTEXT"!]</EXECUTION-CONTEXT>              
              <SW-SERVICE-IMPL-POLICY>STANDARD</SW-SERVICE-IMPL-POLICY>
              <BSW-ENTRY-KIND>CONCRETE</BSW-ENTRY-KIND>
            </BSW-MODULE-ENTRY>    
            <BSW-MODULE-ENTRY UUID="510e44b2-8dd8-4347-b3f4-379fe350e304">
              <SHORT-NAME>Port_Ch130Isr</SHORT-NAME>
              <IS-REENTRANT>false</IS-REENTRANT>
              <IS-SYNCHRONOUS>true</IS-SYNCHRONOUS>
              <CALL-TYPE>INTERRUPT</CALL-TYPE>
              <EXECUTION-CONTEXT>[!"$INT_EXECUTION_CONTEXT"!]</EXECUTION-CONTEXT>              
              <SW-SERVICE-IMPL-POLICY>STANDARD</SW-SERVICE-IMPL-POLICY>
              <BSW-ENTRY-KIND>CONCRETE</BSW-ENTRY-KIND>
            </BSW-MODULE-ENTRY>    
            <BSW-MODULE-ENTRY UUID="faf2e945-0cde-4c6a-858f-aa72cb628a30">
              <SHORT-NAME>Port_Ch131Isr</SHORT-NAME>
              <IS-REENTRANT>false</IS-REENTRANT>
              <IS-SYNCHRONOUS>true</IS-SYNCHRONOUS>
              <CALL-TYPE>INTERRUPT</CALL-TYPE>
              <EXECUTION-CONTEXT>[!"$INT_EXECUTION_CONTEXT"!]</EXECUTION-CONTEXT>              
              <SW-SERVICE-IMPL-POLICY>STANDARD</SW-SERVICE-IMPL-POLICY>
              <BSW-ENTRY-KIND>CONCRETE</BSW-ENTRY-KIND>
            </BSW-MODULE-ENTRY>    
            <BSW-MODULE-ENTRY UUID="6ff8d6a2-7c1f-49a8-b1f1-1647fc209131">
              <SHORT-NAME>Port_Ch132Isr</SHORT-NAME>
              <IS-REENTRANT>false</IS-REENTRANT>
              <IS-SYNCHRONOUS>true</IS-SYNCHRONOUS>
              <CALL-TYPE>INTERRUPT</CALL-TYPE>
              <EXECUTION-CONTEXT>[!"$INT_EXECUTION_CONTEXT"!]</EXECUTION-CONTEXT>              
              <SW-SERVICE-IMPL-POLICY>STANDARD</SW-SERVICE-IMPL-POLICY>
              <BSW-ENTRY-KIND>CONCRETE</BSW-ENTRY-KIND>
            </BSW-MODULE-ENTRY>    
            <BSW-MODULE-ENTRY UUID="8940a005-bb71-45c4-a301-f447c3d3b2af">
              <SHORT-NAME>Port_Ch133Isr</SHORT-NAME>
              <IS-REENTRANT>false</IS-REENTRANT>
              <IS-SYNCHRONOUS>true</IS-SYNCHRONOUS>
              <CALL-TYPE>INTERRUPT</CALL-TYPE>
              <EXECUTION-CONTEXT>[!"$INT_EXECUTION_CONTEXT"!]</EXECUTION-CONTEXT>              
              <SW-SERVICE-IMPL-POLICY>STANDARD</SW-SERVICE-IMPL-POLICY>
              <BSW-ENTRY-KIND>CONCRETE</BSW-ENTRY-KIND>
            </BSW-MODULE-ENTRY>    
            <BSW-MODULE-ENTRY UUID="45dcdf3e-af12-4d1c-ba28-fda398623495">
              <SHORT-NAME>Port_Ch134Isr</SHORT-NAME>
              <IS-REENTRANT>false</IS-REENTRANT>
              <IS-SYNCHRONOUS>true</IS-SYNCHRONOUS>
              <CALL-TYPE>INTERRUPT</CALL-TYPE>
              <EXECUTION-CONTEXT>[!"$INT_EXECUTION_CONTEXT"!]</EXECUTION-CONTEXT>              
              <SW-SERVICE-IMPL-POLICY>STANDARD</SW-SERVICE-IMPL-POLICY>
              <BSW-ENTRY-KIND>CONCRETE</BSW-ENTRY-KIND>
            </BSW-MODULE-ENTRY>    
            <BSW-MODULE-ENTRY UUID="7dfc43d4-3253-45d8-aab7-e563a964c977">
              <SHORT-NAME>Port_Ch135Isr</SHORT-NAME>
              <IS-REENTRANT>false</IS-REENTRANT>
              <IS-SYNCHRONOUS>true</IS-SYNCHRONOUS>
              <CALL-TYPE>INTERRUPT</CALL-TYPE>
              <EXECUTION-CONTEXT>[!"$INT_EXECUTION_CONTEXT"!]</EXECUTION-CONTEXT>              
              <SW-SERVICE-IMPL-POLICY>STANDARD</SW-SERVICE-IMPL-POLICY>
              <BSW-ENTRY-KIND>CONCRETE</BSW-ENTRY-KIND>
            </BSW-MODULE-ENTRY>    
            <BSW-MODULE-ENTRY UUID="2a2b3ad1-d0df-4d9b-bcfa-d1a0c656f2a6">
              <SHORT-NAME>Port_Ch136Isr</SHORT-NAME>
              <IS-REENTRANT>false</IS-REENTRANT>
              <IS-SYNCHRONOUS>true</IS-SYNCHRONOUS>
              <CALL-TYPE>INTERRUPT</CALL-TYPE>
              <EXECUTION-CONTEXT>[!"$INT_EXECUTION_CONTEXT"!]</EXECUTION-CONTEXT>              
              <SW-SERVICE-IMPL-POLICY>STANDARD</SW-SERVICE-IMPL-POLICY>
              <BSW-ENTRY-KIND>CONCRETE</BSW-ENTRY-KIND>
            </BSW-MODULE-ENTRY>    
            <BSW-MODULE-ENTRY UUID="1338662a-980c-4936-a955-85474655ff25">
              <SHORT-NAME>Port_Ch137Isr</SHORT-NAME>
              <IS-REENTRANT>false</IS-REENTRANT>
              <IS-SYNCHRONOUS>true</IS-SYNCHRONOUS>
              <CALL-TYPE>INTERRUPT</CALL-TYPE>
              <EXECUTION-CONTEXT>[!"$INT_EXECUTION_CONTEXT"!]</EXECUTION-CONTEXT>              
              <SW-SERVICE-IMPL-POLICY>STANDARD</SW-SERVICE-IMPL-POLICY>
              <BSW-ENTRY-KIND>CONCRETE</BSW-ENTRY-KIND>
            </BSW-MODULE-ENTRY>    
            <BSW-MODULE-ENTRY UUID="226cf876-ac00-4ff3-a642-ae26f1fb7b33">
              <SHORT-NAME>Port_Ch138Isr</SHORT-NAME>
              <IS-REENTRANT>false</IS-REENTRANT>
              <IS-SYNCHRONOUS>true</IS-SYNCHRONOUS>
              <CALL-TYPE>INTERRUPT</CALL-TYPE>
              <EXECUTION-CONTEXT>[!"$INT_EXECUTION_CONTEXT"!]</EXECUTION-CONTEXT>              
              <SW-SERVICE-IMPL-POLICY>STANDARD</SW-SERVICE-IMPL-POLICY>
              <BSW-ENTRY-KIND>CONCRETE</BSW-ENTRY-KIND>
            </BSW-MODULE-ENTRY>
            <BSW-MODULE-ENTRY UUID="226cf876-ac00-4ff3-a642-ae26f1fb7b33">
              <SHORT-NAME>Port_Ch139Isr</SHORT-NAME>
              <IS-REENTRANT>false</IS-REENTRANT>
              <IS-SYNCHRONOUS>true</IS-SYNCHRONOUS>
              <CALL-TYPE>INTERRUPT</CALL-TYPE>
              <EXECUTION-CONTEXT>[!"$INT_EXECUTION_CONTEXT"!]</EXECUTION-CONTEXT>              
              <SW-SERVICE-IMPL-POLICY>STANDARD</SW-SERVICE-IMPL-POLICY>
              <BSW-ENTRY-KIND>CONCRETE</BSW-ENTRY-KIND>
            </BSW-MODULE-ENTRY>
          </ELEMENTS>
        </AR-PACKAGE>
      </AR-PACKAGES>
    </AR-PACKAGE>
  </AR-PACKAGES>
</AUTOSAR>
